/* -*- mode:c -*-
 *
 * Copyright 2018 The Chromium OS Authors. All rights reserved.
 * Use of this source code is governed by a BSD-style license that can be
 * found in the LICENSE file.
 */

/* Intel ICL-RVP-ITE board-specific configuration */

/*
 * Declare symbolic names for all the GPIOs that we care about.
 * Note: Those with interrupt handlers must be declared first.
 */

/* Power sequencing interrupts */
GPIO_INT(PCH_SLP_S0_L,	PIN(G, 6), GPIO_INT_BOTH, power_signal_interrupt)
#ifndef CONFIG_HOSTCMD_ESPI_VW_SLP_SIGNALS
UNIMPLEMENTED(PCH_SLP_S5_L)
GPIO_INT(PCH_SLP_S3_L,	PIN(F, 2), GPIO_INT_BOTH, power_signal_interrupt)
GPIO_INT(PCH_SLP_S4_L,	PIN(F, 3), GPIO_INT_BOTH, power_signal_interrupt)
#endif
GPIO_INT(PCH_SLP_SUS_L,	PIN(K, 2), GPIO_INT_BOTH, power_signal_interrupt)
GPIO_INT(RSMRST_L_PGOOD,PIN(F, 1), GPIO_INT_BOTH, power_signal_interrupt)
GPIO_INT(DSW_DPWROK,	PIN(I, 1), GPIO_INT_BOTH, power_signal_interrupt)
GPIO_INT(ALL_SYS_PWRGD,	PIN(F, 0), GPIO_INT_BOTH, power_signal_interrupt)

/* Button interrupts */
GPIO_INT(VOLUME_UP_L,	PIN(D, 5), GPIO_INT_BOTH | GPIO_PULL_UP, button_interrupt)
GPIO_INT(VOLUME_DOWN_L,	PIN(D, 6), GPIO_INT_BOTH | GPIO_PULL_UP, button_interrupt)
GPIO_INT(LID_OPEN,	PIN(E, 2), GPIO_INT_BOTH | GPIO_PULL_UP, lid_interrupt)
GPIO_INT(POWER_BUTTON_L,PIN(C, 0), GPIO_INT_BOTH, power_button_interrupt)

GPIO_INT(AC_PRESENT,	PIN(A, 7), GPIO_INT_BOTH, extpower_interrupt)

GPIO_INT(UART1_RX,	PIN(B, 0), GPIO_INT_FALLING, uart_deepsleep_interrupt)	/* UART1 RX input */

GPIO_INT(WP_L,		PIN(I, 4), GPIO_INT_BOTH, switch_interrupt)		/* EC_WP_ODL */

#ifdef CONFIG_HOSTCMD_ESPI
/* enable 1.8v input of EC's espi_reset pin, and then this pin takes effect. */
GPIO_INT(ESPI_RESET_L,	PIN(D, 2), GPIO_INT_FALLING | GPIO_SEL_1P8V, espi_reset_pin_asserted_interrupt) /* eSPI_reset# */
#endif

/* Type-C interrupts */
GPIO_INT(USB_C0_VBUS_INT,	PIN(L, 1),  GPIO_INT_BOTH, vbus0_evt)
/* TODO: SYSCROS-27560 */
UNIMPLEMENTED(USB_C1_VBUS_INT)

/* Power sequencing GPIOs */
GPIO(SYS_RESET_L,	PIN(B, 6), GPIO_ODR_HIGH)
GPIO(PCH_RSMRST_L,	PIN(C, 6), GPIO_OUT_LOW)
GPIO(PCH_PWRBTN_L,	PIN(D, 0), GPIO_ODR_HIGH)
GPIO(PCH_SYS_PWROK,	PIN(K, 4), GPIO_OUT_LOW)
GPIO(SMC_SHUTDOWN,	PIN(C, 3), GPIO_OUT_LOW | GPIO_PULL_DOWN)
GPIO(STARTUP_LATCH_SET,	PIN(L, 6), GPIO_INPUT)
GPIO(EC_SPI_OE_N,	PIN(I, 2), GPIO_OUT_HIGH)
UNIMPLEMENTED(PG_EC_DSW_PWROK)
UNIMPLEMENTED(EC_PCH_DSW_PWROK)
UNIMPLEMENTED(EN_PP3300_A)
UNIMPLEMENTED(EN_PP5000)
/*
 * PCH_PROCHOT_ODL is primarily for monitoring the PROCHOT# signal which is
 * normally driven by the PMIC. The EC can also drive this signal in the event
 * that the ambient or charger temperature sensors exceeds their thresholds.
 */
GPIO(CPU_PROCHOT,	PIN(B, 2), GPIO_INPUT)		/* PCH_PROCHOT_ODL */

/* Host communication GPIOs */
GPIO(PCH_WAKE_L,	PIN(J, 0), GPIO_ODR_HIGH)
#ifndef CONFIG_HOSTCMD_ESPI_VW_SLP_SIGNALS
GPIO(PCH_PLTRST_L,	PIN(E, 3), GPIO_INPUT | GPIO_PULL_UP)
#endif

GPIO(DC_JACK_PRESENT,	PIN(J, 2), GPIO_INPUT)	/* DC Jack presence coming from +VADP_OUT */
GPIO(USBC_LDO_ENABLE,	PIN(G, 2), GPIO_OUT_HIGH)	/* USB TCPC to enable LDO in dead battery */
GPIO(ENTERING_RW,	PIN(C, 5), GPIO_OUTPUT)		/* EC_ENTERING_RW */
UNIMPLEMENTED(ENABLE_BACKLIGHT)

GPIO(EC_BATT_PRES_L,	PIN(K, 0), GPIO_INPUT)

GPIO(SUSWARN,	PIN(E, 1), GPIO_INPUT)
GPIO(SUSACK,	PIN(H, 0), GPIO_OUT_LOW)

GPIO(USB_C0_SRC_EN_L,	PIN(F, 7), GPIO_OUT_HIGH)
GPIO(USB_C0_SNK_EN_L,	PIN(H, 6), GPIO_OUT_LOW)
GPIO(USB_C0_SRC_HI_ILIM, PIN(M, 6), GPIO_OUT_LOW)
GPIO(USB_C0_HPD,	PIN(E, 6), GPIO_INPUT)
GPIO(USB_C0_FRS_EN,	PIN(L, 7), GPIO_INPUT)

GPIO(USB_C1_SRC_EN_L,	PIN(G, 1), GPIO_OUT_HIGH)
GPIO(USB_C1_SNK_EN_L,	PIN(I, 5), GPIO_OUT_LOW)
GPIO(USB_C1_SRC_HI_ILIM, PIN(A, 0), GPIO_OUT_LOW)
GPIO(USB_C1_HPD,	PIN(D, 3), GPIO_INPUT)
GPIO(USB_C1_FRS_EN,	PIN(K, 5), GPIO_INPUT)

/* Retimer GPIOs */
GPIO(USB_C0_LS_EN,		PIN(J, 1), GPIO_INPUT)
GPIO(USB_C0_RETIMER_FORCE_PWR,	PIN(J, 3), GPIO_INPUT)
GPIO(USB_C0_RETIMER_RST_N,	PIN(J, 5), GPIO_INPUT)

GPIO(USB_C1_LS_EN,		PIN(C, 4), GPIO_INPUT)
GPIO(USB_C1_RETIMER_FORCE_PWR,	PIN(H, 5), GPIO_INPUT)
GPIO(USB_C1_RETIMER_RST_N,	PIN(J, 4), GPIO_INPUT)

/* TODO: Reassign, H4 and J6 as they are not I2C pins */
GPIO(USB_C0_RETIMER_I2C_DATA,	PIN(H, 4), GPIO_INPUT)
GPIO(USB_C0_RETIMER_I2C_CLK,	PIN(J, 6), GPIO_INPUT)
GPIO(USB_C1_RETIMER_ALRT,	PIN(G, 0), GPIO_INPUT)
GPIO(USB_C0_RETIMER_ALRT,	PIN(I, 7), GPIO_INPUT)

/* Type-C BC1.2 GPIOs */
GPIO(USB_C0_BC12_CHG_DET_L,	PIN(B, 7), GPIO_INPUT)
GPIO(USB_C1_BC12_CHG_DET_L,	PIN(A, 1), GPIO_INPUT)

/* USB-A GPIOs */
GPIO(USB_A_5V_EN,	PIN(K, 3), GPIO_INPUT)
GPIO(USB_A_CHG_EN,	PIN(D, 1), GPIO_INPUT)

/* LED */
GPIO(BAT_LED_GREEN,	PIN(A, 6), GPIO_INPUT)
GPIO(AC_LED_GREEN,	PIN(A, 3), GPIO_INPUT)

GPIO(CPU_PWM_FAN,	PIN(A, 2), GPIO_INPUT)
GPIO(CCD_MODE_ODL,	PIN(B, 5), GPIO_INPUT)
GPIO(SMB_PMIC_ALRT,	PIN(D, 4), GPIO_INPUT)
GPIO(CPU_TACHO_FAN,	PIN(D, 7), GPIO_INPUT)
GPIO(SLATE_MODE,	PIN(K, 1), GPIO_INPUT)
GPIO(THERM_SENS_PWRGATE_N, PIN(K, 6), GPIO_INPUT)
GPIO(EC_PCH_RTCRST,	PIN(K, 7), GPIO_INPUT)
GPIO(PMIC_EN,		PIN(H, 3), GPIO_INPUT)
GPIO(EC_PECI,		PIN(F, 6), GPIO_INPUT)
GPIO(SD_CARD_DETECT,	PIN(E, 5), GPIO_INPUT)
GPIO(SLP_S0_CS_N,	PIN(I, 0), GPIO_INPUT)
/*
 * TODO:SYSCROS-27640
 * GPIO(VR_TEMP,		PIN(I, 1), GPIO_INPUT)
 */
GPIO(EC_BASE_DET,	PIN(I, 3), GPIO_INPUT)
GPIO(SKIN_TEMP,		PIN(I, 6), GPIO_INPUT)
/* TODO:SYSCROS-27639 Remove multiple power button GPIOs */
GPIO(PWR_BTN_1,		PIN(E, 4), GPIO_INPUT)
GPIO(PWR_BTN_2,		PIN(L, 3), GPIO_INPUT)
GPIO(AMBIENT_TEMP,	PIN(L, 0), GPIO_INPUT)
GPIO(DDR_TEMP,		PIN(L, 2), GPIO_INPUT)
GPIO(EC_DS4,		PIN(L, 4), GPIO_INPUT)
GPIO(EC_THERM_ALRT,	PIN(L, 5), GPIO_INPUT)
/* TODO: C7 can be I2C only with F7 */
GPIO(SMB_PCK_CK,	PIN(C, 7), GPIO_INPUT)

/*
 * I2C pins should be configure as inputs until I2C module is
 * initialized. This will avoid driving the lines unintentionally.
 */
GPIO(I2C_A_SCL,	PIN(B, 3), GPIO_INPUT)
GPIO(I2C_A_SDA,	PIN(B, 4), GPIO_INPUT)
GPIO(I2C_B_SCL,	PIN(C, 1), GPIO_INPUT)
GPIO(I2C_B_SDA,	PIN(C, 2), GPIO_INPUT)
GPIO(I2C_E_SCL,	PIN(E, 0), GPIO_INPUT)
GPIO(I2C_E_SDA,	PIN(E, 7), GPIO_INPUT)
GPIO(I2C_F_SCL,	PIN(A, 4), GPIO_INPUT)
GPIO(I2C_F_SDA,	PIN(A, 5), GPIO_INPUT)

/* Unused pins 3.3V & Interruptable */
/* Unused pins: 3.3V or 1.8V & Interruptable */
/* Unused pins 3.3V & Non-Interruptable */
/* eSPI: Unused pins 1.8V & Interruptable */
/* eSPI: Unused pins 1.8V & Non-Interruptable */

/* Alternate pins for UART */
ALTERNATE(PIN_MASK(B, 0x03), 1, MODULE_UART, GPIO_PULL_UP) /* UART1 B0/B1 */

/* Alternate pins for I2C */
ALTERNATE(PIN_MASK(A, 0x30), 1, MODULE_I2C, 0)	/* I2C F SCL/SDA A4/A5 */
ALTERNATE(PIN_MASK(B, 0x18), 1, MODULE_I2C, 0)	/* I2C A SCL/SDA B3/B4 */
ALTERNATE(PIN_MASK(C, 0x06), 1, MODULE_I2C, 0)	/* I2C B SCL/SDA C1/C2 */
ALTERNATE(PIN_MASK(E, 0x81), 1, MODULE_I2C, 0)	/* I2C E SCL/SDA E0/E7 */


/* GPIOs that have internal configuration */
#if 0
/* Type-C GPIOs */
GPIO(USB_C0_CC1,	PIN(F, 4), GPIO_INPUT)
GPIO(USB_C0_CC2,	PIN(F, 5), GPIO_INPUT)
GPIO(USB_C0_CC1,	PIN(H, 1), GPIO_INPUT)
GPIO(USB_C0_CC2,	PIN(H, 2), GPIO_INPUT)

/* LPC / eSPI signals */
GPIO(LAD_EIO_0,		PIN(M, 0), GPIO_INPUT)
GPIO(LAD_EIO_1,		PIN(M, 1), GPIO_INPUT)
GPIO(LAD_EIO_2,		PIN(M, 2), GPIO_INPUT)
GPIO(LAD_EIO_3,		PIN(M, 3), GPIO_INPUT)
GPIO(LPC_ESPI_CLK,	PIN(M, 4), GPIO_INPUT)
GPIO(LFRAME_ESPI_CS,	PIN(M, 5), GPIO_INPUT)

/* EC SPI Flash signals */
GPIO(EC_SPI_FLASH_CS_L,	PIN(G, 3), GPIO_INPUT)
GPIO(EC_SPI_FLASH_MOSI,	PIN(G, 4), GPIO_INPUT)
GPIO(EC_SPI_FLASH_MISO,	PIN(G, 5), GPIO_INPUT)
GPIO(EC_SPI_FLASH_CLK,	PIN(G, 7), GPIO_INPUT)

/* Keyboard GPIOs */
GPIO(KSO_00)
GPIO(KSO_01)
GPIO(KSO_02_INV)
GPIO(KSO_03)
GPIO(KSO_04)
GPIO(KSO_05)
GPIO(KSO_06)
GPIO(KSO_07)
GPIO(KSO_08)
GPIO(KSO_09)
GPIO(KSO_10)
GPIO(KSO_11)
GPIO(KSO_12)
GPIO(KSO_13)
GPIO(KSO_14)
GPIO(KSO_15)

GPIO(KSI_00)
GPIO(KSI_01)
GPIO(KSI_02)
GPIO(KSI_03)
GPIO(KSI_04)
GPIO(KSI_05)
GPIO(KSI_06)
GPIO(KSI_07)
#endif
