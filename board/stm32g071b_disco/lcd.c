/* Copyright 2019 The Chromium OS Authors. All rights reserved.
 * Use of this source code is governed by a BSD-style license that can be
 * found in the LICENSE file.
 *
 */
#include "console.h"
#include "gpio.h"
#include "hooks.h"
#include "lcd.h"
#include "registers.h"
#include "spi.h"
#include "timer.h"
#include "util.h"

#define LCD_COLUMN_NUMBER	128
#define LCD_PAGE_NUMBRER	8

#define CHAR_LEN 13
static const uint8_t codes[][CHAR_LEN] = {
	{0x00, 0x00, 0x00, 0x00, 0x00, 0x00, 0x00, 0x00, 0x00, 0x00, 0x00,
	0x00, 0x00}, /*   */
	{0x00, 0x00, 0x18, 0x18, 0x00, 0x00, 0x18, 0x18, 0x18, 0x18, 0x18,
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	0x00, 0x00} /* ~ */
};

static uint8_t frame_buffer[LCD_COLUMN_NUMBER * LCD_PAGE_NUMBRER] __aligned(16);

static void write_cmd(uint8_t cmd)
{
	gpio_set_level(GPIO_LCD_DC, 0);
	spi_transaction(SPI_LCD_DEVICE, &cmd, 1, NULL, 0);
}

void lcd_clear(void)
{
	memset(frame_buffer, 0xff, LCD_COLUMN_NUMBER * LCD_PAGE_NUMBRER);
}

void lcd_update(void)
{
	gpio_set_level(GPIO_LCD_DC, 1);
	spi_transaction(SPI_LCD_DEVICE, frame_buffer,
			LCD_COLUMN_NUMBER * LCD_PAGE_NUMBRER, NULL, 0);

}

void lcd_init(void)
{
	gpio_set_level(GPIO_LCD_RES_L, 1);
	msleep(30);
	gpio_set_level(GPIO_LCD_RES_L, 0);
	msleep(10);
	gpio_set_level(GPIO_LCD_RES_L, 1);
	msleep(10);

	write_cmd(0x80);
	write_cmd(0x8d);
	write_cmd(0x14);
	write_cmd(0x20);
	write_cmd(0x00);
	write_cmd(0x40);
	write_cmd(0xc8);
	write_cmd(0xa1);
	write_cmd(0xaf);

	lcd_clear();
	lcd_update();
}

void lcd_prints(uint16_t x, uint16_t y, char const *str)
{
	int j;
	int len;

	if (str == NULL)
		return;

	len = strlen(str);
	if (len > 12)
		len = 12;

	for (j = 0; j < len; j++) {
		lcd_draw_char(x, y, *str);
		x += 10;
		str++;
	}
}

void lcd_draw_char(uint16_t ox, uint16_t oy, char ch)
{
	int j;
	int k;
	int m;
	int x = ox;
	int y = oy;

	for (j = CHAR_LEN-1; j >= 0; j--) {
		m = 0x80;
		x = ox;
		for (k = 0; k < 8; k++) {
			lcd_write_pixel(x, y, (m & codes[ch - 0x20][j]) ? 0:1);
			m = m >> 1;
			x++;
		}
		y++;
	}
}

void lcd_write_pixel(uint16_t x, uint16_t y, uint16_t c)
{
	if (c)
		frame_buffer[x + (y / 8) * LCD_PIXEL_WIDTH] |= 1 << (y % 8);
	else
		frame_buffer[x + (y / 8) * LCD_PIXEL_WIDTH] &= ~(1 << (y % 8));
}

void lcd_draw_hline(uint16_t x, uint16_t y, uint16_t len, uint16_t c)
{
	int i;

	for (i = x; i < x + len; i++)
		lcd_write_pixel(i, y, c);
}

void lcd_draw_vline(uint16_t x, uint16_t y, uint16_t len, uint16_t c)
{
	int i;

	for (i = y; i < y + len; i++)
		lcd_write_pixel(x, y, c);
}
