/* -*- mode:c -*-
 *
 * Copyright 2021 The Chromium OS Authors. All rights reserved.
 * Use of this source code is governed by a BSD-style license that can be
 * found in the LICENSE file.
 */

IOEX(USB_C0_BB_RETIMER_RST,	EXPIN(IOEX_C0_PCA9675, 0, 0), GPIO_OUT_LOW)
IOEX(USB_C0_BB_RETIMER_LS_EN,	EXPIN(IOEX_C0_PCA9675, 0, 1), GPIO_OUT_LOW)
IOEX(USB_C0_USB_MUX_CNTRL_1,	EXPIN(IOEX_C0_PCA9675, 0, 4), GPIO_OUT_LOW)
IOEX(USB_C0_USB_MUX_CNTRL_0,	EXPIN(IOEX_C0_PCA9675, 0, 5), GPIO_OUT_LOW)

IOEX(USB_C1_BB_RETIMER_RST,	EXPIN(IOEX_C1_PCA9675, 0, 0), GPIO_OUT_LOW)
IOEX(USB_C1_BB_RETIMER_LS_EN,	EXPIN(IOEX_C1_PCA9675, 0, 1), GPIO_OUT_LOW)
IOEX(USB_C0_C1_OC,		EXPIN(IOEX_C1_PCA9675, 0, 8), GPIO_OUT_HIGH)

IOEX(USB_C2_BB_RETIMER_RST,	EXPIN(IOEX_C2_PCA9675, 0, 0), GPIO_OUT_LOW)
IOEX(USB_C2_BB_RETIMER_LS_EN,	EXPIN(IOEX_C2_PCA9675, 0, 1), GPIO_OUT_LOW)

IOEX(USB_C3_BB_RETIMER_RST,	EXPIN(IOEX_C3_PCA9675, 0, 0), GPIO_OUT_LOW)
IOEX(USB_C3_BB_RETIMER_LS_EN,	EXPIN(IOEX_C3_PCA9675, 0, 1), GPIO_OUT_LOW)
IOEX(USB_C2_C3_OC,		EXPIN(IOEX_C3_PCA9675, 0, 8), GPIO_OUT_HIGH)
