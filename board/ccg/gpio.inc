/* -*- mode:c -*-
 *
 * Copyright 2020 The ChromiumOS Authors
 * Use of this source code is governed by a BSD-style license that can be
 * found in the LICENSE file.
 */

/* Intel ADL-P-RVP-ITE board-specific configuration */

/*
 * Declare symbolic names for all the GPIOs that we care about.
 * Note: Those with interrupt handlers must be declared first.
 */

GPIO(SLP_S0, PIN(D, 4), GPIO_INPUT)
GPIO(SLP_S3, PIN(F, 2), GPIO_INPUT)
GPIO(SLP_S4, PIN(F, 3), GPIO_INPUT)
GPIO(AC_PRESENT, PIN(K, 3), GPIO_INPUT)
GPIO(PLT_RST, PIN(H, 6), GPIO_INPUT)
GPIO(POWER_BTN, PIN(E, 4), GPIO_INPUT)
GPIO(RSMRST_PWRGD, PIN(F, 1), GPIO_INPUT)
GPIO(ALL_SYS_PWRGD, PIN(F, 0), GPIO_INPUT)
GPIO(PM_SLP_SUS_EC, PIN(K, 2), GPIO_INPUT)
GPIO(PCH_PWROK_EC_R, PIN(K, 4), GPIO_INPUT)
GPIO(SYS_PWROK_EC, PIN(D, 1), GPIO_INPUT)
GPIO(PROCHOT_EC, PIN(C, 0), GPIO_INPUT)
GPIO(EC_SPI_OE_N, PIN(I, 2), GPIO_OUT_HIGH)

#ifdef BOOT_FROM_MECC
GPIO(PM_PWRBTN_N_EC, PIN(D, 0), GPIO_OUT_HIGH)
GPIO(SYS_RST_ODL_EC, PIN(B, 6), GPIO_OUT_HIGH)
GPIO(PCH_WAKE_N, PIN(J, 0), GPIO_ODR_HIGH)

GPIO(EC_DS3, PIN(L, 4), GPIO_OUT_LOW)
GPIO(DSW_PWROK_EC, PIN(L, 6), GPIO_OUT_LOW)
GPIO(PM_RSMRST_EC, PIN(C, 6), GPIO_OUT_LOW)
#else
GPIO(PM_PWRBTN_N_EC, PIN(D, 0), GPIO_INPUT)
GPIO(SYS_RST_ODL_EC, PIN(B, 6), GPIO_INPUT)
GPIO(PCH_WAKE_N, PIN(J, 0), GPIO_INPUT)

GPIO(EC_DS3, PIN(L, 4), GPIO_INPUT)
GPIO(DSW_PWROK_EC, PIN(L, 6), GPIO_INPUT)
GPIO(PM_RSMRST_EC, PIN(C, 6), GPIO_INPUT)
#endif

UNIMPLEMENTED(WP_L)
UNIMPLEMENTED(ENTERING_RW)
UNIMPLEMENTED(PCH_WAKE_L)

ALTERNATE(PIN_MASK(B, BIT(0) | BIT(1)), GPIO_ALT_FUNC_DEFAULT, MODULE_UART,
	  GPIO_FLAG_NONE) /* UART1 B0/B1 */
