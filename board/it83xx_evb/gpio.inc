/* -*- mode:c -*-
 *
 * Copyright (c) 2014 The Chromium OS Authors. All rights reserved.
 * Use of this source code is governed by a BSD-style license that can be
 * found in the LICENSE file.
 */

/* Declare symbolic names for all the GPIOs that we care about.
 * Note: Those with interrupt handlers must be declared first. */

#ifdef CONFIG_LOW_POWER_IDLE
GPIO_INT(UART1_RX,       PIN(B, 0), GPIO_INT_FALLING,               uart_deepsleep_interrupt) /* UART1 RX input */
#endif

GPIO(GPIOA_0,        PIN(A, 0), GPIO_INPUT | GPIO_PULL_DOWN)
GPIO(GPIOA_1,        PIN(A, 1), GPIO_INPUT | GPIO_PULL_DOWN)
GPIO(GPIOA_2,        PIN(A, 2), GPIO_INPUT | GPIO_PULL_DOWN)
GPIO(GPIOA_3,        PIN(A, 3), GPIO_INPUT | GPIO_PULL_DOWN)
GPIO(GPIOA_4,        PIN(A, 4), GPIO_INPUT | GPIO_PULL_DOWN)
GPIO(GPIOA_5,        PIN(A, 5), GPIO_INPUT | GPIO_PULL_DOWN)
GPIO(GPIOA_6,        PIN(A, 6), GPIO_INPUT | GPIO_PULL_DOWN)
GPIO(GPIOA_7,        PIN(A, 7), GPIO_INPUT | GPIO_PULL_DOWN)

GPIO(GPIOB_2,        PIN(B, 2), GPIO_INPUT | GPIO_PULL_DOWN)
GPIO(I2C_A_SCL,      PIN(B, 3), GPIO_INPUT)
GPIO(I2C_A_SDA,      PIN(B, 4), GPIO_INPUT)
GPIO(GPIOB_5,        PIN(B, 5), GPIO_INPUT | GPIO_PULL_DOWN)
GPIO(GPIOB_6,        PIN(B, 6), GPIO_INPUT | GPIO_PULL_DOWN)
GPIO(PCH_WAKE_L,     PIN(B, 7), GPIO_INPUT | GPIO_PULL_DOWN)

GPIO(GPIOC_0,        PIN(C, 0), GPIO_INPUT | GPIO_PULL_DOWN)
GPIO(I2C_B_SCL,      PIN(C, 1), GPIO_INPUT)
GPIO(I2C_B_SDA,      PIN(C, 2), GPIO_INPUT)
GPIO(GPIOC_3,        PIN(C, 3), GPIO_INPUT | GPIO_PULL_DOWN)
GPIO(GPIOC_4,        PIN(C, 4), GPIO_INPUT | GPIO_PULL_DOWN)
GPIO(GPIOC_5,        PIN(C, 5), GPIO_INPUT | GPIO_PULL_DOWN)
GPIO(GPIOC_6,        PIN(C, 6), GPIO_INPUT | GPIO_PULL_DOWN)
GPIO(GPIOC_7,        PIN(C, 7), GPIO_INPUT | GPIO_PULL_DOWN)

GPIO(GPIOD_0,        PIN(D, 0), GPIO_INPUT | GPIO_PULL_DOWN)
GPIO(GPIOD_1,        PIN(D, 1), GPIO_INPUT | GPIO_PULL_DOWN)
GPIO(GPIOD_2,        PIN(D, 2), GPIO_INPUT | GPIO_PULL_DOWN)
GPIO(PCH_SMI_L,      PIN(D, 3), GPIO_INPUT | GPIO_PULL_DOWN)
GPIO(PCH_SCI_L,      PIN(D, 4), GPIO_INPUT | GPIO_PULL_DOWN)
GPIO(GPIOD_5,        PIN(D, 5), GPIO_INPUT | GPIO_PULL_DOWN)
GPIO(GPIOD_6,        PIN(D, 6), GPIO_INPUT | GPIO_PULL_DOWN)
GPIO(GPIOD_7,        PIN(D, 7), GPIO_INPUT | GPIO_PULL_DOWN)

GPIO(I2C_E_SCL,      PIN(E, 0), GPIO_INPUT | GPIO_PULL_DOWN)
GPIO(GPIOE_1,        PIN(E, 1), GPIO_INPUT | GPIO_PULL_DOWN)
GPIO(LID_OPEN,       PIN(E, 2), GPIO_INPUT | GPIO_PULL_DOWN)
GPIO(PCH_PLTRST_L,   PIN(E, 3), GPIO_INPUT | GPIO_PULL_DOWN)
GPIO(POWER_BUTTON_L, PIN(E, 4), GPIO_INPUT | GPIO_PULL_DOWN)
GPIO(GPIOE_5,        PIN(E, 5), GPIO_INPUT | GPIO_PULL_DOWN)
GPIO(GPIOE_6,        PIN(E, 6), GPIO_INPUT | GPIO_PULL_DOWN)
GPIO(I2C_E_SDA,      PIN(E, 7), GPIO_INPUT | GPIO_PULL_DOWN)

GPIO(GPIOF_0,        PIN(F, 0), GPIO_INPUT | GPIO_PULL_DOWN)
GPIO(GPIOF_1,        PIN(F, 1), GPIO_INPUT | GPIO_PULL_DOWN)
GPIO(GPIOF_2,        PIN(F, 2), GPIO_INPUT | GPIO_PULL_DOWN)
GPIO(GPIOF_3,        PIN(F, 3), GPIO_INPUT | GPIO_PULL_DOWN)
GPIO(GPIOF_4,        PIN(F, 4), GPIO_INPUT | GPIO_PULL_DOWN)
GPIO(GPIOF_5,        PIN(F, 5), GPIO_INPUT | GPIO_PULL_DOWN)
GPIO(I2C_C_SCL,      PIN(F, 6), GPIO_INPUT | GPIO_PULL_DOWN)
GPIO(I2C_C_SDA,      PIN(F, 7), GPIO_INPUT | GPIO_PULL_DOWN)

GPIO(GPIOG_0,        PIN(G, 0), GPIO_INPUT | GPIO_PULL_DOWN)
GPIO(GPIOG_1,        PIN(G, 1), GPIO_INPUT | GPIO_PULL_DOWN)
GPIO(GPIOG_2,        PIN(G, 2), GPIO_INPUT | GPIO_PULL_DOWN)
GPIO(GPIOG_3,        PIN(G, 3), GPIO_INPUT | GPIO_PULL_DOWN)
GPIO(GPIOG_4,        PIN(G, 4), GPIO_INPUT | GPIO_PULL_DOWN)
GPIO(GPIOG_5,        PIN(G, 5), GPIO_INPUT | GPIO_PULL_DOWN)
GPIO(GPIOG_6,        PIN(G, 6), GPIO_INPUT | GPIO_PULL_DOWN)
GPIO(GPIOG_7,        PIN(G, 7), GPIO_INPUT | GPIO_PULL_DOWN)

GPIO(GPIOH_0,        PIN(H, 0), GPIO_INPUT | GPIO_PULL_DOWN)
GPIO(GPIOH_1,        PIN(H, 1), GPIO_INPUT | GPIO_PULL_DOWN)
GPIO(GPIOH_2,        PIN(H, 2), GPIO_INPUT | GPIO_PULL_DOWN)
GPIO(GPIOH_3,        PIN(H, 3), GPIO_INPUT | GPIO_PULL_DOWN)
GPIO(GPIOH_4,        PIN(H, 4), GPIO_INPUT | GPIO_PULL_DOWN)
GPIO(GPIOH_5,        PIN(H, 5), GPIO_INPUT | GPIO_PULL_DOWN)
GPIO(GPIOH_6,        PIN(H, 6), GPIO_INPUT | GPIO_PULL_DOWN)
GPIO(GPIOH_7,        PIN(H, 7), GPIO_INPUT | GPIO_PULL_DOWN)

GPIO(GPIOI_0,        PIN(I, 0), GPIO_INPUT | GPIO_PULL_DOWN)
GPIO(GPIOI_1,        PIN(I, 1), GPIO_INPUT | GPIO_PULL_DOWN)
GPIO(GPIOI_2,        PIN(I, 2), GPIO_INPUT | GPIO_PULL_DOWN)
GPIO(GPIOI_3,        PIN(I, 3), GPIO_INPUT | GPIO_PULL_DOWN)
GPIO(GPIOI_4,        PIN(I, 4), GPIO_INPUT | GPIO_PULL_DOWN)
GPIO(GPIOI_5,        PIN(I, 5), GPIO_INPUT | GPIO_PULL_DOWN)
GPIO(GPIOI_6,        PIN(I, 6), GPIO_INPUT | GPIO_PULL_DOWN)
GPIO(GPIOI_7,        PIN(I, 7), GPIO_INPUT | GPIO_PULL_DOWN)

GPIO(GPIOJ_0,        PIN(J, 0), GPIO_INPUT | GPIO_PULL_DOWN)
GPIO(GPIOJ_1,        PIN(J, 1), GPIO_INPUT | GPIO_PULL_DOWN)
GPIO(GPIOJ_2,        PIN(J, 2), GPIO_INPUT | GPIO_PULL_DOWN)
GPIO(GPIOJ_3,        PIN(J, 3), GPIO_INPUT | GPIO_PULL_DOWN)
GPIO(GPIOJ_4,        PIN(J, 4), GPIO_INPUT | GPIO_PULL_DOWN)
GPIO(GPIOJ_5,        PIN(J, 5), GPIO_INPUT | GPIO_PULL_DOWN)
GPIO(GPIOJ_6,        PIN(J, 6), GPIO_INPUT | GPIO_PULL_DOWN)
GPIO(GPIOJ_7,        PIN(J, 7), GPIO_INPUT | GPIO_PULL_DOWN)

GPIO(GPIOK_0,        PIN(K, 0), GPIO_INPUT | GPIO_PULL_DOWN)
GPIO(GPIOK_1,        PIN(K, 1), GPIO_INPUT | GPIO_PULL_DOWN)
GPIO(GPIOK_2,        PIN(K, 2), GPIO_INPUT | GPIO_PULL_DOWN)
GPIO(GPIOK_3,        PIN(K, 3), GPIO_INPUT | GPIO_PULL_DOWN)
GPIO(GPIOK_4,        PIN(K, 4), GPIO_INPUT | GPIO_PULL_DOWN)
GPIO(GPIOK_5,        PIN(K, 5), GPIO_INPUT | GPIO_PULL_DOWN)
GPIO(GPIOK_6,        PIN(K, 6), GPIO_INPUT | GPIO_PULL_DOWN)
GPIO(GPIOK_7,        PIN(K, 7), GPIO_INPUT | GPIO_PULL_DOWN)

GPIO(GPIOL_0,        PIN(L, 0), GPIO_INPUT | GPIO_PULL_DOWN)
GPIO(GPIOL_1,        PIN(L, 1), GPIO_INPUT | GPIO_PULL_DOWN)
GPIO(GPIOL_2,        PIN(L, 2), GPIO_INPUT | GPIO_PULL_DOWN)
GPIO(GPIOL_3,        PIN(L, 3), GPIO_INPUT | GPIO_PULL_DOWN)
GPIO(GPIOL_4,        PIN(L, 4), GPIO_INPUT | GPIO_PULL_DOWN)
GPIO(GPIOL_5,        PIN(L, 5), GPIO_INPUT | GPIO_PULL_DOWN)
GPIO(GPIOL_6,        PIN(L, 6), GPIO_INPUT | GPIO_PULL_DOWN)
GPIO(GPIOL_7,        PIN(L, 7), GPIO_INPUT | GPIO_PULL_DOWN)

GPIO(GPIOM_0,        PIN(M, 0), GPIO_INPUT | GPIO_PULL_DOWN)
GPIO(GPIOM_1,        PIN(M, 1), GPIO_INPUT | GPIO_PULL_DOWN)
GPIO(GPIOM_2,        PIN(M, 2), GPIO_INPUT | GPIO_PULL_DOWN)
GPIO(GPIOM_3,        PIN(M, 3), GPIO_INPUT | GPIO_PULL_DOWN)
GPIO(GPIOM_4,        PIN(M, 4), GPIO_INPUT | GPIO_PULL_DOWN)
GPIO(GPIOM_5,        PIN(M, 5), GPIO_INPUT | GPIO_PULL_DOWN)
GPIO(GPIOM_6,        PIN(M, 6), GPIO_INPUT | GPIO_PULL_DOWN)
GPIO(GPIOM_7,        PIN(M, 7), GPIO_INPUT | GPIO_PULL_DOWN)

/* KSO/KSI pins can be used as GPIO input. */
GPIO(KSO_H_0, PIN(KSO_H, 0), GPIO_INPUT)
GPIO(KSO_H_1, PIN(KSO_H, 1), GPIO_INPUT)
GPIO(KSO_H_2, PIN(KSO_H, 2), GPIO_INPUT)
GPIO(KSO_H_3, PIN(KSO_H, 3), GPIO_INPUT)
GPIO(KSO_H_4, PIN(KSO_H, 4), GPIO_INPUT)
GPIO(BOARD_VERSION1, PIN(KSO_H, 5), GPIO_INPUT)
GPIO(BOARD_VERSION2, PIN(KSO_H, 6), GPIO_INPUT)
GPIO(BOARD_VERSION3, PIN(KSO_H, 7), GPIO_INPUT)

GPIO(KSO_L_0, PIN(KSO_L, 0), GPIO_INPUT)
GPIO(KSO_L_1, PIN(KSO_L, 1), GPIO_INPUT)
GPIO(KSO_L_2, PIN(KSO_L, 2), GPIO_INPUT)
GPIO(KSO_L_3, PIN(KSO_L, 3), GPIO_INPUT)
GPIO(KSO_L_4, PIN(KSO_L, 4), GPIO_INPUT)
GPIO(KSO_L_5, PIN(KSO_L, 5), GPIO_INPUT)
GPIO(KSO_L_6, PIN(KSO_L, 6), GPIO_INPUT)
GPIO(KSO_L_7, PIN(KSO_L, 7), GPIO_INPUT)

GPIO(KSI_0, PIN(KSI, 0), GPIO_INPUT)
GPIO(KSI_1, PIN(KSI, 1), GPIO_INPUT)
GPIO(KSI_2, PIN(KSI, 2), GPIO_INPUT)
GPIO(KSI_3, PIN(KSI, 3), GPIO_INPUT)
GPIO(KSI_4, PIN(KSI, 4), GPIO_INPUT)
GPIO(KSI_5, PIN(KSI, 5), GPIO_INPUT)
GPIO(KSI_6, PIN(KSI, 6), GPIO_INPUT)
GPIO(KSI_7, PIN(KSI, 7), GPIO_INPUT)

/* Unimplemented signals which we need to emulate for now */
UNIMPLEMENTED(WP)
UNIMPLEMENTED(ENTERING_RW)

ALTERNATE(PIN_MASK(B, 0x03), 1, MODULE_UART, GPIO_PULL_UP) /* UART1 */
