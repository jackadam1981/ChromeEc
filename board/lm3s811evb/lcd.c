/* Copyright 2017 The Chromium OS Authors. All rights reserved.
 * Use of this source code is governed by a BSD-style license that can be
 * found in the LICENSE file.
 *
 */
#include "console.h"
#include "hooks.h"
#include "i2c.h"
#include "util.h"

static const uint8_t *greeting = " EC ON QEMU ";

#define CHAR_LEN 8
static const uint8_t codes[][CHAR_LEN] = {
	{0x00, 0x00, 0x00, 0x00, 0x00, 0x00, 0x00, 0x00}, /*   */
	{0x5f, 0x5f, 0x00, 0x00, 0x00, 0x00, 0x00, 0x00}, /* ! */
	{0x07, 0x07, 0x00, 0x07, 0x07, 0x00, 0x00, 0x00}, /* " */
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	{0x00, 0x00, 0x00, 0x00, 0x00, 0x00, 0x00, 0x00}
};

static void lcd_clear(uint8_t line)
{
	int i;

	if (line > 1)
		return;

	i2c_write8(0, 0x3d, 0x80, 0xb0 + line);

	i2c_write8(0, 0x3d, 0x80, 0x04);
	i2c_write8(0, 0x3d, 0x80, 0x12);

	for (i = 0; i < CHAR_LEN; i++)
		i2c_write8(0, 0x3d, 0x40, codes[0][i]);

	i2c_write8(0, 0x3d, 0x80, 0xe3);

	i2c_write8(0, 0x3d, 0x80, 0x04);
	i2c_write8(0, 0x3d, 0x80, 0x12);
}

static void lcd_print(char const *str, uint8_t line)
{
	int len;
	int j;
	int k;

	if (str == NULL)
		return;

	if (line > 1)
		return;

	lcd_clear(line);

	len = strlen(str);
	if (len > 12)
		len = 12;

	for (j = 0; j < len; j++) {
		for (k = 0; k < CHAR_LEN; k++)
			i2c_write8(0, 0x3d, 0x40, codes[*str - 0x20][k]);
		str++;
	}
	i2c_write8(0, 0x3d, 0x80, 0xe3);
}

static int command_lcd_print(int argc, char **argv)
{
	int line;
	char *e;

	if (argc < 2)
		return EC_ERROR_PARAM_COUNT;

	line = strtoi(argv[1], &e, 10);
	if (*e)
		return EC_ERROR_PARAM1;

	lcd_print(argv[2], line);

	return EC_SUCCESS;
}
DECLARE_CONSOLE_COMMAND(lcdp, command_lcd_print, "", "Print to LCD");

static void lcd_init(void)
{
	i2c_write8(0, 0x3d, 0x80, 0x04);
	i2c_write8(0, 0x3d, 0x80, 0x12);
	i2c_write8(0, 0x3d, 0x80, 0x40);
	i2c_write8(0, 0x3d, 0x80, 0x81);
	i2c_write8(0, 0x3d, 0x80, 0x2b);
	i2c_write8(0, 0x3d, 0x80, 0xa1);
	i2c_write8(0, 0x3d, 0x80, 0xa4);
	i2c_write8(0, 0x3d, 0x80, 0xa6);
	i2c_write8(0, 0x3d, 0x80, 0xa8);
	i2c_write8(0, 0x3d, 0x80, 0x0f);
	i2c_write8(0, 0x3d, 0x80, 0xaf);
	i2c_write8(0, 0x3d, 0x80, 0xd3);
	i2c_write8(0, 0x3d, 0x80, 0xd0);
	i2c_write8(0, 0x3d, 0x80, 0x72);
	i2c_write8(0, 0x3d, 0x80, 0xd8);
	i2c_write8(0, 0x3d, 0x80, 0x00);
	i2c_write8(0, 0x3d, 0x80, 0x12);
	i2c_write8(0, 0x3d, 0x80, 0xdb);
	i2c_write8(0, 0x3d, 0x80, 0x0f);

	lcd_print(greeting, 0);
}
DECLARE_HOOK(HOOK_INIT, lcd_init, HOOK_PRIO_DEFAULT);
