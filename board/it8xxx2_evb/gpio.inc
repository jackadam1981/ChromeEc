/* -*- mode:c -*-
 *
 * Copyright 2020 The Chromium OS Authors. All rights reserved.
 * Use of this source code is governed by a BSD-style license that can be
 * found in the LICENSE file.
 */

/* Declare symbolic names for all the GPIOs that we care about.
 * Note: Those with interrupt handlers must be declared first. */

GPIO_INT(POWER_BUTTON_L, PIN(E, 4), GPIO_INT_BOTH | GPIO_PULL_UP,   power_button_interrupt)
#ifndef CONFIG_HOSTCMD_ESPI
GPIO_INT(PCH_PLTRST_L,   PIN(E, 3), GPIO_INT_BOTH | GPIO_PULL_UP,   lpcrst_interrupt)
#endif
GPIO_INT(LID_OPEN,       PIN(E, 2), GPIO_INT_BOTH | GPIO_PULL_UP,   lid_interrupt)
GPIO_INT(WP_L,           PIN(I, 4), GPIO_INT_BOTH | GPIO_PULL_UP,   switch_interrupt)         /* Write protect input */
#ifdef CONFIG_LOW_POWER_IDLE
GPIO_INT(UART1_RX,       PIN(B, 0), GPIO_INT_FALLING | GPIO_PULL_UP, uart_deepsleep_interrupt) /* UART1 RX input */
#endif

GPIO(PCH_SMI_L,      PIN(D, 3), GPIO_OUT_LOW)
GPIO(PCH_SCI_L,      PIN(D, 4), GPIO_OUT_LOW)
GPIO(GATE_A20_H,     PIN(B, 5), GPIO_OUT_LOW)
GPIO(SYS_RESET_L,    PIN(B, 6), GPIO_OUT_LOW)
GPIO(LPC_CLKRUN_L,   PIN(H, 0), GPIO_OUT_LOW)
GPIO(PCH_WAKE_L,     PIN(B, 7), GPIO_OUT_LOW) /* Wake signal from EC to PCH */

GPIO(I2C_A_SCL,      PIN(B, 3), GPIO_INPUT)
GPIO(I2C_A_SDA,      PIN(B, 4), GPIO_INPUT)
GPIO(I2C_B_SCL,      PIN(C, 1), GPIO_INPUT)
GPIO(I2C_B_SDA,      PIN(C, 2), GPIO_INPUT)
#ifdef CONFIG_IT83XX_SMCLK2_ON_GPC7
GPIO(I2C_C_SCL,      PIN(C, 7), GPIO_INPUT)
#else
GPIO(I2C_C_SCL,      PIN(F, 6), GPIO_INPUT)
#endif
GPIO(I2C_C_SDA,      PIN(F, 7), GPIO_INPUT)

GPIO(I2C_E_SCL,      PIN(E, 0), GPIO_INPUT)
GPIO(I2C_E_SDA,      PIN(E, 7), GPIO_INPUT)

#ifdef CONFIG_UART_HOST
GPIO(UART2_SIN1,     PIN(H, 1), GPIO_INPUT)
GPIO(UART2_SOUT1,    PIN(H, 2), GPIO_INPUT)
#endif

GPIO(GPA0,           PIN(A, 0), GPIO_INPUT | GPIO_PULL_DOWN)
GPIO(GPA1,           PIN(A, 1), GPIO_INPUT | GPIO_PULL_DOWN)
GPIO(GPA2,           PIN(A, 2), GPIO_INPUT | GPIO_PULL_DOWN)
GPIO(GPA3,           PIN(A, 3), GPIO_INPUT | GPIO_PULL_DOWN)
GPIO(GPA4,           PIN(A, 4), GPIO_INPUT | GPIO_PULL_UP)
GPIO(GPA5,           PIN(A, 5), GPIO_INPUT | GPIO_PULL_UP)
GPIO(GPA6,           PIN(A, 6), GPIO_INPUT | GPIO_PULL_DOWN)

GPIO(GPB2,           PIN(B, 2), GPIO_INPUT | GPIO_PULL_DOWN)
GPIO(GPC0,           PIN(C, 0), GPIO_INPUT | GPIO_PULL_DOWN)
GPIO(GPC3,           PIN(C, 3), GPIO_INPUT | GPIO_PULL_DOWN)
GPIO(GPC4,           PIN(C, 4), GPIO_INPUT | GPIO_PULL_DOWN)
GPIO(GPC5,           PIN(C, 5), GPIO_INPUT | GPIO_PULL_DOWN)
GPIO(GPC6,           PIN(C, 6), GPIO_INPUT | GPIO_PULL_DOWN)
GPIO(GPD0,           PIN(D, 0), GPIO_INPUT | GPIO_PULL_DOWN)
GPIO(GPD1,           PIN(D, 1), GPIO_INPUT | GPIO_PULL_DOWN)
GPIO(GPD2,           PIN(D, 2), GPIO_INPUT | GPIO_PULL_DOWN)
GPIO(GPD5,           PIN(D, 5), GPIO_INPUT | GPIO_PULL_DOWN)
GPIO(GPD7,           PIN(D, 7), GPIO_INPUT | GPIO_PULL_DOWN)
GPIO(GPE1,           PIN(E, 1), GPIO_INPUT | GPIO_PULL_DOWN)
GPIO(GPE5,           PIN(E, 5), GPIO_INPUT | GPIO_PULL_DOWN)
GPIO(GPE6,           PIN(E, 6), GPIO_INPUT | GPIO_PULL_DOWN)

GPIO(GPF0,           PIN(F, 0), GPIO_INPUT | GPIO_PULL_DOWN)
GPIO(GPF1,           PIN(F, 1), GPIO_INPUT | GPIO_PULL_DOWN)
GPIO(GPF2,           PIN(F, 2), GPIO_INPUT | GPIO_PULL_DOWN)
GPIO(GPF3,           PIN(F, 3), GPIO_INPUT | GPIO_PULL_DOWN)
GPIO(GPF4,           PIN(F, 4), GPIO_INPUT | GPIO_PULL_DOWN)
GPIO(GPF5,           PIN(F, 5), GPIO_INPUT | GPIO_PULL_DOWN)
/* PECI */
GPIO(GPF6,           PIN(F, 6), GPIO_INPUT | GPIO_PULL_DOWN)
GPIO(GPG0,           PIN(G, 0), GPIO_INPUT | GPIO_PULL_DOWN)
GPIO(GPG1,           PIN(G, 1), GPIO_INPUT | GPIO_PULL_DOWN)
GPIO(GPG2,           PIN(G, 2), GPIO_INPUT | GPIO_PULL_DOWN)
GPIO(GPH3,           PIN(H, 3), GPIO_INPUT | GPIO_PULL_DOWN)
GPIO(GPH4,           PIN(H, 4), GPIO_INPUT | GPIO_PULL_DOWN)
GPIO(GPH5,           PIN(H, 5), GPIO_INPUT | GPIO_PULL_DOWN)
GPIO(GPH6,           PIN(H, 6), GPIO_INPUT | GPIO_PULL_DOWN)

GPIO(GPI0,           PIN(I, 0), GPIO_INPUT | GPIO_PULL_DOWN)
GPIO(GPI1,           PIN(I, 1), GPIO_INPUT | GPIO_PULL_DOWN)
GPIO(GPI2,           PIN(I, 2), GPIO_INPUT | GPIO_PULL_DOWN)
GPIO(GPI3,           PIN(I, 3), GPIO_INPUT | GPIO_PULL_DOWN)
GPIO(GPI5,           PIN(I, 5), GPIO_INPUT | GPIO_PULL_DOWN)
GPIO(GPI6,           PIN(I, 6), GPIO_INPUT | GPIO_PULL_DOWN)
GPIO(GPI7,           PIN(I, 7), GPIO_INPUT | GPIO_PULL_DOWN)

GPIO(GPJ0,           PIN(J, 0), GPIO_INPUT | GPIO_PULL_DOWN)
GPIO(GPJ1,           PIN(J, 1), GPIO_INPUT | GPIO_PULL_DOWN)
GPIO(GPJ2,           PIN(J, 2), GPIO_INPUT | GPIO_PULL_DOWN)
GPIO(GPJ3,           PIN(J, 3), GPIO_INPUT | GPIO_PULL_DOWN)
GPIO(GPJ4,           PIN(J, 4), GPIO_INPUT | GPIO_PULL_DOWN)
GPIO(GPJ5,           PIN(J, 5), GPIO_INPUT | GPIO_PULL_DOWN)
GPIO(GPJ6,           PIN(J, 6), GPIO_OUT_LOW)
GPIO(GPJ7,           PIN(J, 7), GPIO_OUT_LOW)

GPIO(GPM0,           PIN(M, 0), GPIO_INPUT | GPIO_PULL_DOWN)
GPIO(GPM1,           PIN(M, 1), GPIO_INPUT | GPIO_PULL_DOWN)
GPIO(GPM2,           PIN(M, 2), GPIO_INPUT | GPIO_PULL_DOWN)
GPIO(GPM3,           PIN(M, 3), GPIO_INPUT | GPIO_PULL_DOWN)
GPIO(GPM4,           PIN(M, 4), GPIO_INPUT | GPIO_PULL_DOWN)
GPIO(GPM5,           PIN(M, 5), GPIO_INPUT | GPIO_PULL_DOWN)
GPIO(GPM6,           PIN(M, 6), GPIO_INPUT | GPIO_PULL_DOWN)

/* KSO/KSI pins can be used as GPIO input. */
GPIO(BOARD_VERSION1, PIN(KSO_H, 5), GPIO_INPUT)
GPIO(BOARD_VERSION2, PIN(KSO_H, 6), GPIO_INPUT)
GPIO(BOARD_VERSION3, PIN(KSO_H, 7), GPIO_INPUT)

/* Unimplemented signals which we need to emulate for now */
UNIMPLEMENTED(ENTERING_RW)

ALTERNATE(PIN_MASK(B, 0x03), 1, MODULE_UART, GPIO_PULL_UP) /* UART1 */
#ifdef CONFIG_UART_HOST
ALTERNATE(PIN_MASK(H, 0x06), 1, MODULE_UART, GPIO_PULL_UP) /* UART2 */
#endif
//ALTERNATE(PIN_MASK(A, 0x40), 3, MODULE_SPI_MASTER, GPIO_PULL_DOWN) /* SSCK of SPI */
//ALTERNATE(PIN_MASK(C, 0x28), 3, MODULE_SPI_MASTER, GPIO_PULL_DOWN) /* SMOSI/SMISO of SPI */
//ALTERNATE(PIN_MASK(G, 0x01), 3, MODULE_SPI_MASTER, GPIO_PULL_DOWN) /* SSCE1# of SPI */
//ALTERNATE(PIN_MASK(G, 0x04), 3, MODULE_SPI_MASTER, GPIO_PULL_DOWN) /* SSCE0# of SPI */
ALTERNATE(PIN_MASK(A, 0x80), 1, MODULE_PWM, GPIO_PULL_UP)        /* PWM7 for FAN1 */
ALTERNATE(PIN_MASK(D, 0x40), 3, MODULE_PWM, GPIO_PULL_UP)        /* TACH0A for FAN1 */
ALTERNATE(PIN_MASK(B, 0x18), 1, MODULE_I2C, GPIO_PULL_UP)        /* I2C A SCL/SDA */
#ifdef CONFIG_IT83XX_SMCLK2_ON_GPC7
ALTERNATE(PIN_MASK(C, 0x86), 1, MODULE_I2C, GPIO_PULL_UP)         /* I2C B SCL/SDA, C SCL */
ALTERNATE(PIN_MASK(F, 0x80), 1, MODULE_I2C, GPIO_PULL_UP)         /* I2C C SDA */
#else
ALTERNATE(PIN_MASK(C, 0x06), 1, MODULE_I2C, GPIO_PULL_UP)         /* I2C B SCL/SDA */
ALTERNATE(PIN_MASK(F, 0xC0), 1, MODULE_I2C, GPIO_PULL_UP)         /* I2C C SCL/SDA */
#endif
ALTERNATE(PIN_MASK(E, 0x81), 1, MODULE_I2C, GPIO_PULL_UP)         /* I2C E SCL/SDA E0/E7 */
