/* -*- mode:c -*-
 *
 * Copyright 2016 The Chromium OS Authors. All rights reserved.
 * Use of this source code is governed by a BSD-style license that can be
 * found in the LICENSE file.
 */

/* Outputs */
GPIO(UART1_EN_L, PIN(A, 8), GPIO_OUT_HIGH)
GPIO(SPI1_BUF_EN_L, PIN(A, 14), GPIO_OUT_HIGH)

/* Inputs */
GPIO(MUX_EN_L,			PIN(A, 7), GPIO_INPUT)
GPIO(USB_MUX_SEL,		PIN(A, 6), GPIO_INPUT)
GPIO(LED_BLUE,			PIN(A, 2), GPIO_INPUT)
GPIO(GPIO_1,  			PIN(A, 1), GPIO_INPUT)
GPIO(GPIO_2,  			PIN(A, 0), GPIO_INPUT)
GPIO(PHY_RESET,			PIN(C, 4), GPIO_INPUT)
GPIO(MCU_TO_PHY_MCO,		PIN(C, 9), GPIO_INPUT)
GPIO(LED_GRN,			PIN(C, 5), GPIO_INPUT)
GPIO(LED_RED,			PIN(C, 15), GPIO_INPUT)


GPIO(DUT_XTAL_STATUS_3V3,	PIN(D, 8), GPIO_INPUT)
GPIO(DUT_TO_MCU_1_3V3,		PIN(D, 9), GPIO_INPUT)
GPIO(DUT_TO_MCU_2_3V3,		PIN(D, 10), GPIO_INPUT)
GPIO(MCU_TO_DUT_INT_3V3,	PIN(D, 12), GPIO_INPUT)

/* I2C pins should be configured as inputs until I2C module is    */
/* initialized. This will avoid driving the lines unintentionally.*/
GPIO(MASTER_I2C1_SCL,		PIN(B, 6), GPIO_INPUT)
GPIO(MASTER_I2C1_SDA,		PIN(B, 7), GPIO_INPUT)
GPIO(MASTER_I2C2_SCL,		PIN(F, 1), GPIO_INPUT)
GPIO(MASTER_I2C2_SDA,		PIN(F, 0), GPIO_INPUT)
GPIO(MASTER_I2C3_SCL,		PIN(A, 8), GPIO_INPUT)
GPIO(MASTER_I2C3_SDA,		PIN(B, 4), GPIO_INPUT)
GPIO(MASTER_FMP_I2C_SCL,	PIN(C, 6), GPIO_INPUT)
GPIO(MASTER_FMP_I2C_SDA,	PIN(C, 7), GPIO_INPUT)

/* USART3 TX/RX */
GPIO(MCU_UART_TX,		PIN(C, 10), GPIO_INPUT)
GPIO(MCU_UART_RX,		PIN(C, 11), GPIO_INPUT)


/* Unimplemented signals since we are not an EC */
UNIMPLEMENTED(ENTERING_RW)
UNIMPLEMENTED(WP_L)

ALTERNATE(PIN_MASK(C, 0x0C00), 7, MODULE_USART, 0) /* USART3: PC10/PC11 - Console */

ALTERNATE(PIN_MASK(B, 0x00C0), 4, MODULE_I2C, 0) /* I2C1 MASTER:PB6/7 */
ALTERNATE(PIN_MASK(F, 0x0003), 4, MODULE_I2C, 0) /* I2C2 MASTER:PF1/0 */
ALTERNATE(PIN_MASK(A, 0x0100), 4, MODULE_I2C, 0) /* I2C3 MASTER:PA8 */
ALTERNATE(PIN_MASK(B, 0x0010), 4, MODULE_I2C, 0) /* I2C3 MASTER:PB4 */

ALTERNATE(PIN_MASK(B, 0xE000), 0, MODULE_SPI_FLASH, 0) /* SPI: PB15 - PB12 MOSI, MISO, CLK, CS */
