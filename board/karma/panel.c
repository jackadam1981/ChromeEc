/* Copyright 2018 The Chromium OS Authors. All rights reserved.
 * Use of this source code is governed by a BSD-style license that can be
 * found in the LICENSE file.
 */

#include "console.h"
#include "gpio.h"
#include "hooks.h"
#include "i2c.h"
#include "task.h"
#include "timer.h"

#define CPRINTS(format, args...) cprints(CC_I2C, format, ## args)
#define CPRINTF(format, args...) cprintf(CC_I2C, format, ## args)

#define EEPROM_PAGE_SIZE	8
#define EEPROM_TOTAL_SIZE	128

enum panel_id_list {
	PANEL_LM_SSE2 = 0,
	PANEL_LM_SSK1,
	PANEL_COUNT,
	PANEL_UNKNOWN,
};

/* Karma panel EDID */
static const uint8_t edid[PANEL_COUNT][EEPROM_TOTAL_SIZE] = {
	/* LM238WF5_SSE2 */
	{
		0x00, 0xFF, 0xFF, 0xFF, 0xFF, 0xFF, 0xFF, 0x00,
		0x30, 0xE4, 0x81, 0x23, 0x78, 0x56, 0x34, 0x12,
		0x06, 0x1D, 0x01, 0x04, 0xA5, 0x34, 0x1D, 0x78,
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		0x00, 0x00, 0x00, 0x00, 0x00, 0x00, 0x00, 0xEB,
	},
	/* LM238WF2_SSK1 */
	{
		0x00, 0xFF, 0xFF, 0xFF, 0xFF, 0xFF, 0xFF, 0x00,
		0x30, 0xE4, 0x82, 0x23, 0x78, 0x56, 0x34, 0x12,
		0x06, 0x1D, 0x01, 0x04, 0xA5, 0x34, 0x1D, 0x78,
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		0x00, 0x00, 0x00, 0x00, 0x00, 0x00, 0x00, 0x22,
	},
};

static int get_panel_id(void)
{
	int pin_status = 0;

	if (gpio_get_level(GPIO_PANEL_ID_0))
		pin_status |= 0x01;
	if (gpio_get_level(GPIO_PANEL_ID_1))
		pin_status |= 0x02;
	if (gpio_get_level(GPIO_PANEL_ID_2))
		pin_status |= 0x04;

	CPRINTS("Panel pin_status 0x%X", pin_status);

	switch (pin_status) {
	case 0x04:
		return PANEL_LM_SSE2;
	case 0x05:
		return PANEL_LM_SSK1;
	default:
		return PANEL_UNKNOWN;
	}
}

static void flash_edid(void)
{
	int i, j, rv, data_is_different;
	int panel_id = get_panel_id();
	uint8_t edid_tmp[EEPROM_PAGE_SIZE];

	if (panel_id == PANEL_UNKNOWN) {
		CPRINTS("Panel ID unknown!");
		return;
	}

	for (i = 0; i < EEPROM_TOTAL_SIZE / EEPROM_PAGE_SIZE; ++i) {
		/* Read EDID from EEPROM to verify. */
		rv = i2c_read_block(
			I2C_PORT_THERMAL,
			I2C_ADDR_EEPROM,
			i * EEPROM_PAGE_SIZE,
			edid_tmp,
			EEPROM_PAGE_SIZE);

		/* Time interval between pages. */
		task_wait_event(5 * MSEC);

		if (rv) {
			data_is_different = 1;
			CPRINTS("Read EDID from EEPROM, page %d FAILED!", i);
		} else {
			data_is_different = 0;

			/* Verify EDID. */
			for (j = 0; j < EEPROM_PAGE_SIZE; ++j) {
				if (edid_tmp[j] !=
				    edid[panel_id][i * EEPROM_PAGE_SIZE + j]) {
					data_is_different = 1;
					break;
				}
			}
		}

		/* If data is already correct, no need to write again. */
		if (!data_is_different)
			continue;

		/* If data is not correct, Write EDID into EEPROM. */
		rv = i2c_write_block(
			I2C_PORT_THERMAL,
			I2C_ADDR_EEPROM,
			i * EEPROM_PAGE_SIZE,
			(uint8_t *)&edid[panel_id][i*EEPROM_PAGE_SIZE],
			EEPROM_PAGE_SIZE);

		/* Time interval between pages. */
		task_wait_event(5 * MSEC);

		if (rv)
			CPRINTS("Write EDID into EEPROM, page %d FAILED!", i);
	}
}
DECLARE_HOOK(HOOK_INIT, flash_edid, HOOK_PRIO_DEFAULT);
