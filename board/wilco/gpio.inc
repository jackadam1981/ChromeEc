/* -*- mode:c -*-
 *
 * Copyright 2017 The Chromium OS Authors. All rights reserved.
 * Use of this source code is governed by a BSD-style license that can be
 * found in the LICENSE file.
 */

GPIO_INT(LID_OPEN, PIN(0115), GPIO_INT_BOTH | GPIO_PULL_UP, lid_interrupt)
GPIO_INT(POWER_BUTTON_L, PIN(0163), GPIO_INT_BOTH, power_button_interrupt)
GPIO_INT(UART0_RX,          PIN(0105), GPIO_INT_BOTH_DSLEEP | GPIO_PULL_UP, \
	 uart_deepsleep_interrupt)
GPIO_INT(PCH_SLP_SUS_L, PIN(0230), GPIO_INT_BOTH, power_signal_interrupt)
GPIO_INT(VCC_PWRGD, PIN(057), GPIO_INT_BOTH, power_signal_interrupt)
GPIO_INT(BC_INT_L, PIN(0212), GPIO_INT_FALLING, bc_link_interrupt)

GPIO(PCH_ALW_ON, PIN(0231), GPIO_OUT_HIGH)
GPIO(RUN_ON_EC, PIN(045), GPIO_OUT_HIGH)
GPIO(SIO_EXT_WAKE_L, PIN(0120), GPIO_OUT_HIGH)
GPIO(PCH_ACOK, PIN(0233), GPIO_OUT_LOW)
GPIO(PCH_SUSACK_L, PIN(0111), GPIO_OUT_HIGH)
GPIO(VCCST_PWRGD, PIN(0114), GPIO_OUT_HIGH)
GPIO(LCD_TST, PIN(052), GPIO_OUT_LOW)
GPIO(PCH_RSMRST_L, PIN(055), GPIO_OUT_LOW)
GPIO(BIA_PWM, PIN(01), GPIO_OUT_HIGH)
GPIO(PANEL_BKEN_EC, PIN(015), GPIO_OUT_HIGH)
GPIO(EN_INVPWR, PIN(023), GPIO_OUT_HIGH)
GPIO(IMVP_VR_ON_EC, PIN(031), GPIO_OUT_HIGH)
GPIO(LCD_VCC_TEST_EN, PIN(0226), GPIO_OUT_HIGH)
GPIO(VCCDSW_EN, PIN(012), GPIO_OUT_HIGH)
GPIO(CV2_ON, PIN(0222), GPIO_OUT_HIGH)
GPIO(TS_3V3_EN, PIN(0223), GPIO_OUT_HIGH)
GPIO(WWAN_3V3_EN, PIN(0165), GPIO_OUT_HIGH)
GPIO(TERMTRIP2_L, PIN(0103), GPIO_OUT_HIGH)
GPIO(SYS_PWROK, PIN(0106), GPIO_OUT_HIGH)

GPIO(PCH_PWRBTN_L,          PIN(0113),  GPIO_OUTPUT)

UNIMPLEMENTED(RSMRST_L_PGOOD)
UNIMPLEMENTED(WP_L)
UNIMPLEMENTED(QMSPI_CS0)
UNIMPLEMENTED(PMIC_SLP_SUS_L)

/* MEC1701H GPIO_0111/PS2_DAT2 OK */
GPIO(CPU_PROCHOT,           PIN(0160), GPIO_OUT_HIGH)
GPIO(SYS_RESET_L,           PIN(025), GPIO_OUT_LOW)
GPIO(CHARGE_LED_1,	PIN(0156), GPIO_OUT_LOW)
GPIO(CHARGE_LED_2,	PIN(0157), GPIO_OUT_LOW)

/* BC-Link pins */
GPIO(BC_DAT, PIN(046), GPIO_INPUT)
GPIO(BC_CLK, PIN(047), GPIO_INPUT)

/* Alternate functions GPIO definitions */

/*
 * GPIO_0104(UART0_TX) Func1
 * GPIO_0105(UART0_RX) Func1
 * Bank 2 bits[4:5]
 */
ALTERNATE(PIN_MASK(2, 0x30), 1, MODULE_UART, 0)

/*
 * GPIO_046(BCM1_DAT) Func1
 * GPIO_047(BCM1_CLK) Func1
 * Bank 2 bits[6:7]
 */
ALTERNATE(PIN_MASK(1, 0xC0), 1, MODULE_I2C, 0)

/* !!! PORTED TO MEC1701H !!! */
/* eSPI pins */
/* ESPI_RESET# - GPIO_0061 Function 2, Bank 1 bit[17] */
ALTERNATE(PIN_MASK(1, 0x20000), 2, MODULE_LPC, 0)
/* ESPI_ALERT# - GPIO_0063 Function 2, Bank 1 bit[19] */
ALTERNATE(PIN_MASK(1, 0x80000), 2, MODULE_LPC, 0)
/* ESPI_CS# - GPIO_0066 Function 2, Bank 1 bit[22] */
ALTERNATE(PIN_MASK(1, 0x400000), 2, MODULE_LPC, 0)
/* ESPI_CLK - GPIO_0065 Function 2, Bank 1 bit[21] */
ALTERNATE(PIN_MASK(1, 0x200000), 2, MODULE_LPC, 0)
/* ESPI_IO{0,1,2,3} - GPIO_0070-GPIO_0073 Function 2, Bank 1 bits[24:27] */
ALTERNATE(PIN_MASK(1, 0xf000000), 2, MODULE_LPC, 0)

/* LPC LRESET# GPIO_0064/LRESET#
 * Function 1, Bank 1 bit[20] */
ALTERNATE(PIN_MASK(1, 0x100000), 1, MODULE_LPC, GPIO_PULL_UP)

/* !!! PORTED TO MEC1701H !!! */
/* LED0 - GPIO_0156 Func1 Bank 3 bit[14]
 * LED1 - GPIO_0157 Func1 Bank 3 bit[15]
 */
ALTERNATE(PIN_MASK(3, 0xc000), 1, MODULE_POWER_LED, 0)
