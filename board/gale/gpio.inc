/* Copyright 2016 The Chromium OS Authors. All rights reserved.
 * Use of this source code is governed by a BSD-style license that can be
 * found in the LICENSE file.
 */

/* Interrupts */

/* PD, USBC */
GPIO(USB_CC1_PD,       PIN(A, 1),  GPIO_ANALOG)
GPIO(USB_CC2_PD,       PIN(A, 3),  GPIO_ANALOG)
GPIO(USB_CC1_TX_DATA,  PIN(B, 4),  GPIO_INPUT)
GPIO(USB_CC2_TX_DATA,  PIN(A, 6),  GPIO_INPUT)
GPIO(USB_CC_POLARITY,  PIN(B, 2),  GPIO_OUT_LOW)

GPIO(USB_SS_MUX_EN_L,  PIN(C, 15), GPIO_OUT_LOW)

/* Input controls */
GPIO(USB_VBUS_DETECT,  PIN(B, 0),  GPIO_ANALOG)
GPIO(IN_CURRENT_SENSE, PIN(B, 1),  GPIO_ANALOG)
GPIO(WP_L,             PIN(B, 11), GPIO_INPUT)

/* Voltage controls */
GPIO(VDD_3P3_EN,       PIN(A, 0),  GPIO_OUT_LOW)
GPIO(VDD_3P3_2G_EN,    PIN(A, 2),  GPIO_OUT_LOW)
GPIO(VDD_1P35_EN,      PIN(A, 5),  GPIO_OUT_LOW)
GPIO(VDD_1P1_CPU_EN,   PIN(F, 0),  GPIO_OUT_LOW)
GPIO(VDD_1P8_EN,       PIN(A, 8),  GPIO_OUT_LOW)
GPIO(SYS_PWR_EN,       PIN(B, 10), GPIO_OUT_HIGH)

/* Other controls */
GPIO(ERROR_LED,        PIN(B, 5),  GPIO_OUT_LOW)
GPIO(ENTERING_REC,     PIN(C, 13), GPIO_INPUT)
GPIO(MCU_INT_L,        PIN(C, 14), GPIO_OUT_HIGH)
GPIO(ENTERING_DEV,     PIN(F, 1),  GPIO_INPUT)

GPIO(SPI_FLASH_NSS,    PIN(B, 12), GPIO_INPUT)

/* Case closed debugging - SPI FLASH */
GPIO(SPI_FLASH_SCK,    PIN(B, 13), GPIO_INPUT)
GPIO(SPI_FLASH_MISO,   PIN(B, 14), GPIO_INPUT)
GPIO(SPI_FLASH_MOSI,   PIN(B, 15), GPIO_INPUT)

/* USB */
GPIO(USB_DM,           PIN(A, 11), GPIO_ANALOG)
GPIO(USB_DP,           PIN(A, 12), GPIO_ANALOG)

/*
 * I2C pins should be configured as input until I2C module is
 * initialized.
 */
GPIO(SLAVE_I2C_SCL,    PIN(B, 6),  GPIO_INPUT)
GPIO(SLAVE_I2C_SDA,    PIN(B, 7),  GPIO_INPUT)

/* Unimplemented controls */
UNIMPLEMENTED(ENTERING_RW)
UNIMPLEMENTED(PD_DISABLE_DEBUG)

/* Alternate functions */
#if 0
GPIO(UART_TX,          PIN(A, 9), GPIO_OUT_HIGH)
GPIO(UART_RX,          PIN(A, 10), GPIO_INPUT)
GPIO(AP_UART_TX,       PIN(A, 14), GPIO_INPUT)
GPIO(AP_UART_RX,       PIN(A, 15), GPIO_INPUT)
#endif


ALTERNATE(PIN_MASK(B, 0x0008), 0, MODULE_USB_PD, 0) /* SPI1: PB3(CLKIN) */
ALTERNATE(PIN_MASK(B, 0x0100), 2, MODULE_USB_PD, 0) /* TIM16_CH1: PB8(CLKOUT) */
ALTERNATE(PIN_MASK(A, 0x0600), 1, MODULE_UART,   0) /* USART1: PA9/10 */
ALTERNATE(PIN_MASK(B, 0x00c0), 1, MODULE_I2C,    0) /* I2C SLAVE: PB6/7 */
ALTERNATE(PIN_MASK(B, 0xe000), 0, MODULE_SPI_FLASH, GPIO_PULL_DOWN) /* SPI2: 13/14/15 */
ALTERNATE(PIN_MASK(A, 0x1800), 6, MODULE_USB,    0) /* USB: PA11/12 */
ALTERNATE(PIN_MASK(A, 0xc000), 1, MODULE_USART,  0) /* USART2: PA14/15 */
