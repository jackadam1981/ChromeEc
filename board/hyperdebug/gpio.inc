/* -*- mode:c -*-
 *
 * Copyright 2021 The Chromium OS Authors. All rights reserved.
 * Use of this source code is governed by a BSD-style license that can be
 * found in the LICENSE file.
 */

/* Outputs */
GPIO(NUCLEO_LED1,		PIN(C, 7), GPIO_OUT_HIGH) /* Green */
GPIO(NUCLEO_LED2,		PIN(B, 7), GPIO_OUT_LOW) /* Blue */
GPIO(NUCLEO_LED3,		PIN(A, 9), GPIO_OUT_LOW) /* Red */

/* GPIO */
GPIO(CC1,			PIN(A, 4), GPIO_ANALOG)
GPIO(CC2,			PIN(A, 5), GPIO_ANALOG)

/* UART: A0, A1 */
GPIO(IOA2,			PIN(G, 1), GPIO_INPUT)
GPIO(IOA3,			PIN(G, 0), GPIO_INPUT)
/* UART A4, A5 */
GPIO(IOA6,			PIN(G, 15), GPIO_INPUT)
/* I2C: A7, A8 */

/* SPI device: B0, B1, B2, B3 */
/* UART B4, B5 */
GPIO(IOB6,			PIN(C, 13), GPIO_INPUT)
GPIO(IOB7,			PIN(C, 14), GPIO_INPUT)
GPIO(IOB8,			PIN(C, 15), GPIO_INPUT)
/* I2C: B10, B9 */
/* I2C: B11, B12 */

/*
 * Disabled, as they currently conflict with LED2 and LED3.
 * GPIO(IOC0,			PIN(C, 7), GPIO_INPUT)
 * GPIO(IOC1,			PIN(A, 9), GPIO_INPUT)
 */
GPIO(IOC2,			PIN(A, 8), GPIO_INPUT)
/* UART: C3, C4 */
GPIO(IOC5,			PIN(E, 4), GPIO_INPUT)
GPIO(IOC6,			PIN(B, 1), GPIO_INPUT)
GPIO(IOC7,			PIN(C, 9), GPIO_INPUT)
GPIO(IOC9,			PIN(E, 5), GPIO_INPUT)
GPIO(IOC10,			PIN(F, 2), GPIO_INPUT)
GPIO(IOC11,			PIN(F, 8), GPIO_INPUT)
GPIO(IOC12,			PIN(F, 9), GPIO_INPUT)

GPIO(IOR0,			PIN(C, 8), GPIO_INPUT)
GPIO(IOR1,			PIN(C, 6), GPIO_INPUT)
GPIO(IOR2,			PIN(B, 2), GPIO_INPUT)
GPIO(IOR3,			PIN(F, 5), GPIO_INPUT)
GPIO(IOR4,			PIN(F, 4), GPIO_INPUT)
GPIO(IOR5,			PIN(E, 8), GPIO_INPUT)
GPIO(IOR6,			PIN(F, 10), GPIO_INPUT)
GPIO(IOR7,			PIN(E, 7), GPIO_INPUT)
GPIO(IOR8,			PIN(D, 14), GPIO_INPUT)
GPIO(IOR9,			PIN(D, 15), GPIO_INPUT)
GPIO(IOR10,			PIN(E, 9), GPIO_INPUT)
GPIO(IOR11,			PIN(F, 3), GPIO_INPUT)
GPIO(IOR12,			PIN(F, 11), GPIO_INPUT)
GPIO(IOR13,			PIN(E, 0), GPIO_INPUT)

GPIO(POR_N,			PIN(E, 1), GPIO_INPUT)

GPIO(QSPI_DEV_CLK,		PIN(E, 10), GPIO_INPUT)
GPIO(QSPI_DEV_CS_L,		PIN(E, 11), GPIO_INPUT)
GPIO(QSPI_DEV_D0,		PIN(E, 12), GPIO_INPUT)
GPIO(QSPI_DEV_D1,		PIN(E, 13), GPIO_INPUT)
GPIO(QSPI_DEV_D2,		PIN(E, 14), GPIO_INPUT)
GPIO(QSPI_DEV_D3,		PIN(E, 15), GPIO_INPUT)

/* I2C pins should be configured as inputs until I2C module is    */
/* initialized. This will avoid driving the lines unintentionally.*/
GPIO(TPM_I2C1_HOST_SCL,		PIN(G, 14), GPIO_INPUT)
GPIO(TPM_I2C1_HOST_SDA,		PIN(G, 13), GPIO_INPUT)
GPIO(INA_I2C2_DEV_SCL,		PIN(B, 13), GPIO_INPUT)
GPIO(INA_I2C2_DEV_SDA,		PIN(B, 14), GPIO_INPUT)

/* These pins are used for USART and are set to alternate mode below */
GPIO(USART1_AP_TX,              PIN(G, 9),  GPIO_INPUT)
GPIO(USART1_AP_RX,              PIN(G, 10), GPIO_INPUT)
GPIO(USART2_OT_RX_HYPER_TX,     PIN(A, 2),  GPIO_INPUT)
GPIO(USART2_OT_TX_HYPER_RX,     PIN(A, 3),  GPIO_INPUT)
GPIO(USART3_HYPER_TX,           PIN(D, 8),  GPIO_INPUT)
GPIO(USART3_HYPER_RX,           PIN(D, 9),  GPIO_INPUT)
GPIO(USART4_EC_TX,              PIN(A, 0),  GPIO_INPUT)
GPIO(USART4_EC_RX,              PIN(A, 1),  GPIO_INPUT)
GPIO(LPUART1_FP_MCU_RX,         PIN(G, 7),  GPIO_INPUT)
GPIO(LPUART1_FP_MCU_TX,         PIN(G, 8),  GPIO_INPUT)

/* USB pins */
GPIO(USB_FS_DM,			PIN(A, 11), GPIO_ALTERNATE)
GPIO(USB_FS_DP,			PIN(A, 12), GPIO_ALTERNATE)

/* Unimplemented signals since we are not an EC */
UNIMPLEMENTED(ENTERING_RW)
UNIMPLEMENTED(WP_L)
ALTERNATE(PIN_MASK(G, 0x0600), 7, MODULE_UART, 0) /* USART1: PG09/PG10 - AP UART */
ALTERNATE(PIN_MASK(A, 0x000C), 7, MODULE_UART, 0) /* USART2: PA02/PA03 - OT UART */
ALTERNATE(PIN_MASK(D, 0x0300), 7, MODULE_UART, 0) /* USART3: PD08/PD09 - HyperDebug console */
ALTERNATE(PIN_MASK(A, 0x0003), 8, MODULE_UART, 0) /* USART4: PA00/PA01 - EC UART */
ALTERNATE(PIN_MASK(G, 0x0180), 8, MODULE_UART, 0) /* LPUART1: PA07/PA08 - FP MCU UART */
ALTERNATE(PIN_MASK(A, 0x1800), 10, MODULE_USB, 0) /* USB: PA11/12 */
ALTERNATE(PIN_MASK(B, 0x6000), 4, MODULE_I2C, 0) /* I2C2: PB13/14 */
ALTERNATE(PIN_MASK(G, 0x6000), 4, MODULE_I2C, 0) /* I2C1: PG13/14 */
ALTERNATE(PIN_MASK(C, 0x0003), 4, MODULE_I2C, 0) /* I2C3: PC00/01 */
ALTERNATE(PIN_MASK(E, 0xFC00), 10, MODULE_SPI_FLASH, 0) /* QSPI: PE10-15 */
ALTERNATE(PIN_MASK(D, 0x0001), 5, MODULE_SPI, 0) /* SPI2: PD00 CS */
ALTERNATE(PIN_MASK(D, 0x0008), 3, MODULE_SPI, 0) /* SPI2: PD03 SCK */
ALTERNATE(PIN_MASK(C, 0x000C), 4, MODULE_SPI, 0) /* SPI2: PC02/03 CIDO/DOCI */
