/* -*- mode:c -*-
 *
 * Copyright 2021 The ChromiumOS Authors
 * Use of this source code is governed by a BSD-style license that can be
 * found in the LICENSE file.
 */

IOEX(DG_SPARE8, EXPIN(IOEX_PCA9535, PCA9535_PORT1, PCA9535_IO_PIN7),
     GPIO_OUT_LOW)
IOEX(DG_SPARE7, EXPIN(IOEX_PCA9535, PCA9535_PORT1, PCA9535_IO_PIN6),
     GPIO_OUT_LOW)
IOEX(DG_SPARE6, EXPIN(IOEX_PCA9535, PCA9535_PORT1, PCA9535_IO_PIN5),
     GPIO_OUT_LOW)
IOEX(DG_SPARE5, EXPIN(IOEX_PCA9535, PCA9535_PORT1, PCA9535_IO_PIN4),
     GPIO_OUT_LOW)
IOEX(DG_SPARE4, EXPIN(IOEX_PCA9535, PCA9535_PORT1, PCA9535_IO_PIN3),
     GPIO_OUT_LOW)
IOEX(DG_SPARE3, EXPIN(IOEX_PCA9535, PCA9535_PORT1, PCA9535_IO_PIN2),
     GPIO_OUT_LOW)
IOEX(DG_SPARE0, EXPIN(IOEX_PCA9535, PCA9535_PORT1, PCA9535_IO_PIN1),
     GPIO_OUT_LOW)
IOEX(EPR_EN_STRAP_PORTA, EXPIN(IOEX_PCA9535, PCA9535_PORT1, PCA9535_IO_PIN0),
     GPIO_OUT_LOW)

IOEX(DG_ERROR_LED_PA_PB, EXPIN(IOEX_PCA9535, PCA9535_PORT0, PCA9535_IO_PIN7),
     GPIO_OUT_LOW)
IOEX(DG_PD_APP_MODE_LED, EXPIN(IOEX_PCA9535, PCA9535_PORT0, PCA9535_IO_PIN6),
     GPIO_OUT_LOW)
IOEX(SINK_EN_LED_PB, EXPIN(IOEX_PCA9535, PCA9535_PORT0, PCA9535_IO_PIN5),
     GPIO_OUT_LOW)
IOEX(SINK_EN_LED_PA, EXPIN(IOEX_PCA9535, PCA9535_PORT0, PCA9535_IO_PIN4),
     GPIO_OUT_LOW)
IOEX(DG_1V8_3V3_SEL, EXPIN(IOEX_PCA9535, PCA9535_PORT0, PCA9535_IO_PIN3),
     GPIO_OUT_LOW)
IOEX(DG_PLATFORM_IND3, EXPIN(IOEX_PCA9535, PCA9535_PORT0, PCA9535_IO_PIN2),
     GPIO_OUT_LOW)
IOEX(DG_PLATFORM_IND2, EXPIN(IOEX_PCA9535, PCA9535_PORT0, PCA9535_IO_PIN1),
     GPIO_OUT_LOW)
IOEX(DG_PLATFORM_IND1, EXPIN(IOEX_PCA9535, PCA9535_PORT0, PCA9535_IO_PIN0),
     GPIO_OUT_LOW)

IOEX(USB_C0_BB_RETIMER_RST,	EXPIN(IOEX_C0_PCA9675, 0, PCA9675_IO_P00), GPIO_OUT_LOW)
IOEX(USB_C0_BB_RETIMER_LS_EN,	EXPIN(IOEX_C0_PCA9675, 0, PCA9675_IO_P01), GPIO_OUT_LOW)
IOEX(USB_C0_USB_MUX_CNTRL_1,	EXPIN(IOEX_C0_PCA9675, 0, PCA9675_IO_P04), GPIO_OUT_LOW)
IOEX(USB_C0_USB_MUX_CNTRL_0,	EXPIN(IOEX_C0_PCA9675, 0, PCA9675_IO_P05), GPIO_OUT_LOW)

IOEX(USB_C1_BB_RETIMER_RST,	EXPIN(IOEX_C1_PCA9675, 0, PCA9675_IO_P00), GPIO_OUT_LOW)
IOEX(USB_C1_BB_RETIMER_LS_EN,	EXPIN(IOEX_C1_PCA9675, 0, PCA9675_IO_P01), GPIO_OUT_LOW)
IOEX(USB_C1_HPD,		EXPIN(IOEX_C1_PCA9675, 0, PCA9675_IO_P02), GPIO_OUT_LOW)
IOEX(USB_C0_C1_OC,		EXPIN(IOEX_C1_PCA9675, 0, PCA9675_IO_P10), GPIO_OUT_HIGH)

#if defined(HAS_TASK_PD_C2)
IOEX(USB_C2_BB_RETIMER_RST,	EXPIN(IOEX_C2_PCA9675, 0, PCA9675_IO_P00), GPIO_OUT_LOW)
IOEX(USB_C2_BB_RETIMER_LS_EN,	EXPIN(IOEX_C2_PCA9675, 0, PCA9675_IO_P01), GPIO_OUT_LOW)
IOEX(USB_C2_USB_MUX_CNTRL_1,	EXPIN(IOEX_C2_PCA9675, 0, PCA9675_IO_P04), GPIO_OUT_LOW)
IOEX(USB_C2_USB_MUX_CNTRL_0,	EXPIN(IOEX_C2_PCA9675, 0, PCA9675_IO_P05), GPIO_OUT_LOW)

IOEX(USB_C3_BB_RETIMER_RST,	EXPIN(IOEX_C3_PCA9675, 0, PCA9675_IO_P00), GPIO_OUT_LOW)
IOEX(USB_C3_BB_RETIMER_LS_EN,	EXPIN(IOEX_C3_PCA9675, 0, PCA9675_IO_P01), GPIO_OUT_LOW)
IOEX(USB_C2_C3_OC,		EXPIN(IOEX_C3_PCA9675, 0, PCA9675_IO_P10), GPIO_OUT_HIGH)
#endif

/* ADL-RVP has custom GPIO implementation for reading board ID */
UNIMPLEMENTED(BOARD_VERSION1)
UNIMPLEMENTED(BOARD_VERSION2)
UNIMPLEMENTED(BOARD_VERSION3)
