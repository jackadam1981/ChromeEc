## common/Kconfig.hostcmd
```kconfig
config HOSTCMD_X86
	bool "EC supports x86 host communication"
	help
	  EC supports x86 host communication with AP. This can either be through LPC
	  or eSPI. The CONFIG_HOSTCMD_X86 will get automatically defined if either
	  CONFIG_HOSTCMD_LPC or CONFIG_HOSTCMD_ESPI are defined. LPC and eSPI are
	  mutually exclusive.

config HOSTCMD_LPC
	bool "Support host command interface over LPC bus"

config HOSTCMD_ESPI
	bool "Support host command interface over eSPI bus"

config HOSTCMD_ESPI_VW_SLP_SIGNALS
	bool "HOSTCMD_ESPI_VW_SLP_SIGNALS"
	depends on HOSTCMD_ESPI
	help
	  SLP signals (SLP_S3 and SLP_S4) use virtual wires intead of physical pins
	  with eSPI interface.

config HOSTCMD_FLASHPD
	bool "Flash commands over PD"
	default y

config HOSTCMD_LOCATE_CHIP
       bool "Enable EC_CMD_LOCATE_CHIP"
       default y

config HOSTCMD_RWHASHPD
	bool "Set entry in PD MCU's device rw_hash table"
	default y

config HOST_COMMAND_STATUS
	bool "HOST_COMMAND_STATUS"
	help
	  Support the host asking the EC about the status of the most recent host
	  command.

	  When the AP is attached to the EC via a serialized bus such as I2C or SPI,
	  it needs a way to minimize the length of time an EC command will tie up the
	  bus (and the kernel driver on the AP).  If this config is defined, the EC
	  may return an in-progress result code for slow commands such as flash
	  erase/write instead of stalling until the command finishes processing, and
	  the AP may then inquire the status of the current command and/or the result
	  of the previous command.

config HOST_EVENT64
	bool "Config option to support 64-bit hostevents and wake-masks"

config HOSTCMD_SECTION_SORTED
	bool "HOSTCMD_SECTION_SORTED"
	help
	  The host commands are sorted in the .rodata.hcmds section so use the binary
	  search algorithm to match a command to its handler

config HOSTCMD_ALIGNED
	bool "HOSTCMD_ALIGNED"
	help
	  Host command parameters and response are 32-bit aligned.  This generates
	  much more efficient code on ARM.

# should be selected by HAS_TASK_HOSTCMD

config HOSTCMD_EVENTS
	bool "HOSTCMD_EVENTS"

config HOSTCMD_BATTERY_V2
	bool "HOSTCMD_BATTERY_V2"
	depends on BATTERY_V2
	help
	  Include host commands to fetch battery information from
	  ec_response_battery_static/dynamic_info structures, only makes sense when
	  CONFIG_BATTERY_V2 is enabled.

config HOSTCMD_FLASH_SPI_INFO
	bool "HOSTCMD_FLASH_SPI_INFO"
	help
	  Board supports host command to get EC SPI flash info.  This is typically
	  only needed if the factory needs to determine which of several possible SPI
	  flash chips is attached to the EC on a given board.

config HOSTCMD_I2C_SLAVE_ADDR_FLAGS
       bool "HOSTCMD_I2C_SLAVE_ADDR_FLAGS"
       help
         For ECs where the host command interface is I2C, slave
	 address which the EC will respond to.

config HOSTCMD_SPS
	bool "Accept EC host commands over the SPI slave (SPS) interface"

config HOSTCMD_PD
	bool "PD MCU supports host commands"

config HOSTCMD_PD_CHG_CTRL
	bool "HOSTCMD_PD_CHG_CTRL"
	help
	  Use if PD MCU controls charging (selecting charging port and input
	  current limit).

config HOSTCMD_PD_PANIC
	bool "Panic when status of PD MCU reflects that it has crashed"

config HOSTCMD_RTC
	bool "Board supports RTC host commands"

config HOSTCMD_VBNV_CONTEXT
	bool "For access to VBNV on-EC battery-backed storage"

config HOSTCMD_SKUID
	bool "EC controls the board's SKU ID and can report that to the AP"

config HOSTCMD_AP_SET_SKUID
	bool "Set SKU ID from AP"

config HOSTCMD_AP_RESET
	bool "Command to issue AP reset"

config HOSTCMD_FLASHPD
	bool "Flash commands over PD"

config HOSTCMD_RWHASHPD
	bool "Set entry in PD MCU's device rw_hash table"

config SUPPRESSED_HOST_COMMANDS
	bool "List of host commands whose debug output will be suppressed"
```

## common/Kconfig.i2c
```kconfig
config I2C
	bool "Enable I2C support"

if I2C

config I2C_DEBUG
	bool "I2C_DEBUG"

config I2C_DEBUG_PASSTHRU
	bool "I2C_DEBUG_PASSTHRU"

config I2C_PASSTHROUGH
	bool "I2C_PASSTHROUGH"

config I2C_PASSTHRU_RESTRICTED
	bool "I2C_PASSTHRU_RESTRICTED"

config I2C_VIRTUAL_BATTERY
	bool "I2C_VIRTUAL_BATTERY"

config I2C_BUS_MAY_BE_UNPOWERED
	bool "I2C_BUS_MAY_BE_UNPOWERED"
	help
	  Define this option if an i2c bus may be unpowered at a certain point during
	  runtime.  An example could be, a sensor bus which is not needed in lower
	  power states so the power rail for those sensors is completely disabled.

	  If defined, your board must provide a board_is_i2c_port_powered() function.

config I2C_XFER_LARGE_READ
	bool "I2C_XFER_LARGE_READ"
	help
	  Enable i2c_xfer() for receiving request larger than
	  CONFIG_I2C_CHIP_MAX_READ_SIZE.

config I2C_XFER_BOARD_CALLBACK
	bool "I2C_XFER_BOARD_CALLBACK"
	help
	  If defined, makes i2c_xfer callback into board-provided functions before the
	  start and after the end of every I2C transaction. This can be used by boards
	  to implement any I2C device specific quirks e.g. requiring minimum bus-free
	  time between every I2C transaction with a device.

config I2C_MASTER
	bool "EC uses an I2C master interface"

config I2C_SLAVE
	bool "EC uses an I2C slave interface"

config I2C_MULTI_PORT_CONTROLLER
	bool "I2C multi-port controller"
	help
	  If CONFIG_I2C_MULTI_PORT_CONTROLLER is defined, a single on-chip I2C
	  controller may have multiple I2C ports attached. Therefore, I2c operations
	  must lock the controller (not just the port) to prevent hardware access
	  conflicts.

endif # I2C

# TODO: these should depend on I2C
#	(defined unconditionally in config.h).

config I2C_CHIP_MAX_READ_SIZE
	int "Conservative I2C reading size per single transaction"
	default 255
	help
	  Conservative I2C reading size per single transaction. For example, register
	  of stm32f0 and stm32l4 are limited to be 8 bits for this field.

config I2C_NACK_RETRY_COUNT
	int "Defines I2C operation retry count when slave nack'd(EC_ERROR_BUSY)"
	default 0

config I2C_EXTRA_PACKET_SIZE
	int "I2C_EXTRA_PACKET_SIZE"
	default 0
	help
	  Some chip supports two owned slave address. The second slave address is used
	  for other purpose such as board specific i2c commands. This option can be
	  set if user of the second slave address requires larger host packet buffer
	  size.
```

## common/Kconfig.keyboard
```kconfig
config MKBP_EVENT
	bool "Support MKBP event"

if MKBP_EVENT

config MKBP_USE_HOST_EVENT
	bool "MKBP events are sent by using host event"

config MKBP_USE_GPIO
	bool "MKBP events are sent by using GPIO"

config MKBP_USE_GPIO_AND_HOST_EVENT
	bool "MKBP events are notified by using both a GPIO and a host event"
	help
	  You should use this if you are using a GPIO to notify the AP of an MKBP
	  event, and you need an MKBP event to wake the AP in suspend and the AP cannot
	  wake from the GPIO.  Since you are using both a GPIO and a hostevent for the
	  notification, make sure that the S0 hostevent mask does NOT include MKBP
	  events.  Otherwise, you will have multiple consumers for a single event.
	  However, make sure to configure the host event *sleep* mask in coreboot to
	  include MKBP events.  In order to prevent all MKBP events from waking the AP,
	  use CONFIG_MKBP_EVENT_WAKEUP_MASK to filter the events.

endif # MKBP_EVENT

config HAVE_KEYBOARD
	bool
	select KEYBOARD__yn

config KEYBOARD__yn
	bool "Keyboard support"

if KEYBOARD__yn

config KEYBOARD_COL2_INVERTED
	bool "KEYBOARD_COL2_INVERTED"
	help
	  The Silego reset chip sits in between the EC and the physical keyboard on
	  column 2.  To save power in low-power modes, some Silego variants require
	  the signal to be inverted so that the open-drain output from the EC isn't
	  costing power due to the pull-up resistor in the Silego.

config KEYBOARD_REFRESH_ROW3
	bool "KEYBOARD_REFRESH_ROW3"
	help
	  Keyboards with the assistant key also move the refresh key matrix to row 3
	  instead of row 2.  This is used by the boot key detection code to determine
	  if the refresh key is held down at boot.

config KEYBOARD_KSO_BASE__yn
	bool "Select CONFIG_KEYBOARD_KSO_BASE"
	default y

config KEYBOARD_KSO_BASE
	int "KEYBOARD_KSO_BASE"
	default 0
	help
	  Config KSO to start from a different KSO pin. This is to allow some chips
	  to use alternate functions on KSO pins.

config KEYBOARD_PWRBTN_ASSERTS_KSI2
	bool "KEYBOARD_PWRBTN_ASSERTS_KSI2"
	help
	  For certain board configurations, KSI2 or KSI3 will be stuck asserted for all
	  scan columns if the power button is held. We must be aware of this case
	  in order to correctly handle recovery mode key combinations.

config KEYBOARD_PWRBTN_ASSERTS_KSI3
	bool "KEYBOARD_PWRBTN_ASSERTS_KSI3"
	help
	  For certain board configurations, KSI2 or KSI3 will be stuck asserted for all
	  scan columns if the power button is held. We must be aware of this case
	  in order to correctly handle recovery mode key combinations.

config KEYBOARD_DEBUG
	bool "Enable extra debugging output from keyboard modules"

config KEYBOARD_IRQ_GPIO
	bool "The board uses a negative edge-triggered GPIO for keyboard interrupts"



#choice
#	prompt "Keyboard protocol (select one)"
menu "Keyboard protocol (select one)"

config KEYBOARD_PROTOCOL_MKBP
	bool "Compile code for MKBP keyboard protocol"
	select MKBP_EVENT

config KEYBOARD_PROTOCOL_8042
	bool "Compile code for 8042 keyboard protocol"

#endchoice # keyboard protocol
endmenu # Keyboard protocol

config KEYBOARD_FACTORY_TEST
	bool "Support keyboard factory test scanning"

config KEYBOARD_BOARD_CONFIG
	bool "KEYBOARD_BOARD_CONFIG"
	help
	  Keyboard config (struct keyboard_scan_config) is in board.c.  If this is
	  not defined, default values from common/keyboard_scan.c will be used.

config KEYBOARD_BOOT_KEYS
	bool "KEYBOARD_BOOT_KEYS"
	default y
	help
	  Support for boot key combinations (e.g. refresh key being held on boot to
	  trigger recovery).

config KEYBOARD_ASSISTANT_KEY
	bool "Add support for the assistant key"

config KEYBOARD_TABLET_MODE_SWITCH
	bool "Add support for a switch that indicates if the device is in tablet mode"

config KEYBOARD_POST_SCAN_CLOCKS__yn
	bool "Select KEYBOARD_POST_SCAN_CLOCKS"
config KEYBOARD_POST_SCAN_CLOCKS
	int "KEYBOARD_POST_SCAN_CLOCKS"
	depends on KEYBOARD_POST_SCAN_CLOCKS__yn
	help
	  Minimum CPU clocks between scans.  This ensures that keyboard scanning
	  doesn't starve the other EC tasks of CPU when running at a decreased system
	  clock.

config KEYBOARD_PRINT_SCAN_TIMES
	bool "Print keyboard scan time intervals"

config KEYBOARD_RUNTIME_KEYS
	bool "Select KEYBOARD_RUNTIME_KEYS"
	default y if !BOARD_HAMMER
config KEYBOARD_RUNTIME_KEYS
	bool "KEYBOARD_RUNTIME_KEYS"
	help
	  Support for extra runtime key combinations (e.g. alt+volup+h/r for hibernate
	  and warm reboot, respectively).

config KEYBOARD_SCANCODE_MUTABLE
	bool "Allow the keyboard scan code set tables to be modified at runtime"


config KEYBOARD_SCANCODE_CALLBACK
	bool "Allow board-specific 8042 keyboard callback when a key state is changed"

config KEYBOARD_SUPPRESS_NOISE
	bool "KEYBOARD_SUPPRESS_NOISE"
	help
	  Call board-supplied keyboard_suppress_noise() function when the debounced
	  keyboard state changes.  Some boards use this to send a signal to the audio
	  codec to suppress typing noise picked up by the microphone.

config KEYBOARD_TEST
	bool "KEYBOARD_TEST"
	help
	  Enable keyboard testing functionality. This enables a message which receives
	  a list of keyscan events from the AP and processes them.  This will cause
	  keypresses to appear on the AP through the same mechanism as a normal
	  keyboard press.

	  This can be used to spoof keyboard events, so is not normally defined,
	  except during internal testing.

config KEYBOARD_KSO_HIGH_DRIVE
	bool "KEYBOARD_KSO_HIGH_DRIVE"
	help
	  Enable quasi-bidirectional buffers for KSO pins. It has an open-drain output
	  and a low-impedance pull-up. The low-impedance pull-up is active when ec
	  changes the output data buffers from 0 to 1, thereby reducing the
	  low-to-high transition time.

config KEYBOARD_LANGUAGE_ID
	bool "Add support for keyboards with language ID pins"

config KEYBOARD_KEYPAD
	bool "Enable keypad (a palm-sized keyboard section usually placed on the far right)"

config KEYBOARD_BACKLIGHT
	bool "Support keyboard backlight control"
	help
	  You need to define board_kblight_init unless PWM_KBLIGHT is used.
	  For example, lm3509 can be registered as a driver in board_kblight_init.

config PWM_KBLIGHT
	bool "Support PWM output to keyboard backlight"
	select PWM
	select KEYBOARD_BACKLIGHT
	help
	  You need to define board_kblight_init unless CONFIG_PWM_KBLIGHT is used.
	  For example, lm3509 can be registered as a driver in board_kblight_init.

endif # KEYBOARD__yn
```
