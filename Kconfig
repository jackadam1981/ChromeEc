## common/Kconfig.led
```kconfig
config LED_COMMON
	bool "Support common LED interface"
	default n

config LED_POLICY_STD
	bool "Standard LED behavior"
	default n
	help
	  Standard LED behavior according to spec given that we have a red-green
	  bicolor led for charging and one power led

config LED_PWM
	bool "Support common PWM-controlled LEDs"
	select PWM
	help
	  Support common PWM-controlled LEDs that conform to the Chrome OS LED
	  behaviour specification.

if LED_PWM

config LED_PWM_COUNT
	int "Number of PWM LEDs"
	range 0 2
	default 2
	help
	  How many PWM LEDs does the system have that will be controlled by the common
	  PWM LED policy?  Currently, this may be at most 2.

config LED_PWM_CHARGE_STATE_ONLY
	bool "LEDs only show charging state"
	help
	  By default the PWM LED behaviour is reflected on both LEDs and includes the
	  chipset state, battery state, as well as the charging state.  Enable
	  this CONFIG_* option to show only the charging state on the LEDs.

config LED_PWM_ACTIVE_CHARGE_PORT_ONLY
	bool "Only on charging port"
	depends on LED_PWM_CHARGE_STATE_ONLY
	help
	  By default the PWM LED behaviour is reflected on both LEDs and includes the
	  chipset state, battery state, as well as the charging state.  Enable
	  this CONFIG_* option to show only the charging state, and only on the LED of
	  the active charge port.

endif

config LED_ONOFF_STATES
	bool "Support GPIO-controlled LEDs"
	help
	  Support GPIO-controlled LEDs for common battery/power
	  states through a board-defined lookup table.

config LED_ONOFF_STATES_BAT_LOW__yn
	bool "Select battery charge percentage for ..."
	depends on LED_ONOFF_STATES

config LED_ONOFF_STATES_BAT_LOW
	int "charge percentage"
	range 0 100
	default 10
	depends on LED_ONOFF_STATES_BAT_LOW__yn
	help
	  Set the battery charge percentage for optional STATE_DISCHARGE_S0_BAT_LOW
	  provided by CONFIG_LED_ONOFF_STATES.

config LED_POWER_LED
	bool "Add a power LED"
	depends on LED_ONOFF_STATES
	help
	  Adds a power LED under the control of the board-defined lookup table.
	  Must be used with the CONFIG_LED_ONOFF_STATES option.

config LED_BAT_ACTIVE_LOW
	bool "LED_BAT_ACTIVE_LOW"
	depends on LED_POLICY_STD
	help
	  LEDs for LED_POLICY STD may be inverted.  In this case they are active low
	  and the GPIO names will be GPIO_LED..._L.

config LED_POWER_ACTIVE_LOW
	bool "LED_POWER_ACTIVE_LOW"
	depends on LED_POLICY_STD
	help
	  LEDs for LED_POLICY STD may be inverted.  In this case they are active low
	  and the GPIO names will be GPIO_LED..._L.

config BACKLIGHT_LID
	bool "Control the display backlight based on the state of the lid"
	help
	  Support controlling the display backlight based on the state of the lid
	  switch.  The EC will disable the backlight when the lid is closed.

	  The GPIO should be named GPIO_ENABLE_BACKLIGHT if active high, or
	  GPIO_ENABLE_BACKLIGHT_L if active low. See CONFIG_BACKLIGHT_LID_ACTIVE_LOW.

config BACKLIGHT_LID_ACTIVE_LOW
	bool "The backlight GPIO pin is active low and named GPIO_BACKLIGHT_ENABLED_L"

menu "Support for LED driver chips"

config LED_DRIVER_DS2413
	bool "Maxim DS2413, on one-wire interface"
config LED_DRIVER_LM3509
	bool "LM3509, on I2C interface"
config LED_DRIVER_LM3630A
	bool "LM3630A, on I2C interface"
config LED_DRIVER_LP5562
	bool "LP5562, on I2C interface"
config LED_DRIVER_OZ554
	bool "O2Micro OZ554, on I2C"

endmenu
```

## common/Kconfig.spi-flash
```kconfig
menu "SPI flash"

config SPI
	bool "Support SPI interfaces"

config SPI_FLASH
	bool "Support SPI flash (common implementation)"

config SPI_FLASH_REGS
	bool "Support SPI flash protection register translation"

#

config HAVE_SPI_FLASH_GD25LQ40
	bool
config HAVE_SPI_FLASH_GD25Q41B
	bool
config HAVE_SPI_FLASH_W25Q40
	bool
config HAVE_SPI_FLASH_W25Q64
	bool
config HAVE_SPI_FLASH_W25Q80
	bool
config HAVE_SPI_FLASH_W25Q128
	bool
config HAVE_SPI_FLASH_W25X40
	bool

choice # SPI flash chip
	prompt "Select SPI flash chip"

	default SPI_FLASH_GD25LQ40 if HAVE_SPI_FLASH_GD25LQ40
	default SPI_FLASH_GD25Q41B if HAVE_SPI_FLASH_GD25Q41B
	default SPI_FLASH_W25Q40   if HAVE_SPI_FLASH_W25Q40
	default SPI_FLASH_W25Q64   if HAVE_SPI_FLASH_W25Q64
	default SPI_FLASH_W25Q80   if HAVE_SPI_FLASH_W25Q80
	default SPI_FLASH_W25Q128  if HAVE_SPI_FLASH_W25Q128
	default SPI_FLASH_W25X40   if HAVE_SPI_FLASH_W25X40

	help
	  Select any of the following SPI flash configs that your board uses

config SPI_FLASH_GD25LQ40
	bool "GD25LQ40"
config SPI_FLASH_GD25Q41B
	bool "GD25Q41B"
config SPI_FLASH_W25Q40
	bool "W25Q40"
config SPI_FLASH_W25Q64
	bool "W25Q64"
config SPI_FLASH_W25Q80
	bool "W25Q80"
config SPI_FLASH_W25Q128
	bool "W25Q128"
config SPI_FLASH_W25X40
	bool "W25X40"

endchoice # SPI flash chip

if SPI || SPI_FLASH

config SPI_FLASH_PORT__yn
	bool "Select SPI_FLASH_PORT"
config SPI_FLASH_PORT
	int "Define the SPI port to use to access the flash"
	depends on SPI_FLASH_PORT__yn

config SPI_FLASH_HAS_SR2
	bool "SPI flash part supports SR2 register"

config SPI_NOR
	bool "Support JEDEC SFDP based Serial NOR flash"

config SPI_NOR_DEBUG
	bool "Enable SPI_NOR debugging"
	help
	  Enable SPI_NOR debugging providing additional console output while
	  initializing Serial NOR Flash devices including SFDP discovery. */

config SPI_NOR_MAX_MESSAGE_SIZE__yn
	bool "Select SPI_NOR_MAX_MESSAGE_SIZE"
config SPI_NOR_MAX_MESSAGE_SIZE
	int "Maximum Serial NOR flash command size, in Bytes"
	depends on SPI_NOR_MAX_MESSAGE_SIZE__yn

config SPI_NOR_MAX_READ_SIZE__yn
	bool "Select SPI_NOR_MAX_READ_SIZE"
config SPI_NOR_MAX_READ_SIZE
	int "Maximum Serial NOR flash read size, in Bytes"
	depends on SPI_NOR_MAX_READ_SIZE__yn

config SPI_NOR_MAX_WRITE_SIZE__yn
	bool "SPI_NOR_MAX_WRITE_SIZE"
config SPI_NOR_MAX_WRITE_SIZE
	int "Maximum Serial NOR flash write size, in bytes. Note this must be a power of two"
	depends on SPI_NOR_MAX_WRITE_SIZE__yn

config SPI_NOR_BLOCK_ERASE
	bool "If defined will enable block (64KiB) erase operations"

config SPI_NOR_SMART_ERASE
	bool "read the sector/block to be erased first"
	help
	  If defined will read the sector/block to be erased first and only initiate
	  the erase operation if not already in an erased state. The read operation
	  (performed in CONFIG_SPI_NOR_MAX_READ_SIZE chunks) is aborted early if a
	  non "0xff" byte is encountered.
	  !! Make sure there is enough stack space to host a
	  !! CONFIG_SPI_NOR_MAX_READ_SIZE sized buffer before enabling.

endif # SPI || SPI_FLASH

endmenu # SPI flash
```

## common/Kconfig.temp
```kconfig
# Temperature sensor config */

config TEMP_SENSOR
	bool "Compile common code for temperature sensor support"

if TEMP_SENSOR

menu "Support particular temperature sensor chips"

config TEMP_SENSOR_ADT7481
	bool "ADT 7481 sensor, on I2C bus"
config TEMP_SENSOR_BD99992GW
	bool "BD99992GW PMIC, on I2C bus"
config TEMP_SENSOR_EC_ADC
	bool "Thermistors on EC's own ADC"
config TEMP_SENSOR_G781
	bool "G781 sensor, on I2C bus"
config TEMP_SENSOR_G782
	bool "G782 sensor, on I2C bus"
config TEMP_SENSOR_SB_TSI
	bool "SB_TSI sensor, on I2C bus"
config TEMP_SENSOR_TMP006
	bool "TI TMP006 sensor, on I2C bus"
config TEMP_SENSOR_TMP411
	bool "TI TMP411 sensor, on I2C bus"
config TEMP_SENSOR_TMP432
	bool "TI TMP432 sensor, on I2C bus"
config TEMP_SENSOR_TMP468
	bool "TI TMP468 sensor, on I2C bus"
config TEMP_SENSOR_F75303
	bool "Fintek  F75303 sensor, on I2C bus"

endmenu

config TEMP_SENSOR_POWER_GPIO
	bool "TEMP_SENSOR_POWER_GPIO"
	help
	  If defined, active-high GPIO which indicates temperature sensor chips are
	  powered.  If not defined, temperature sensors are assumed to be always
	  powered.

config THROTTLE_AP
	bool "Compile common code for throttling the CPU based on the temp sensors"
	help
	  Thermal throttling AP must have temperature sensor enabled to get
	  the temperature readings.

config DPTF
	bool "Enable DPTF to manage thermals"
	help
	  If defined, DPTF is enabled to manage thermals.

	  NOTE: This doesn't mean that thermal control is completely taken care by
	  DPTF. We have some hybrid solutions where the EC still manages the fans.

	  DPTF must have temperature sensor enabled to get the readings for
	  generating DPTF thresholds events.

endif # TEMP_SENSOR
```

## common/Kconfig.usb
```kconfig
menu "USB Setup"

config USB_CONSOLE
	bool "Enable USB serial console module"

config USB_CONSOLE_TX_BUF_SIZE
	int "USB serial console transmit buffer size in bytes"
	default 2048
#	depends on USB_CONSOLE

config USB_CONSOLE_CRC
	bool "Enable USB serial console crc32 computation"
	help
	  Also makes console output block on overrun.

config USB_HID
	bool "Support USB HID interface"

config USB_HID_KEYBOARD
	bool "Support USB HID keyboard interface"

config USB_HID_KEYBOARD_BACKLIGHT
	bool "Support USB HID keyboard backlight"

config USB_HID_TOUCHPAD
	bool "Support USB HID touchpad interface"

config USB_INHIBIT_CONNECT
	bool "Disable automatic connection of USB peripheral"

config USB_INHIBIT_INIT
	bool "Disable automatic initialization of USB peripheral"

config USB_SELECT_PHY
	bool "Support control of multiple PHY"

config USB_PORT_POWER_DUMB
	bool "Support simple control of power to the device's USB ports"

config USB_PORT_POWER_SMART
	bool "Support smart power control to the device's USB ports"
	help
	  Support smart power control to the device's USB ports, using
	  dedicated power control chips.  This potentially enables automatic
	  negotiation of supplying more power to peripherals.

config USB_PORT_POWER_SMART_CDP_SDP_ONLY
	bool "USB_PORT_POWER_SMART_CDP_SDP_ONLY"
	help
	  Support smart power control to the device's USB ports, however only CDP and
	  SDP are supported.  Usually this is the case if all the control lines to the
	  charging port controller are hard-wired.

config USB_PORT_POWER_SMART_SIMPLE
	bool "USB_PORT_POWER_SMART_SIMPLE"
	help
	  Smart USB power control can use a full set of control signals to the USB
	  port power chip, or a reduced set.  If this is defined, use the reduced set.

config USB_PORT_POWER_SMART_PORT_COUNT
	int "Number of smart USB power ports"
	default 2

config USB_PORT_POWER_SMART_INVERTED
	bool "USB_PORT_POWER_SMART_INVERTED"
	help
	  Smart USB power control current limit pins may be inverted.  In this case
	  they are active low and the GPIO names will be GPIO_USBn_ILIM_SEL_L.

config USB_REMOTE_WAKEUP
	bool "USB_REMOTE_WAKEUP"
	help
	  Support waking up host by setting the K-state on the data lines (requires
	  CONFIG_USB_SUSPEND to be set as well).

config USB_SERIALNO
	bool "Support programmable USB device iSerial field"

config USB_MAXPOWER_MA
	int "Support reporting of configuration bMaxPower in mA"
	default 500

config USB_SELF_POWERED
	bool "Support reporting as self powered in USB configuration"

config USB_SUSPEND
	bool "Support correct handling of USB suspend (host-initiated)"

config USB_DWC_FS
	bool "Set USB speed to FS rather than HS"

config USB_MUX_IT5205
	bool "Support the ITE IT5205 Type-C USB alternate mode mux"

config USB_MUX_PI3USB30532
	bool "Support the Pericom PI3USB30532 USB3.0/DP1.2 Matrix Switch"

config USB_MUX_PS8740
	bool "Support the Parade PS8740 Type-C Redriving Switch"

config USB_MUX_PS8743
	bool "Support the Parade PS8743 Type-C Redriving Switch"

config USB_MUX_VIRTUAL
	bool "'Virtual' USB mux under host (not EC) control"

config USB_GPIO
	bool "USB GPIO config"

config USB_SPI
	bool "USB SPI config"

config USB_I2C
	bool "USB I2C config"

config USB_I2C_MAX_WRITE_COUNT
	int "Allowed write count for USB over I2C"
	default 60

config USB_I2C_MAX_READ_COUNT
	int "Allowed read count for USB over I2C"
	default 60

config USB_POWER
	bool "USB Power monitoring interface config"

config STREAM_SIGNATURE
	bool "STREAM_SIGNATURE"
	help
	  USB stream signing config. This allows data read over UART or SPI
	  to have a signature generated that can be used to validate the data
	  offline based on H1's registered key. Used by mn50.

endmenu # USB Setup

menu "USB Type-C Setup"

config USBC_PPC_POLARITY
	bool "PPC needs to be informed of CC polarity"

config USBC_DISABLE_CHARGE_FROM_RP_DEF
       	bool "Disable charging from Default(USB) Rp"
	help
	  Disable charging from Default(USB) Rp as a type-c supplier. If your device
	  can detect such a supplier by BC 1.2, define this to get more current
	  from a BC 1.2 supplier.

config USBC_SS_MUX
	bool "Support for USB type-c superspeed mux"

config USBC_SS_MUX_DFP_ONLY
	bool "Only configure USB type-c superspeed mux when DFP"
	depends on USBC_SS_MUX
	help
	  Only configure USB type-c superspeed mux when DFP (for chipsets that
	  don't support being a UFP)

config USBC_BACKWARDS_COMPATIBLE_DFP
	bool "Support v1.1 type-C connection state machine"

config USBC_VCONN
	bool "Support for USB type-c vconn. Not needed for captive cables"

config USBC_VCONN_SWAP
	bool "Support VCONN swap"
	depends on USBC_VCONN

config USB_SM_FRAMEWORK
	bool "Use Power Delivery State Machine Framework"
	help
	  Define to use Power Delivery State Machine Framework. Along with
	  CONFIG_USB_SM_FRAMEWORK, you must ensure the follow options are defined to
	  use the new statemachine for USB-C:

	  CONFIG_USB_TYPEC_SM (defined by default)
	  CONFIG_USB_PRL_SM (defined by default)
	  One of CONFIG_USB_PE_* policy engine options.

config USB_TYPEC_SM
	bool "Enable Type-C State Machine"
	default y
	help
	  Define to enable Type-C State Machine. Must be enabled
	  with CONFIG_USB_SM_FRAMEWORK

config USB_PRL_SM
	bool "Enable Protocol Layer State Machine"
	default y
	help
	  Define to enable Protocol Layer State Machine. Must be enabled
	  with CONFIG_USB_SM_FRAMEWORK and CONFIG_USB_TYPEC_SM

config USB_PE_SM
	bool "Enable Policy Engine State Machine"
	default y
	help
	  Define to enable Policy Engine State Machine. Must be enabled
	  with CONFIG_USB_SM_FRAMEWORK and CONFIG_USB_TYPEC_SM

endmenu

config USBC_PPC
	bool "Board has a USB Type-C Power Path Controller"

if USBC_PPC

menu "USB Type-C Power Path Controllers (PPC)"

config USBC_PPC_NX20P3481
	bool "NX20P3481"
config USBC_PPC_NX20P3483
	bool "NX20P3483"
config USBC_PPC_SN5S330
	bool "SN5S330"
config USBC_PPC_SYV682X
	bool "SYV682X"

endmenu # PPC

config USBC_PPC_SBU
	bool "PPC is capable of gating the SBU lines"

config USBC_PPC_VCONN
	bool "PPC is capable of providing VCONN"

config USBC_PPC_DEDICATED_INT
	bool "PPC has level interrupts and has a dedicated interrupt pin to check"

endif # USBC_PPC
```
