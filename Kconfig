## board/atlas/Kconfig
```kconfig
config BOARD_ATLAS__yn
	select HAVE_CHIP_NPCX_NPCX7
	select HIBERNATE_PSL
	select ADC
	select FPU
	select MPU
	select RTC
	select SWITCH
	select CHIP_PANIC_BACKUP
	select WATCHDOG_HELP

	select SPI_FLASH_REGS
	select HAVE_SPI_FLASH_W25Q80
	select FLASH_PSTATE_BANK

	select HAVE_CHIPSET_SKYLAKE
	select CHIPSET_HAS_PLATFORM_PMIC_RESET
	select CHIPSET_RESET_HOOK
	select CPU_PROCHOT_ACTIVE_LOW
	select POWER_S0IX

	select ACCEL_FIFO
	select ACCEL_INTERRUPTS
	select SENSOR_TIGHT_TIMESTAMPS

	select HAVE_ALS_OPT3001

	select TEMP_SENSOR
	select TEMP_SENSOR_BD99992GW
	select DPTF
	select HAVE_THERMISTOR_NCP15WB

	select HAVE_BATTERY_SMART
	select HAVE_BATTERY_DEVICE_CHEMISTRY_LION
	select PWR_STATE_DISCHARGE_FULL
	select BATTERY_CUT_OFF
	select BATTERY_HW_PRESENT_CUSTOM
	select BATTERY_PRESENT_CUSTOM
	select BATTERY_REQUESTS_NIL_WHEN_DEAD

#	select BOARD_VERSION
	select HAVE_BOARD_VERSION_CUSTOM

	select BOARD_FORCE_RESET_PIN

	select I2C
	select I2C_MASTER
	select I2C_MULTI_PORT_CONTROLLER

	select HAVE_KEYBOARD
	select KEYBOARD_BOARD_CONFIG
	select KEYBOARD_COL2_INVERTED
	select KEYBOARD_PROTOCOL_8042
	select KEYBOARD_REFRESH_ROW3
	select PWM_KBLIGHT
	select MKBP_EVENT
	select MKBP_USE_HOST_EVENT

	select LED_COMMON
	select LED_PWM
	select LED_PWM_CHARGE_STATE_ONLY
	select LED_PWM_ACTIVE_CHARGE_PORT_ONLY

	select POWER_BUTTON
	select POWER_BUTTON_X86
	select EXTPOWER_GPIO
	select POWER_TRACK_HOST_SLEEP_STATE

	select USBC_SS_MUX
	select USBC_SS_MUX_DFP_ONLY
	select USBC_VCONN
	select USBC_VCONN_SWAP

	select USB_POWER_DELIVERY
	select USB_PD_ALT_MODE
	select USB_PD_ALT_MODE_DFP
	select USB_PD_COMM_LOCKED
	select USB_PD_DISCHARGE_TCPC
	select USB_PD_DUAL_ROLE
	select USB_PD_DUAL_ROLE_AUTO_TOGGLE
	select USB_PD_LOGGING
	select USB_PD_TCPC_LOW_POWER
	select USB_PD_TCPM_TCPCI
	select USB_PD_TCPM_PS8751
	select USB_PD_TCPM_MUX
	select HAVE_USB_PD_VBUS_DETECT_TCPC
	select USB_PD_VBUS_MEASURE_NOT_PRESENT
	select USB_PD_TRY_SRC

	select LID_SWITCH
	select LOW_POWER_IDLE

	select CHARGER
	select CHARGER_V2
	select CHARGER_ISL9238
	select HAVE_CHARGER_ISL9238
	select CHARGER_PSYS_READ
	select CHARGER_DISCHARGE_ON_AC
	select CHARGER_PROFILE_OVERRIDE

	select CHARGE_MANAGER
	select CHARGE_MANAGER_EXTERNAL_POWER_LIMIT

	select VBOOT_HASH
	select VSTORE

	select CMD_ACCEL_INFO
	select CMD_ACCELS
	select CMD_BATT_MFG_ACCESS
	select CMD_CHARGER_ADC_AMON_BMON
	select CMD_PD_CONTROL

	select HOSTCMD_ESPI
	select HOSTCMD_ESPI_VW_SLP_SIGNALS
	select HOSTCMD_EVENTS
	select HOSTCMD_X86

	select LTO
	select SHA256_UNROLLED
	select SOFTWARE_PANIC

# these are implied:
#	select PWM

if BOARD_ATLAS__yn

config CHARGER_SENSE_RESISTOR_AC
	default 20

config CHARGER_SENSE_RESISTOR
	default 10

config USB_PD_PORT_COUNT
	default 2

config USB_PD_TRY_SRC_MIN_BATT_SOC
	default 2

config VSTORE_SLOT_COUNT
	default 1

config CHARGER_MIN_POWER_MW_FOR_POWER_ON
	default 15000

config CHARGER_INPUT_CURRENT
	default 512

config BATTERY_LEVEL_NEAR_FULL
	default 95

config ACCEL_FIFO_SIZE
	default 1024

config CHARGER_MIN_BAT_PCT_FOR_POWER_ON
	default 2

config POWER_SIGNAL_INTERRUPT_STORM_DETECT_THRESHOLD
	default 30

endif # BOARD_ATLAS__yn
```

## board/nocturne/Kconfig
```kconfig
config BOARD_NOCTURNE__yn
	select ADC
#	select ALS
#	select ALS_OPT3001
	select BATTERY_SMART
	select BOARD_VERSION_CUSTOM
	select BOARD_FORCE_RESET_PIN
	select CHIP_PANIC_BACKUP
	select DPTF
	select FPU
	select I2C
	select I2C_MASTER
	select KEYBOARD__yn
	select LID_SWITCH
	select LOW_POWER_IDLE
	select LTO
#	select PWM
#	select PWM_KBLIGHT
	select SHA256_UNROLLED
	select SOFTWARE_PANIC
```

## chip/Kconfig
```kconfig
config HAVE_CHIP_G
	bool
config HAVE_CHIP_HOST
	bool
config HAVE_CHIP_ISH
	bool
config HAVE_CHIP_IT83XX
	bool
config HAVE_CHIP_LM4
	bool
config HAVE_CHIP_MAX32660
	bool
config HAVE_CHIP_MCHP
	bool
config HAVE_CHIP_MEC1322
	bool
config HAVE_CHIP_MT_SCP
	bool
config HAVE_CHIP_NPCX
	bool
config HAVE_CHIP_NRF51
	bool
config HAVE_CHIP_STM32
	bool

choice # CHIP
	prompt "EC chip"

	default CHIP_G__yn        if HAVE_CHIP_G
	default CHIP_HOST__yn     if HAVE_CHIP_HOST
	default CHIP_ISH__yn      if HAVE_CHIP_ISH
	default CHIP_IT83XX__yn   if HAVE_CHIP_IT83XX
	default CHIP_LM4__yn      if HAVE_CHIP_LM4
	default CHIP_MAX32660__yn if HAVE_CHIP_MAX32660
	default CHIP_MCHP__yn     if HAVE_CHIP_MCHP
	default CHIP_MEC1322__yn  if HAVE_CHIP_MEC1322
	default CHIP_MT_SCP__yn   if HAVE_CHIP_MT_SCP
	default CHIP_NPCX__yn     if HAVE_CHIP_NPCX
	default CHIP_NRF51__yn    if HAVE_CHIP_NRF51
	default CHIP_STM32__yn    if HAVE_CHIP_STM32

config CHIP_G__yn
	bool "g"
config CHIP_HOST__yn
	bool "host"
config CHIP_ISH__yn
	bool "ish"
config CHIP_IT83XX__yn
	bool "IT83xx"
config CHIP_LM4__yn
	bool "LM4"
config CHIP_MAX32660__yn
	bool "MAX32660"
config CHIP_MCHP__yn
	bool "MCHP"
config CHIP_MEC1322__yn
	bool "MEC1322"
config CHIP_MT_SCP__yn
	bool "MT_SCP"
config CHIP_NPCX__yn
	bool "NPCX"
	select CHIP_PRE_INIT
config CHIP_NRF51__yn
	bool "NRF51"
config CHIP_STM32__yn
	bool "STM32"

endchoice # CHIP

config CHIP
	string
	default "g"		if CHIP_G__yn
	default "host"		if CHIP_HOST__yn
	default "ish"		if CHIP_ISH__yn
	default "it83xx"	if CHIP_IT83XX__yn
	default "lm4"		if CHIP_LM4__yn
	default "max32660"	if CHIP_MAX32660__yn
	default "mchp"		if CHIP_MCHP__yn
	default "mec1322"	if CHIP_MEC1322__yn
	default "mt_scp"	if CHIP_MT_SCP__yn
	default "npcx"		if CHIP_NPCX__yn
	default "nrf51"		if CHIP_NRF51__yn
	default "stm32"		if CHIP_STM32__yn

config UART_TX_BUF_SIZE
	int "UART transmit buffer size in bytes"
	default 2048	if CHIP_ISH__yn
	default 8192	if CHIP_LM4__yn
	default 8192	if CHIP_MAX32660__yn
	default 1024	if CHIP_MCHP__yn
	default 2048	if CHIP_MEC1322__yn
	default 1024	if CHIP_NPCX__yn
	default 1024	if CHIP_NRF51__yn
	default 2048	if CHIP_STM32__yn
	default 512
	help
	  UART transmit buffer size in bytes.  Must be a power of 2 for macros in
	  common/uart_buffering.c to work properly.


config CHIP_PANIC_BACKUP
	bool "Panic backup"
	default n
	help
	  Certain platforms(e.g. eve, poppy) cannot retain panic info in data ram since
	  VCC is powered down on EC reset. On such platforms, panic data needs to be
	  saved/restored to persistent storage by using chip specific
	  implementations. This option can be enabled by those platforms that have and
	  wish to use chip-implemented panic backup/restore functions.

config STACK_SIZE__yn
	bool "Select STACK_SIZE"

if STACK_SIZE__yn

config STACK_SIZE
	int "Default stack size to use for tasks, in bytes"
	default 1024 if (CHIP = "g")
	default 1024 if (CHIP = "ish")
	default 1024 if (CHIP = "it83xx")
	default 1024 if (CHIP = "mec1322")
	default 1024 if (CHIP = "mt_scp")
	default 1024 if (CHIP = "npcx")
	default 1024 if (CHIP = "nrf51")
	default 1024 if (CHIP = "stm32")

endif # STACK_SIZE__yn

config CHIP_MEMORY_REGIONS
	bool "The chip needs to define special SRAM memory regions as linker sections"
	help
	  The chip needs to define special SRAM memory regions as linker sections.
	  Those regions are defined in the special-purpose preprocessed file in
	  chip/<chip_name>/memory_regions.inc using the following macro:
	  REGION(name, attributes, start_address, size)

	  Note: these 'special' regions are NOT cleared at startup contrary to .bss.

config CHIP_PRE_INIT
	bool "Chip needs to do pre-init"
	help
	  Chip needs to do pre-init very early in main(), and provides chip_pre_init()
	  to do so.

config RTC
	bool "Support Real-Time Clock (RTC)"

menu "Low Power Idle"

config LOW_POWER_IDLE
	bool "low power idle"
	help
	  Low power idle options. These are disabled by default and all boards that
	  want to use low power idle must define it. When using the LFIOSC, the low
	  frequency clock will be used to conserve even more power when possible.

	  GPIOs which need to trigger interrupts in low power idle must specify the
	  GPIO_INT_DSLEEP flag in gpio_list[].

	  Note that for some processors (e.g. LM4), an active JTAG connection will
	  prevent the EC from using low-power idle.

config LOW_POWER_USE_LFIOSC
	bool "Use LFIOSC"

config LOW_POWER_IDLE_LIMITED
	bool "Allows us to enable/disable low power idle mode in runtime"

endmenu # LPI

menu "USB config"

# USB section 

config USB_BOS
	bool "USB Binary device Object Store support"
	default n

config USB_BCD_DEV__yn
	bool "Set USB Device version of product"
	default n

if USB_BCD_DEV__yn
config USB_BCD_DEV
	prompt "USB Device version of product"
	range 0x00 0xff
	hex
endif

config USB
	bool "Compile chip support for the USB device controller"
	default n

config USB_ISOCHRONOUS
	bool "Support USB isochronous handler"
	default n

config USB_BLOB
	bool "Support USB blob handler"
	default n

config USB_CHARGER
	bool "Common USB / BC1.2 charger detection routines"
	default n

endmenu # "USB config"

menu "ADC config"

config ADC
	bool "Compile chip support for analog-to-digital convertor"

# TODO: this should be "if ADC", but enabled by default in config.h

config ADC_WATCHDOG
	bool
	prompt "Include the ADC analog watchdog feature in the ADC code"
	default y

if ADC

choice
	prompt "Chip-dependent ADC configuration"

config ADC_PROFILE_SINGLE
	bool "Sample all inputs once when requested"
config ADC_PROFILE_FAST_CONTINUOUS
	bool "Sample all inputs continuously using DMA, with minimal sample time."

endchoice

endif # ADC

endmenu # "ADC config"

config WATCHDOG
	bool "Compile watchdog timer support"
	default y
	help
	  Compile watchdog timer support.  The watchdog timer will reboot the system
	  if the hook task (which is the lowest-priority task on the system) gets
	  starved for CPU time and isn't able to fire its HOOK_TICK event.

if WATCHDOG

config WATCHDOG_HELP
	bool "Try to detect a watchdog that is about to fire"
	help
	  Try to detect a watchdog that is about to fire, and print a trace.  This is
	  required on chips such as STM32 where the watchdog timer simply reboots the
	  system without any early warning.

endif # WATCHDOG

config WATCHDOG_MAX_RETRIES
	int "The maximum number of times that the watchdog timer may reset"
	default 4
	help
	  The maximum number of times that the watchdog timer may reset
	  before halting the system (or taking some sort of other
	  chip-dependent corrective action).

config WATCHDOG_PERIOD_MS
	int "Watchdog period in ms; see also AUX_TIMER_PERIOD_MS"
	default 1600

config FPU
	bool "Enable support for floating point unit"

config HIBERNATE
	bool "Enable system hibernate"
	default y

config MPU
	bool "Support memory protection unit (MPU)"


config DMA
	bool "Support DMA transfers inside the EC"

config DMA_DEFAULT_HANDLERS
	bool "Use the common interrupt handlers for DMA IRQs"
	default y

config DMA_HELP
	bool "Compile extra debugging and tests for the DMA module"

config FW_INCLUDE_RO
	bool "FW_INCLUDE_RO"
	default y
	help
	  Board Image ec.bin contains a RO firmware.  If not defined, the image will
	  only contain the RW firmware.

config FW_LIMITED_IMAGE
	bool "If defined, another image (RW) exists with more features"

config MAPPED_STORAGE
	bool "Flash is directly mapped into the EC's address space"
	default y
	help
	  Flash is directly mapped into the EC's address space.  If this is not
	  defined, the flash driver must implement flash_physical_read().

choice
	prompt "EC code can reside on internal or external storage"
	help
	  EC code can reside on internal or external storage. Only one of these
	  CONFIGs should be defined. CONFIG_INTERNAL_STORAGE implies XIP
	  (eXecute-In-Place) semantics. i.e. code is being fetched directly from
	  storage media.

config EXTERNAL_STORAGE
	bool "EXTERNAL_STORAGE"
config INTERNAL_STORAGE
	bool "INTERNAL_STORAGE"
endchoice
```

## chip/ish/Kconfig
```kconfig
config HAVE_CHIP_ISH_ISH3
	bool
	select HAVE_CHIP_ISH

config HAVE_CHIP_ISH_ISH5
	bool
	select HAVE_CHIP_ISH

if CHIP_ISH__yn

choice # CHIP_FAMILY
	prompt "ISH family"

	default CHIP_ISH_ISH3__yn if HAVE_CHIP_ISH_ISH3
	default CHIP_ISH_ISH5__yn if HAVE_CHIP_ISH_ISH5

config CHIP_ISH_ISH3__yn
	bool "ISH3"
config CHIP_ISH_ISH5__yn
	bool "ISH5"

endchoice # CHIP_FAMILY

config CHIP_FAMILY
	string
	default "ish3"		if CHIP_ISH_ISH3__yn
	default "ish5"		if CHIP_ISH_ISH5__yn

endif # CHIP_ISH__yn

# TODO:
# CHIP_VARIANT:=ish3p0
# CHIP_VARIANT:=ish5p0
```

## chip/npcx/Kconfig
```kconfig
config HAVE_CHIP_NPCX_NPCX5
	bool
	select HAVE_CHIP_NPCX

config HAVE_CHIP_NPCX_NPCX7
	bool
	select HAVE_CHIP_NPCX

if CHIP_NPCX__yn

choice # CHIP_FAMILY
	prompt "NPCX family"

	default CHIP_NPCX_NPCX5__yn if HAVE_CHIP_NPCX_NPCX5
	default CHIP_NPCX_NPCX7__yn if HAVE_CHIP_NPCX_NPCX7

config CHIP_NPCX_NPCX5__yn
	bool "NPCX5"
	select I2C_MULTI_PORT_CONTROLLER
config CHIP_NPCX_NPCX7__yn
	bool "NPCX7"
	select I2C_MULTI_PORT_CONTROLLER

endchoice # CHIP_FAMILY

config CHIP_FAMILY
	string
	default "npcx5"		if CHIP_NPCX_NPCX5__yn
	default "npcx7"		if CHIP_NPCX_NPCX7__yn

config CONSOLE_UART
	int "Console UART"
	range 0 1
	default 0
	help
	  Select which UART controller is the console UART:
	  0:UART1 1:UART2.

config SUPPORT_CHIP_HIBERNATION
	bool "If defined, chip hibernation is used"
	default y
	help
	  If defined, chip hibernation is used. Your board needs to define wake-up
	  signals. Undefine this to use board hibernation capability.

config HIBERNATE_PSL
	bool "Use PSL (Power Switch Logic) for hibernating"
	help
	  Use PSL (Power Switch Logic) for hibernating. It turns off VCC power rail
	  for ultra-low power consumption and uses PSL inputs rely on VSBY power rail
	  to wake up ec and the whole system.

endif # CHIP_NPCX__yn

# TODO:
# CHIP_VARIANT:=npcx5m5g
# CHIP_VARIANT:=npcx5m6g
# CHIP_VARIANT:=npcx7m6f
# CHIP_VARIANT:=npcx7m6fb
# CHIP_VARIANT:=npcx7m6fc
# CHIP_VARIANT:=npcx7m6g
# CHIP_VARIANT:=npcx7m7wb
# CHIP_VARIANT:=npcx7m7wc
```
