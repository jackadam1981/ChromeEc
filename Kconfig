## common/Kconfig.console
```kconfig
config CONSOLE__yn
	bool "Console support"

if CONSOLE__yn


config CONSOLE_CHANNEL
	bool "Output to different channels"
	default y
	help
	  Make it possible for console to be output to different channels that can be
	  turned on and off.

	  This is useful as a developer convenience when the console is crowded with
	  messages, to make it easier to use the interactive console.
	  FAFT and servod also use this feature.

	  Boards may #undef this to reduce image size.

config CONSOLE_CMDHELP
	bool "Provide additional help on console commands"
	default y
	help
	  Provide additional help on console commands, such as the supported
	  options/usage.

	  Boards may #undef this to reduce image size.

config CONSOLE_COMMAND_FLAGS
       	bool "Add a .flags field to the console commands data structure"
	help
	  Add a .flags field to the console commands data structure, to distinguish
	  some commands from others. The available flags bits are defined in
	  include/console.h

config RESTRICTED_CONSOLE_COMMANDS
	bool "RESTRICTED_CONSOLE_COMMANDS"
	depends on CONSOLE_COMMAND_FLAGS
	help
	  One use of the .flags field is to make some console commands restricted, so
	  that they can be disabled or enabled at run time.

config CONSOLE_ENABLE_READ_V1
	bool "Enable EC_CMD_CONSOLE_READ V1"
	default y
	help
	  Enable EC_CMD_CONSOLE_READ V1. One could disable this config to prevent
	  kernel from creating the `console_log` debugfs entry.

if !EXPERIMENTAL_CONSOLE

config CONSOLE_HISTORY
	int "Number of entries in console history buffer"
	default 8
	help
	  Number of entries in console history buffer.

	  Boards may #undef this to reduce memory usage.

endif

config CONSOLE_INPUT_LINE_SIZE
	int "Max length of a single line of input"
	default 80

config CONSOLE_VERBOSE
	bool "Enable verbose output to UART console and extra timestamp print precision"
	default y

config UART_BAUD_RATE
	int "Baud rate for UARTs"
	default 115200

config UART_RX_BUF_SIZE
	int "UART receive buffer size in bytes"
	default 128
	help
	  UART receive buffer size in bytes.  Must be a power of 2 for macros in
	  common/uart_buffering.c to work properly.  Must be larger than
	  CONFIG_CONSOLE_INPUT_LINE_SIZE to copy and paste scripts.

config UART_TX_BUF_SIZE
	int "UART transmit buffer size in bytes"
	default 1024 if (CHIP = "npcx" || CHIP = "mchp")
	default 512
	help
	  UART transmit buffer size in bytes.  Must be a power of 2 for macros in
	  common/uart_buffering.c to work properly.

config UART_RX_DMA_RECHECKS
	int "UART_RX_DMA_RECHECKS"
	default 5
	help
	  On some platforms, UART receive DMA can't trigger an interrupt when a single
	  character is received.  Those platforms poll for characters every HOOK_TICK.
	  When a character is received, make this many additional checks between then
	  and the next HOOK_TICK, to increase responsiveness of the console to input.

config EXPERIMENTAL_CONSOLE
	bool "Enable the experimental console"
	select CRC8
	help
	  NOTE: If you enable this experimental console, you will need to run the
	  EC-3PO interactive console in the util directory!  Otherwise, you won't be
	  able to enter any commands.

config FORCE_CONSOLE_RESUME
	bool "Allow EC serial console input to wake up the EC from STOP mode"

endif # CONSOLE__yn
```

## common/Kconfig.debug
```kconfig
config DEBUG_ASSERT
	bool "ASSERT() macros are checked at runtime"
	default y
	help
	  ASSERT() macros are checked at runtime.  See CONFIG_DEBUG_ASSERT_REBOOTS
	  to see what happens if one fails.

	  Boards may #undef this to reduce image size.

config DEBUG_ASSERT_REBOOTS
	bool "Prints a message and reboots if an ASSERT() macro fails at runtime"
	default y
	depends on DEBUG_ASSERT
	help
	  Prints a message and reboots if an ASSERT() macro fails at runtime.  When
	  enabled, an ASSERT() which fails will produce a message of the form:

	  ASSERTION FAILURE '<expr>' in function() at file:line

	  If this is not defined, failing ASSERT() will trigger a BKPT instruction
	  instead.

	  Ignored if CONFIG_DEBUG_ASSERT is not defined.

	  Boards may #undef this to reduce image size.

config DEBUG_ASSERT_BRIEF
	bool "On assertion failure, prints only the file name and the line number"
	depends on DEBUG_ASSERT
	help
	  On assertion failure, prints only the file name and the line number.

	  Ignored if CONFIG_DEBUG_ASSERT_REBOOTS is not defined.

	  Boards may define this to reduce image size.

config DEBUG_DISABLE_WRITE_BUFFER
	bool "Disable the write buffer used for default memory map accesses"
	help
	  Disable the write buffer used for default memory map accesses.
	  This turns "Imprecise data bus errors" into "Precise" errors
	  in exception traces at the cost of some performance.
	  This may help identify the offending instruction causing an
	  exception. Supported on cortex-m.

config DEBUG_EXCEPTIONS
	bool "Print additional information when exceptions are triggered"
	default y
	help
	Print additional information when exceptions are triggered, such as the
	fault address, here shown as bfar. This shows the reason for the fault
	and may help to determine the cause.

	    === EXCEPTION: 03 ====== xPSR: 01000000 ===========
	    r0 :0000000b r1 :00000047 r2 :60000000 r3 :200013dd
	    r4 :00000000 r5 :080053f4 r6 :200013d0 r7 :00000002
	    r8 :00000000 r9 :200013de r10:00000000 r11:00000000
	    r12:00000000 sp :200009a0 lr :08002b85 pc :08003a8a
	    Precise data bus error, Forced hard fault, Vector catch, bfar = 60000000
	    mmfs = 00008200, shcsr = 00000000, hfsr = 40000000, dfsr = 00000008

	If this is not defined, only a register dump will be printed.

	Boards may #undef this to reduce image size.

config DEBUG_PRINTF
	bool "Support Synchronous UART debug printf"

config DEBUG_STACK_OVERFLOW
	bool "Check for stack overflows on every context switch"
	default y
```

## common/Kconfig.flash
```kconfig
config FLASH
	bool "Enable console commands and higher-level features"
	default y

if FLASH

config FLASH_PHYSICAL
	bool "Enable chip-specific access functions"
	default y

config FLASH_BANK_SIZE__yn
	bool "Select FLASH_BANK_SIZE"
config FLASH_BANK_SIZE
	int "FLASH_BANK_SIZE"
	depends on FLASH_BANK_SIZE__yn

config FLASH_LOG
	bool "Provide event log stored in flash memory"

config FLASH_LOG_BASE__yn
	bool "Select flash log base"
	depends on FLASH_LOG
config FLASH_LOG_BASE
	hex "flash log base"
	depends on FLASH_LOG

config FLASH_LOG_SPACE__yn
	bool "Select flash log space"
	depends on FLASH_LOG
config FLASH_LOG_SPACE
	hex "flash log space"
	depends on FLASH_LOG_SPACE__yn

config FLASH_ERASED_VALUE32__yn
	bool "Select FLASH_ERASED_VALUE32"
config FLASH_ERASED_VALUE32
	int "FLASH_ERASED_VALUE32"
#	string "FLASH_ERASED_VALUE32"
	depends on FLASH_ERASED_VALUE32__yn
	help
	  This is typically 0 or (-1U)... which Kconfig does not parse correctly.

config FLASH_ERASE_SIZE__yn
	bool "Select FLASH_ERASE_SIZE"
config FLASH_ERASE_SIZE
	hex "FLASH_ERASE_SIZE"
	depends on FLASH_ERASE_SIZE__yn

config FLASH_ROW_SIZE__yn
	bool "Select FLASH_ROW_SIZE"
config FLASH_ROW_SIZE
	int "FLASH_ROW_SIZE"
	depends on FLASH_ROW_SIZE__yn

config FLASH_DEFERRED_ERASE
	bool "Allow deferred (async) flash erase"

config FLASH_SELECT_REQUIRED
	bool "Flash must be selected for write/erase operations to succeed"

config FLASH_PROTECT_NEXT_BOOT
	bool "FLASH_PROTECT_NEXT_BOOT"

config FLASH_PROTECT_RW
	bool "Some platforms need to write protect RW independently of all flash"


config FLASH_PSTATE
	bool "FLASH_PSTATE"
	default y
	help
	  Store persistent write protect for the flash inside the flash data itself.
	  This allows ECs with internal flash to emulate something closer to a SPI
	  flash write protect register.  If this is not defined, write protect state
	  is maintained solely by the physical flash driver.

# %%% this should depend on FLASH_PSTATE
# but that breaks config.h match

config FLASH_PSTATE_BANK
	bool "FLASH_PSTATE_BANK"
	default y
#	#depends on FLASH_PSTATE
	help
	  Store the pstate data in its own dedicated bank of flash.  This allows
	  disabling the protect-RO-at-boot flag without rewriting the RO firmware,
	  but costs a bank of flash.

	  If this is not defined, the pstate data is stored inside the RO firmware
	  image itself.  This is more space-efficient, but the only way to clear the
	  flag once it's set is to rewrite the RO firmware (after removing the WP
	  screw, of course).

config FLASH_PSTATE_LOCKED
	bool "FLASH_PSTATE_LOCKED"
	depends on !FLASH_PSTATE_BANK
	help
	  Lock the PSTATE by default (currently only supported when
	  CONFIG_FLASH_PSTATE_BANK is not defined).

config FLASH_READOUT_PROTECTION
	bool "Enable readout protection"

config FLASH_READOUT_PROTECTION_AS_PSTATE
	bool "FLASH_READOUT_PROTECTION_AS_PSTATE"
	help
	  Use Read-out protection status as PSTATE, i.e. after RDP is enabled, we never
	  allow RO protection to be disabled.

	  This is used when we want to prevent read-back of some critical region (e.g.
	  rollback), even in DFU/BOOT0 mode.

	  Note that this significantly changes the behaviour or flash protection,
	  as this tie EC_FLASH_PROTECT_RO_AT_BOOT with RDP status: it makes no
	  sense to be able to unlock RO protection if RDP is enabled, as a custom RO
	  could allow protected regions readback.

	  TODO(crbug.com/888109): Implementation is currently only available on
	  STM32H7 and STM32F4, and requires more documentation.

config FLASH_MULTIPLE_REGION
	bool "FLASH_MULTIPLE_REGION"
	help
	  For flash that is segemented in different regions.

config FLASH_REGION_TYPE_COUNT__yn
	bool "Select number of regions of different size/type"
config FLASH_REGION_TYPE_COUNT
	int "Number of regions of different size/type"
	depends on FLASH_REGION_TYPE_COUNT__yn

config FLASH_SIZE__yn
	bool "Select total size of writable flash"
config FLASH_SIZE
	hex "Total size of writable flash"
	depends on FLASH_SIZE__yn

config FLASH_WRITE_SIZE__yn
	bool "Select minimum flash write size (in bytes)"
config FLASH_WRITE_SIZE
	hex "Minimum flash write size (in bytes)"
	depends on FLASH_WRITE_SIZE__yn

config FLASH_WRITE_IDEAL_SIZE__yn
	bool "Select most efficient flash write size (in bytes)"
config FLASH_WRITE_IDEAL_SIZE
	hex "Most efficient flash write size (in bytes)"
	depends on FLASH_WRITE_IDEAL_SIZE__yn

menu "NvMem Configuration"

config FLASH_NVMEM
	bool "Enable NV Memory module within flash"

config FLASH_NVMEM_VARS
	bool "Enable <key,value> variable support (requires CONFIG_FLASH_NVMEM)"
	depends on FLASH_NVMEM

endmenu

config FMAP
	bool "Include a flashmap in the compiled firmware image"
	default y

menu "SPI flash"

config SPI_FLASH
	bool "Support SPI flash"


config SPI_FLASH_REGS
	bool "Support SPI flash protection register translation"

choice
	prompt "Select any of the following SPI flash configs that your board uses"

config SPI_FLASH_GD25LQ40
	bool "GD25LQ40"
config SPI_FLASH_GD25Q41B
	bool "GD25Q41B"
config SPI_FLASH_W25Q128
	bool "W25Q128"
config SPI_FLASH_W25Q40
	bool "W25Q40"
config SPI_FLASH_W25Q64
	bool "W25Q64"
config SPI_FLASH_W25Q80
	bool "W25Q80"
config SPI_FLASH_W25X40
	bool "W25X40"

endchoice

if SPI_FLASH

config SPI_FLASH_PORT__yn
	bool "Select SPI_FLASH_PORT"
config SPI_FLASH_PORT
	int "Define the SPI port to use to access the flash"
	depends on SPI_FLASH_PORT__yn


config SPI_FLASH_HAS_SR2
	bool "SPI flash part supports SR2 register"

config SPI_NOR
	bool "Support JEDEC SFDP based Serial NOR flash"


config SPI_NOR_DEBUG
	bool "Enable SPI_NOR debugging"
	help
	  Enable SPI_NOR debugging providing additional console output while
	  initializing Serial NOR Flash devices including SFDP discovery. */

config SPI_NOR_MAX_MESSAGE_SIZE__yn
	bool "Select SPI_NOR_MAX_MESSAGE_SIZE"
config SPI_NOR_MAX_MESSAGE_SIZE
	int "Maximum Serial NOR flash command size, in Bytes"
	depends on SPI_NOR_MAX_MESSAGE_SIZE__yn

config SPI_NOR_MAX_READ_SIZE__yn
	bool "Select SPI_NOR_MAX_READ_SIZE"
config SPI_NOR_MAX_READ_SIZE
	int "Maximum Serial NOR flash read size, in Bytes"
	depends on SPI_NOR_MAX_READ_SIZE__yn

config SPI_NOR_MAX_WRITE_SIZE__yn
	bool "SPI_NOR_MAX_WRITE_SIZE"
config SPI_NOR_MAX_WRITE_SIZE
	int "Maximum Serial NOR flash write size, in bytes. Note this must be a power of two"
	depends on SPI_NOR_MAX_WRITE_SIZE__yn

config SPI_NOR_BLOCK_ERASE
	bool "If defined will enable block (64KiB) erase operations"

config SPI_NOR_SMART_ERASE
	bool "read the sector/block to be erased first"
	help
	  If defined will read the sector/block to be erased first and only initiate
	  the erase operation if not already in an erased state. The read operation
	  (performed in CONFIG_SPI_NOR_MAX_READ_SIZE chunks) is aborted early if a
	  non "0xff" byte is encountered.
	  !! Make sure there is enough stack space to host a
	  !! CONFIG_SPI_NOR_MAX_READ_SIZE sized buffer before enabling.




endif # SPI_FLASH

endmenu



endif # FLASH
```
