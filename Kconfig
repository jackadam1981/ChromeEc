## common/Kconfig
```kconfig
menu "Board setup"
source "common/Kconfig.board"
endmenu

menu "Console config"
source "common/Kconfig.console"
endmenu

menu "Accel setup"
source "common/Kconfig.accel"
endmenu

menu "Charge Manager setup"
source "common/Kconfig.charge-manager"
endmenu

menu "Charger setup"
source "common/Kconfig.charger"
endmenu

menu "Console commands"
source "common/Kconfig.cmd"
endmenu

source "common/Kconfig.battery"

config PWM
	bool "Support PWM control"

config SOFTWARE_PANIC
	bool "Software panic"

	help
	  Store a panic log and halt the system for a software-related reasons, such as
	  stack overflow or assertion failure.

config SHA256_UNROLLED
	bool "Unroll some loops in SHA256_transform for better performance"

menu "Common Code"

config COMMON_PANIC_OUTPUT
	bool "Provide common core code to output panic information without interrupts"
	default y

config COMMON_GPIO
	bool "Provide the default GPIO abstraction layer"
	default y
	help
	  You want this unless you are doing a really tiny firmware.

config COMMON_GPIO_SHORTNAMES
	bool "Use short GPIO names"
	depends on COMMON_GPIO
	help
	  Provides smaller GPIO names to reduce flash size.  Instead of the 'name'
	  field in GPIO macro it will concat 'port' and 'pin' to reduce flash size.

config COMMON_RUNTIME
	bool "COMMON_RUNTIME"
	default y
	help
	  Provide common runtime layer code (tasks, hooks ...)
	  You want this unless you are doing a really tiny firmware.

config COMMON_TIMER
	bool "Provide common core code to handle the operating system timers"
	default y

endmenu

menu IPI
endmenu # IPI

config IPI
	bool "EC support Inter-Processor Interrupt"

if IPI


config IPC_SHARED_OBJ_ADDR
	bool "IPC0/IPI shared object address"
	help
	  IPC0/IPI shared object address. This is the starting address of the send
	  object and the receive object.  Each object contains a buffer.

config IPC_SHARED_OBJ_BUF_SIZE
	int "\"buffer\" size of ipc_shared_obj"

config RPMSG_NAME_SERVICE
	bool "EC support rpmsg name service over IPI"

endif # IPI

config FACTORY_MODE
	bool "Add support for CCD factory mode"


menu "Vboot"

config VBOOT_EFS
	bool "Support early firmware selection"

config VBOOT_HASH
	bool "Support computing hash of code for verified boot"

config VSTORE
	bool "Support for secure temporary storage for verified boot"

config VSTORE_SLOT_COUNT
	int "Number of supported slots for secure temporary storage"
	depends on VSTORE

endmenu # "Vboot"

config SWITCH
	bool "Compile common code to handle simple switch inputs"
	help
	  Compile common code to handle simple switch inputs such as the recovery
	  button input from the servo debug interface.

config SWITCH_DEDICATED_RECOVERY
	bool "Support dedicated recovery signal from servo board"
	depends on SWITCH

config TASK_PROFILING
	bool "Enable task profiling"
	default y
	help
	  Boards may #undef this to reduce image size and RAM usage.

menu "Rollback"

config ROLLBACK_VERSION
	int "Current rollback version"
	default 0
	help
	  Current rollback version. Meaningless for RO (but provides the minimum value
	  that will be written to the rollback protection at flash time).

	  For RW, rollback version included in version structure, used by RO to
	  determine if the RW image is recent enough and can be jumped to.

	  Valid values are >= 0, <= INT32_MAX (positive, 32-bit signed integer).

config ROLLBACK_SECRET_SIZE__yn
	bool "Select ROLLBACK_SECRET_SIZE"

config ROLLBACK_SECRET_SIZE
	int "If defined, add support for storing some entropy in the rollback region"
	depends on ROLLBACK_SECRET_SIZE__yn

config ROLLBACK_MPU_PROTECT
	bool "If defined, protect rollback region readback using MPU"

config ROLLBACK_SECRET_LOCAL_ENTROPY_SIZE
	bool "inject some locally generated entropy when secret is updated"
	help
	  If defined, inject some locally generated entropy when secret is updated,
	  using board_get_entropy function.
	  Large values may take a long time to generate.

	  This is only meant to add a little bit of extra entropy, when the hardware
	  lacks a random number generator (otherwise, the strong entropy can be
	  directly added to the secret, using rollback_add_entropy).


config ROLLBACK_UPDATE
	bool "If defined, we can update rollback information (RW can unset this)"
	default y


endmenu # "Rollback"

config PWR_STATE_DISCHARGE_FULL
	bool "special status if battery is discharging and nearly full"
	help
	  If defined, charge_get_state returns a special status if battery is
	  discharging and battery is nearly full.


menu "Motion Sensor"

config MOTION_SENSE_SUSPEND_DELAY_US
	int "Defer the (re)configuration of motion sensors after suspend"
	default 0
	help
	  Defer the (re)configuration of motion sensors after the suspend event or
	  resume event.  Sensor power rails may be powered up or down asynchronously
	  from the EC, so it may be necessary to wait some time period before
	  reconfiguring after a transition.

config MOTION_SENSE_RESUME_DELAY_US
	int "Defer the (re)configuration of motion sensors after resume"
	default 0
	help
	  Defer the (re)configuration of motion sensors after the suspend event or
	  resume event.  Sensor power rails may be powered up or down asynchronously
	  from the EC, so it may be necessary to wait some time period before
	  reconfiguring after a transition.


config DYNAMIC_MOTION_SENSOR_COUNT
	bool "Define motion sensor count in board layer"

config MOTION_FILL_LPC_SENSE_DATA
	bool "Define when LPC memory space needs to be populated"

endmenu # "Motion Sensor"

choice
	prompt "EC code can reside on internal or external storage"
	help
	  EC code can reside on internal or external storage. Only one of these
	  CONFIGs should be defined. CONFIG_INTERNAL_STORAGE implies XIP
	  (eXecute-In-Place) semantics. i.e. code is being fetched directly from
	  storage media.

config EXTERNAL_STORAGE
	bool "EXTERNAL_STORAGE"
config INTERNAL_STORAGE
	bool "INTERNAL_STORAGE"
endchoice

config MAPPED_STORAGE
	bool "Flash is directly mapped into the EC's address space"
	default y
	help
	  Flash is directly mapped into the EC's address space.  If this is not
	  defined, the flash driver must implement flash_physical_read().

config FW_INCLUDE_RO
	bool "FW_INCLUDE_RO"
	default y
	help
	  Board Image ec.bin contains a RO firmware.  If not defined, the image will
	  only contain the RW firmware.

config FW_LIMITED_IMAGE
	bool "If defined, another image (RW) exists with more features"
	
```

## common/Kconfig.accel
```kconfig
config ACCEL_FIFO
#	bool "Select ACCEL_FIFO"
	bool "Enable sensor FIFO"
	help
	  Add support for sensor FIFO

if ACCEL_FIFO

config ACCEL_FIFO_SIZE
	int "define the size of the global fifo, must be a power of 2."
#	depends on ACCEL_FIFO

config ACCEL_INTERRUPTS
	bool "Enable accelerometer interrupts"

config ACCEL__yn
	bool "Select ACCEL"

if ACCEL__yn

# TODO: do we support multiple accel types on a board?

choice
	prompt "Specify type of accelerometers attached"
	help
	  lis2dh/lis2de/lng2dm have the same register interface but different
	  supported resolution. In normal mode, lis2dh works in 10-bit resolution,
	  but lis2de/lng2dm only support 8bit resolution.

config ACCEL_BMA255
	bool "BMA255"
config ACCEL_KXCJ9
	bool "KXCJ9"
config ACCEL_KX022
	bool "KX022"
config ACCEL_LIS2DE
	bool "LIS2DE"
config ACCEL_LIS2DH
	bool "LIS2DH"
config ACCEL_LNG2DM
	bool "LNG2DM"
config ACCEL_LIS2DW12
	bool "LIS2DW12"
config ACCEL_LIS2DWL
	bool "LIS2DWL"

endchoice

config ACCEL_LIS2D_COMMON
	bool
	default y if ACCEL_LIS2DE || ACCEL_LIS2DH || ACCEL_LNG2DM

config ACCEL_LIS2DW_COMMON
	bool
	default y if ACCEL_LIS2DW12 || ACCEL_LIS2DWL

config ACCEL_LIS2DW_AS_BASE
	bool "lis2dw driver support fifo and interrupt"
	depends on ACCEL_LIS2DW_COMMON
	help
	  lis2dw driver support fifo and interrupt, but letting lid accel sensor work
	  at polling mode is a common selection in current usage model. We need get a
	  option to be able to select interrupt or polling (foced mode).

endif # ACCEL__yn

endif # ACCEL_FIFO

config ACCEL_SPOOF_MODE
	bool "Support \"spoof\" mode for sensors"
	default y
	help
	  Support "spoof" mode for sensors.  This allows sensors to have their values
	  spoofed to any arbitrary value.  This is useful for testing.

config ACCELGYRO__yn
	bool "Select ACCELGYRO"

if ACCELGYRO__yn

config HAVE_ACCELGYRO_BMI160
	bool
config HAVE_ACCELGYRO_LSM6DS0
	bool
config HAVE_ACCELGYRO_LSM6DSM
	bool
config HAVE_ACCELGYRO_LSM6DSO
	bool

choice
	prompt "ACCELGYRO"
	help
	  Use CONFIG_ACCELGYRO_LSM6DSM for LSM6DSL, LSM6DSM, and/or LSM6DS3

	default ACCELGYRO_BMI160  if HAVE_ACCELGYRO_BMI160
	default ACCELGYRO_LSM6DS0 if HAVE_ACCELGYRO_LSM6DS0
	default ACCELGYRO_LSM6DSM if HAVE_ACCELGYRO_LSM6DSM
	default ACCELGYRO_LSM6DSO if HAVE_ACCELGYRO_LSM6DSO

config ACCELGYRO_BMI160
	bool "BMI160"
config ACCELGYRO_LSM6DS0
	bool "LSM6DS0"
config ACCELGYRO_LSM6DSM
	bool "LSM6DSM"
config ACCELGYRO_LSM6DSO
	bool "LSM6DSO"

endchoice # 

config SENSORHUB_LSM6DSM
	bool "Add sensorhub function for LSM6DSM, required if 2nd device attached"
	depends on ACCELGYRO_LSM6DSM

config BMI160_SEC_I2C
	bool "When set, it indicates a secondary sensor is attached behind a BMI160"
	depends on ACCELGYRO_BMI160

config LSM6DSM_SEC_I2C
	bool "When set, it indicates a secondary sensor is attached behind a LSM6DSM/L"
	depends on ACCELGYRO_LSM6DSM

config ACCELGYRO_BMI160_INT2_OUTPUT
	bool "Set when INT2 is an ouptut"
	depends on ACCELGYRO_BMI160

config ORIENTATION_SENSOR
	bool "Select orientation sensor"
	depends on ACCEL_FIFO

if ORIENTATION_SENSOR

config BMI160_ORIENTATION_SENSOR
	bool "Support for BMI160 hardware orientation sensor"
	depends on ACCELGYRO_BMI160

config KX022_ORIENTATION_SENSOR
	bool "Support for KIONIX KX022 hardware orientation sensor"
	depends on ACCEL_KX022

config DEBUG_ORIENTATION
	bool "Print orientation when device orientation changes"

endif # ORIENTATION_SENSOR

endif # ACCELGYRO__yn

config MAG__yn
	bool "Select MAG"
	help
	  Specify type of Magnetometer attached

if MAG__yn

choice
	prompt "Specify type of Magnetometer attached"

config MAG_LIS2MDL
	bool "MAG_LIS2MDL"
config MAG_BMM150
	bool "MAG_BMM150"

endchoice

config MAG_BMI160_BMM150
	bool "Presence of a Bosh Sensortec BMM150 magnetometer behind a BMI160"
	depends on ACCELGYRO_BMI160

config MAG_LSM6DSM_BMM150
	bool "Presence of a Bosh Sensortec BMM150 magnetometer behind a LSM6DSM"
	depends on ACCELGYRO_LSM6DSM

config MAG_BMI160_LIS2MDL
	bool "Presence of a ST LIS2MDL magnetometer behind a BMI160"
	depends on ACCELGYRO_BMI160

config MAG_LSM6DSM_LIS2MDL
	bool "Presence of a ST LIS2MDL magnetometer behind a LSM6DSM"
	depends on ACCELGYRO_LSM6DSM

endif # MAG__yn

config BARO_BMP280
	bool "Specify barometer attached"

config GESTURE_ORIENTATION
	bool "Support the orientation gesture"

config ACCEL_STD_REF_FRAME_OLD
	bool "Use the old standard reference frame for accelerometers"
	help
	  Use the old standard reference frame for accelerometers. The old
	  reference frame is:
	   Z-axis: perpendicular to keyboard, pointing up, such that if the device
           is sitting flat on a table, the accel reads +G.
	   X-axis: in the plane of the keyboard, pointing from the front lip to the
	   hinge, such that if the device is oriented with the front lip touching
	   the table and the hinge directly above, the accel reads +G.
	   Y-axis: in the plane of the keyboard, pointing to the right, such that
	   if the device is on it's left side, the accel reads +G.

	   Also, in the old reference frame, the lid accel matches the base accel
	   readings when lid is closed.

config GYRO_L3GD20H
	bool "Specify type of Gyrometers attached"

config SENSOR_TIGHT_TIMESTAMPS
	bool "SENSOR_TIGHT_TIMESTAMPS"
	help
	  If this is defined, motion_sense sends sensor events to the AP in the format
	  +-----------+
	  | Timestamp |
	  |  Payload  |
	  | Timestamp |
	  |  Payload  |
	  |    ...    |
	  +-----------+

	  If this is not defined, the events will be sent in the format
	  +-----------+
	  |  Payload  |
	  |  Payload  |
	  |  Payload  |
	  |    ...    |
	  | Timestamp |
	  +-----------+

	  The former format enables improved filtering of sensor event timestamps on
	  the AP, but comes with stricter jitter requirements.
```
