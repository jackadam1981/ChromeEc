## zephyr/dts/bindings/usbc/anologix,anx7447-tcpc.yaml
```yaml
description: Anologix ANX7447 USBC TCPC binding

compatible: "anologix,anx7447-tcpc"

include: base.yaml

properties:
  tcpc-flags:
    type: int
    default: 0
    description: |
      TCPC configuration flags
```

## zephyr/dts/bindings/usbc/bc12/pericom,pi3usb9201.yaml
```yaml
# Copyright 2022 The ChromiumOS Authors
# Use of this source code is governed by a BSD-style license that can be
# found in the LICENSE file.

description: Pericom PI3USB9201, Dual-Role USB Charging-Type Detector

compatible: "pericom,pi3usb9201"

include: [base.yaml, i2c-device.yaml]

properties:
    intb-gpios:
      type: phandle
      required: false
      description: |
        GPIO input connected to the active low interrupt INTB pin on the PI39201.

    enable-gpios:
      type: phandle
      required: false
      description: |
        GPIO output connected to the system enable ENB pin on the PI39201.

    always-powered:
      type: boolean
      required: false
      description: |
        If true, this PI3USB9201 device is always powered.
        FIXME - move to common bc1.2 handler?

    client-mode-only:
      type: boolean
      required: false
      description: |
        If true, this PI3USB9201 device only supports client-mode operation. If
        false, then both host-mode and client-mode operation is supported.
```

## zephyr/dts/bindings/usbc/cros,tcpc.yaml
```yaml
description: USBC TCPC

compatible: "cros,tcpc"

properties:
  port:
    type: phandle
    required: true
    description: |
      I2C port used to communicate with controller

  i2c-addr-flags:
    type: int
    required: true
    description: |
      I2C address of controller

  drv:
    type: string
    required: true
    description:
      CrOS EC driver used to communicate with chip.
      The value for PS8XXX is ps8xxx_tcpm_drv and FUSB302 is fusb302_tcpm_drv

  flags:
    type: int
    required: false
    default: 0
    description: |
       Value which represents TCPC_FLAGS_* or other internal flags
        for tcpc chip.
```

## zephyr/dts/bindings/usbc/cros-ec,alt-usb-mux-chain.yaml
```yaml
description: Alternative usb mux chain

compatible: "cros-ec,alt-usb-mux-chain"

properties:
  usb-muxes:
    type: phandles
    required: true
    description: |
      Alternative list of USB-C muxes and retimers for the USB-C port. The USB-C
      subsystem may use this list to replace default chain present in
      a named-usbc-port node.

  alternate-for:
    type: phandle
    required: true
    description: |
      Pointer to the USBC port which usb mux chain can be replaced at runtime
      by this chain.
```

## zephyr/dts/bindings/usbc/cros-ec,alt-usb-mux.yaml
```yaml
description: Alternative USBC mux chip

compatible: "cros-ec,alt-usb-mux"

properties:
  usb-mux:
    type: phandle
    required: true
    description: |
      Alternative usb mux that can be used in an alternative usb mux chain

  port:
    type: phandle
    required: true
    description: |
      USBC port to which the usb mux is connected
```

## zephyr/dts/bindings/usbc/cros-ec,pdc-port-group.yaml
```yaml
# Copyright 2024 The Chromium OS Authors. All rights reserved.
# Use of this source code is governed by a BSD-style license that can be
# found in the LICENSE file.

description: Associates USB-C port drivers that are served by the same PDC.

compatible: "cros-ec,pdc-port-group"

include: [base.yaml]

properties:
  ports:
    type: phandles
    required: true
    description: |
      List of handles to the USB power/data drivers for each port served by this
      PDC.

  reg:
    required: true
    description: Index of this chip / port group.
```

## zephyr/dts/bindings/usbc/cros-ec,tcpci-usb-mux.yaml
```yaml
# Copyright (c) 2022 The Chromium OS Authors
# SPDX-License-Identifier: Apache-2.0

description: USBC TCPC USB MUX

include: cros-ec,usb-mux.yaml

compatible: "cros-ec,tcpci-usb-mux"

properties:
  hpd-update:
    type: string
    required: false
    description: |
      Name of function used as hpd_update callback
    enum:
      - ps8xxx_tcpc_update_hpd_status
```

## zephyr/dts/bindings/usbc/cros-ec,usb-mux-chain.yaml
```yaml
# Copyright 2022 The Chromium OS Authors. All rights reserved.
# Use of this source code is governed by a BSD-style license that can be
# found in the LICENSE file.

description: USB-C muxes chain

compatible: "cros-ec,usb-mux-chain"

properties:
  usb-muxes:
    type: phandles
    required: true
    description: |
      List of USB-C muxes and retimers for the USB-C port. The USB-C subsystem
      traverses this list in the order specified. The phandles are references to
      cros-ec,usbc-mux nodes. All muxes has to be children of the same USB-C
      port.

  alternative-chain:
    type: boolean
    description: |
      Set if this is alternative USB-C muxes chain. It can be selected in
      runtime using USB_MUX_ENABLE_ALTERNATIVE macro.
```

## zephyr/dts/bindings/usbc/cros-ec,usb-mux.yaml
```yaml
# Copyright (c) 2022 The Chromium OS Authors
# SPDX-License-Identifier: Apache-2.0

description: Common properties for USB mux

properties:
  board-init:
    type: string
    required: false
    description: |
      Name of function used as board_init callback

  board-set:
    type: string
    required: false
    description: |
      Name of function used as board_set callback
```

## zephyr/dts/bindings/usbc/cros-ec,virtual-usb-mux.yaml
```yaml
# Copyright (c) 2022 The Chromium OS Authors
# SPDX-License-Identifier: Apache-2.0

description: USBC Virtual USB MUX

include: cros-ec,usb-mux.yaml

compatible: "cros-ec,virtual-usb-mux"
```

## zephyr/dts/bindings/usbc/cypress,ccgxxf.yaml
```yaml
description: USBC TCPC

compatible: "cypress,ccgxxf"

properties:
  port:
    type: phandle
    required: true
    description: |
      I2C port used to communicate with controller

  i2c-addr-flags:
    type: string
    default: "CCGXXF_I2C_ADDR1_FLAGS"
    enum:
      - "CCGXXF_I2C_ADDR1_FLAGS"
      - "CCGXXF_I2C_ADDR2_FLAGS"
    description: |
      I2C address of controller
```

## zephyr/dts/bindings/usbc/ite,it5205-usb-mux.yaml
```yaml
# Copyright (c) 2022 The Chromium OS Authors
# SPDX-License-Identifier: Apache-2.0

description: ITE IT5205 USB Type-C 3:2 alternate mode MUX

include: cros-ec,usb-mux.yaml

compatible: "ite,it5205-usb-mux"

properties:
  port:
    type: phandle
    required: true
    description: phandle to the named i2c port

  i2c-addr-flags:
    type: string
    required: true
    description: I2C address of chip
    enum:
      - IT5205_I2C_ADDR1_FLAGS
      - IT5205_I2C_ADDR2_FLAGS
```

## zephyr/dts/bindings/usbc/kinetic_ktu1125.yaml
```yaml
description: USBC PPC

compatible: "kinetic,ktu1125"

include: ppc-chip.yaml

properties:
  i2c-addr-flags:
    default: "KTU1125_ADDR0_FLAGS"
    enum:
      - "KTU1125_ADDR0_FLAGS"
      - "KTU1125_ADDR1_FLAGS"
      - "KTU1125_ADDR2_FLAGS"
      - "KTU1125_ADDR3_FLAGS"
```

## zephyr/dts/bindings/usbc/mux/analogix,anx7451.yaml
```yaml
# Copyright 2023 The ChromiumOS Authors
# Use of this source code is governed by a BSD-style license that can be
# found in the LICENSE file.

description: Analogix 7451 re-timing MUX

compatible: "analogix,anx7451"

include: ["i2c-device.yaml", "cros-ec,usbc-mux.yaml"]

properties:
  flags:
    type: int
    required: false
    default: 0
    description: |
      Mask of flags defined in dt-bindings/usbc_mux.h

  usb-en-pin:
    type: phandle
    required: true

  dp-en-pin:
    type: phandle
    required: false
```

## zephyr/dts/bindings/usbc/mux/analogix,anx7452.yaml
```yaml
# Copyright 2023 The ChromiumOS Authors
# Use of this source code is governed by a BSD-style license that can be
# found in the LICENSE file.

description: |
  Analogix re-timing MUX

include: ["i2c-device.yaml", "cros-ec,usbc-mux.yaml"]

compatible: "analogix,anx7452"

properties:
  flags:
    type: int
    required: false
    default: 0
    description: |
      Mask of flags defined in dt-bindings/usbc_mux.h

  usb-en-pin:
    type: phandle
    required: true

  dp-en-pin:
    type: phandle
    required: false

  hpd-in-pin:
    type: phandle
    required: false
```

## zephyr/dts/bindings/usbc/mux/cros-ec,usbc-mux-tcpci.yaml
```yaml
# Copyright 2022 The Chromium OS Authors. All rights reserved.
# Use of this source code is governed by a BSD-style license that can be
# found in the LICENSE file.

description: USBC TCPC USB MUX

include: cros-ec,usbc-mux.yaml

compatible: "cros-ec,usbc-mux-tcpci"

properties:
  hpd-update:
    type: string
    required: false
    description: |
      Name of function used as hpd_update callback
    enum:
      - ps8xxx_tcpc_update_hpd_status

  port:
    type: phandle
    required: false
    description: |
      Phandle to the named i2c port. If provided, i2c-addr-flags property has
      to be present and USB_MUX_FLAG_NOT_TCPC flag is added to USB mux flags.
      Otherwise I2C configuration from tcpc_config of given USB-C port is used
      to communicate with this USB mux.

  i2c-addr-flags:
    type: int
    required: false
    description: |
      I2C address of chip. If provided, port property hat to be present too.
      Please check description of port property for more information.
```

## zephyr/dts/bindings/usbc/mux/cros-ec,usbc-mux-virtual.yaml
```yaml
# Copyright (c) 2022 The Chromium OS Authors
# SPDX-License-Identifier: Apache-2.0

description: USB-C Virtual USB MUX

include: cros-ec,usbc-mux.yaml

compatible: "cros-ec,usbc-mux-virtual"
```

## zephyr/dts/bindings/usbc/mux/cros-ec,usbc-mux.yaml
```yaml
# Copyright 2022 The ChromiumOS Authors
# Use of this source code is governed by a BSD-style license that can be
# found in the LICENSE file.

description: Common properties for USB-C mux

properties:
  flags:
    type: int
    required: false
    default: 0
    description: |
      Mask of flags defined in dt-bindings/usbc_mux.h

  board-init:
    type: string
    required: false
    description: |
      Name of function used as board_init callback

  board-set:
    type: string
    required: false
    description: |
      Name of function used as board_set callback

properties:
  is-alt:
    type: boolean
    required: false
    description: |
      If present, this node refers to an alternate MUX device. The MUX
      device is not used by default, and must be manually enabled at
      runtime.
```

## zephyr/dts/bindings/usbc/named-pdc-port.yaml
```yaml
# Copyright 2022 The ChromiumOS Authors
# Use of this source code is governed by a BSD-style license that can be
# found in the LICENSE file.

description: |
  PDC counterpart for a named USB-C port node

  Example:
        usbc {
                #address-cells = <1>;
                #size-cells = <0>;
                usbc_port0: port0@0 {
                        compatible = "named-pdc-port";
                        reg = <0>;
                        chg = <&charger>;
                        alt-mode = <&pdc_data_port0>;
                        pdc = <&pdc_power_p0>;
                        pd-retimer;
                        usb-mux-chain-0 {
                              compatible = "cros-ec,usb-mux-chain";
                              usb-muxes = <&virtual_mux_0>;
                        };
                        policy = <&cros_policy>;
                };

                port0-muxes {
                        virtual_mux_0: virtual-mux-0 {
                               compatible = "cros-ec,usbc-mux-virtual";
                        };
                usbc_port1: port0@1 {
                        ...
                };
                port1-muxes {
                        ...
                };

                /* Associate ports served by the same PDC */
                pdc-chip@0 {
                        reg = <0>;
                        compatible = "cros-ec,pdc-port-group";
                        ports = <&usbc_port0 &usbc_port1>;
                };
        };

compatible: "named-pdc-port"

include: base.yaml

properties:
  alt-mode:
    type: phandle
    description: |
      PD chip for configuring the alternate modes of the USB-C port.
  chg:
    type: phandle
    description: |
      Charger chip for the USB-C port.
  pdc:
    type: phandle
    description: |
      PD chip for managing Power Delivery
  pd-retimer:
    type: boolean
    description: |
      If present, this PD port has a retimer and connected to PD chip.
  policy:
    type: phandle
    description: |
      The static policies of the USB-C port.
```

## zephyr/dts/bindings/usbc/named-usbc-port.yaml
```yaml
# Copyright (c) 2021 The Chromium OS Authors
# SPDX-License-Identifier: Apache-2.0

description: Named USB-C port node

compatible: "named-usbc-port"

include: base.yaml
```

## zephyr/dts/bindings/usbc/nuvoton,nct38xx2.yaml
```yaml
description: USBC TCPC

compatible: "nuvoton,nct38xx1"

properties:
  port:
    type: phandle
    required: true
    description: |
      I2C port used to communicate with controller

  i2c-addr-flags:
    type: string
    default: "NCT38XX_I2C_ADDR1_1_FLAGS"
    enum:
      - "NCT38XX_I2C_ADDR1_1_FLAGS"
      - "NCT38XX_I2C_ADDR2_1_FLAGS"
    description: |
      I2C address of controller
```
