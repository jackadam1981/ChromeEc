## zephyr/dts/bindings/usbc/parade,ps8xxx.yaml
```yaml
description: USBC TCPC

compatible: "parade,ps8xxx"

include: base.yaml

properties:
  tcpc-flags:
    type: int
    default: 0
    description: |
      TCPC configuration flags
```

## zephyr/dts/bindings/usbc/pd/infineon,ccg8.yaml
```yaml
# Copyright 2023 Google LLC
# Use of this source code is governed by a BSD-style license that can be
# found in the LICENSE file.

description: Infineon CCG8 Power Delivery Controller

compatible: "infineon,ccg8"

include: ["i2c-device.yaml"]

properties:
  irq-gpios:
    type: phandle-array
    required: true
    description: |
      Interrupt line from the PD for power path (zephyr standard GPIO format)
  irq-shared:
    type: boolean
    description: |
      Interrupt line is shared between ports in a dual port solution.
      Define it only for the secondary port so that the driver doesn't
      trigger multiple events.
```

## zephyr/dts/bindings/usbc/pd/intel,pd-altmode.yaml
```yaml
# Copyright 2023 Google LLC
# Use of this source code is governed by a BSD-style license that can be
# found in the LICENSE file.

description: Intel SoC USBC Alternate mode Compatible PD

compatible: "intel,pd-altmode"

include: ["i2c-device.yaml"]

properties:
  irq-gpios:
    type: phandle-array
    required: true
    description: |
      Interrupt line from the PD for data path (zephyr standard GPIO format)
  irq-shared:
    type: boolean
    description: |
      Interrupt line is shared between ports in a dual port solution.
      Define it only for the secondary port so that the driver doesn't
      trigger multiple events.
  irq-flags:
    type: int
    default: 0
    description: |
      Zephyr config flags for interrupt. Valid if GPIO is an interrupt.
      If this field not assigned in dts file, it will be assigned as
      GPIO_INT_EDGE_FALLING in intel_altmode driver.
```

## zephyr/dts/bindings/usbc/pericom,pi3usb9201.yaml
```yaml
description: USBC BC1.2

compatible: "pericom,pi3usb9201"

include: base.yaml

properties:
  irq:
    type: phandles
    description: |
        GPIO interrupt from BC1.2

  i2c-addr-flags:
    type: string
    default: "PI3USB9201_I2C_ADDR_3_FLAGS"
    enum:
      - "PI3USB9201_I2C_ADDR_0_FLAGS"
      - "PI3USB9201_I2C_ADDR_1_FLAGS"
      - "PI3USB9201_I2C_ADDR_2_FLAGS"
      - "PI3USB9201_I2C_ADDR_3_FLAGS"
    description: |
      I2C address of controller
```

## zephyr/dts/bindings/usbc/ppc-chip.yaml
```yaml
# Copyright (c) 2021 The Chromium OS Authors
# SPDX-License-Identifier: Apache-2.0

description: Power path chip

include: base.yaml

properties:

  irq:
    type: phandles
    required: false
    description: |
      GPIO interrupt from PPC
```

## zephyr/dts/bindings/usbc/ppc/kinetic,ktu1125.yaml
```yaml
description: USBC PPC

compatible: "kinetic,ktu1125"

include: ["i2c-device.yaml", "ppc-chip.yaml"]

properties:
  irq-gpios:
    type: phandle-array
    required: false
    description: |
      Interrupt from PPC using shim driver
```

## zephyr/dts/bindings/usbc/ppc/silergy,syv682x.yaml
```yaml
description: USBC PPC

compatible: "silergy,syv682x"

include: ["i2c-device.yaml", "ppc-chip.yaml"]

properties:
  frs_en_gpio:
    type: phandle
    description: The GPIO that controls FRS enable on this device
    required: false
  irq-gpios:
    type: phandle-array
    required: false
    description: |
      Interrupt from PPC using shim driver
```

## zephyr/dts/bindings/usbc/ppc/ti,sn5s330.yaml
```yaml
description: USBC PPC

compatible: "ti,sn5s330"

include: ["i2c-device.yaml", "ppc-chip.yaml"]

properties:
  irq-gpios:
    type: phandle-array
    required: false
    description: |
      Interrupt from PPC using shim driver
```

## zephyr/dts/bindings/usbc/silergy,syv682x.yaml
```yaml
description: USBC PPC

compatible: "silergy,syv682x"

include: ppc-chip.yaml

properties:
  i2c-addr-flags:
    type: string
    default: "SYV682X_ADDR0_FLAGS"
    enum:
      - "SYV682X_ADDR0_FLAGS"
      - "SYV682X_ADDR1_FLAGS"
      - "SYV682X_ADDR2_FLAGS"
      - "SYV682x_ADDR3_FLAGS"
    description: |
      I2C address of controller
```

## zephyr/dts/bindings/usbc/tcpc/fairchild,fusb302.yaml
```yaml
description: USBC TCPC

compatible: "fairchild,fusb302"

include: i2c-device.yaml

properties:
  tcpc-flags:
    type: int
    default: 0
    description: |
      TCPC configuration flags
  irq-gpios:
    type: phandle-array
    required: false
    description: |
      Interrupt from TCPC using shim driver
  int-pin:
    type: phandles
    required: false
    description: |
      Interrupt from TCPC using gpio-int
```

## zephyr/dts/bindings/usbc/tcpc/parade,ps8xxx.yaml
```yaml
description: USBC TCPC

compatible: "parade,ps8xxx"

include: ["i2c-device.yaml", "tcpc-device.yaml"]

properties:
  irq-gpios:
    type: phandle-array
    required: false
    description: |
      Interrupt from TCPC
  rst-gpios:
    type: phandle-array
    required: false
    description: |
      TCPC reset line
```

## zephyr/dts/bindings/usbc/ti,tusb1064-usb-mux.yaml
```yaml
# Copyright (c) 2022 The Chromium OS Authors
# SPDX-License-Identifier: Apache-2.0

description: TI TUSB1064 USB MUX

include: cros-ec,usb-mux.yaml

compatible: "ti,tusb1064-usb-mux"

properties:
  port:
    type: phandle
    required: true
    description: phandle to the named i2c port

  i2c-addr-flags:
    type: string
    required: true
    description: I2C address of chip
    enum:
      - TUSB1064_I2C_ADDR0_FLAGS
      - TUSB1064_I2C_ADDR1_FLAGS
      - TUSB1064_I2C_ADDR2_FLAGS
      - TUSB1064_I2C_ADDR3_FLAGS
      - TUSB1064_I2C_ADDR4_FLAGS
      - TUSB1064_I2C_ADDR5_FLAGS
      - TUSB1064_I2C_ADDR6_FLAGS
      - TUSB1064_I2C_ADDR7_FLAGS
      - TUSB1064_I2C_ADDR8_FLAGS
      - TUSB1064_I2C_ADDR9_FLAGS
      - TUSB1064_I2C_ADDR10_FLAGS
      - TUSB1064_I2C_ADDR11_FLAGS
      - TUSB1064_I2C_ADDR12_FLAGS
      - TUSB1064_I2C_ADDR13_FLAGS
      - TUSB1064_I2C_ADDR14_FLAGS
      - TUSB1064_I2C_ADDR15_FLAGS
```

## zephyr/dts/bindings/usbc/usbc-bc12.yaml
```yaml
description: USBC BC1.2

compatible: "usbc-bc12"

properties:
  port:
    type: phandle
    required: true
    description: |
      I2C port used to communicate with controller

  addr-flags:
    type: string
    default: "PI3USB9201_I2C_ADDR_3_FLAGS"
    enum:
      - "MT6360_PMU_I2C_ADDR_FLAGS"
      - "MT6360_PMIC_I2C_ADDR_FLAGS"
      - "MT6360_LDO_I2C_ADDR_FLAGS"
      - "MT6360_PD_I2C_ADDR_FLAGS"
      - "PI3USB9201_I2C_ADDR_0_FLAGS"
      - "PI3USB9201_I2C_ADDR_1_FLAGS"
      - "PI3USB9201_I2C_ADDR_2_FLAGS"
      - "PI3USB9201_I2C_ADDR_3_FLAGS"
    description: |
      I2C address of controller
```

## zephyr/emul/Kconfig
```kconfig
# Copyright 2021 The Chromium OS Authors. All rights reserved.
# Use of this source code is governed by a BSD-style license that can be
# found in the LICENSE file.

config EMUL_SMART_BATTERY
	bool "Smart Battery emulator"
	help
	  Enable the Smart Battery emulator. This driver use emulated I2C bus.

config EMUL_BC12_DETECT_PI3USB9201
	bool "PI3USB9201 emulator"
	help
	  Enable the PI3USB9201 emulator. PI3USB9201 is a BC1.2 charger
	  detector/advertiser. The emulator supports reading and writing the
	  4 I2C registers of the PI3USB9201 using the emulated I2C bus.
```

## zephyr/emul/Kconfig.counter
```kconfig
# Copyright 2025 The ChromiumOS Authors
# Use of this source code is governed by a BSD-style license that can be
# found in the LICENSE file.

config EMUL_COUNTER
	bool "Emulated counter driver"
	default y
	depends on DT_HAS_CROS_COUNTER_EMUL_ENABLED
	help
	  Enable the emulated counter module. This module introduces a
	  functioning counter implementation along with backdoor APIs to
	  verify and override behavior. Emulator API is available in
	  zephyr/include/emul/emul_counter.h

if EMUL_COUNTER

module = COUNTER_EMUL
module-str = counter_emul
source "subsys/logging/Kconfig.template.log_config"

endif # EMUL_COUNTER
```
