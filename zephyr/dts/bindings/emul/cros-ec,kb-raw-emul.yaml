## zephyr/dts/bindings/fingerprint/egis,ec660.yaml
```yaml
# Copyright 2025 The Chromium OS Authors. All rights reserved.
# Use of this source code is governed by a BSD-style license that can be
# found in the LICENSE file.

description: EGIS EC660 fingerprint sensor

compatible: "egis,ec660"

include: [spi-device.yaml]

properties:
  irq-gpios:
    type: phandle-array
    required: true
    description: |
      This property specifies the connection for sensor interrupt.

  reset-gpios:
    type: phandle-array
    required: true
    description: |
      This property specifies the connection for sensor reset.
```

## zephyr/dts/bindings/fingerprint/elan.elani80sa.yaml
```yaml
# Copyright 2025 The ChromiumOS Authors. All rights reserved.
# Use of this source code is governed by a BSD-style license that can be
# found in the LICENSE file.

description: ELANI80SA fingerprint sensor

compatible: "elan,elani80sa"

include: [spi-device.yaml]

properties:
  irq-gpios:
    type: phandle-array
    required: true
    description: |
      This property specifies the connection for sensor interrupt.

  reset-gpios:
    type: phandle-array
    required: true
    description: |
      This property specifies the connection for sensor reset.

  base-image-addr:
    type: int
    description: |
      Image base address from internal flash.

  ft-info-addr:
    type: int
    description: |
      Ft Info address from internal flash.
```

## zephyr/dts/bindings/fingerprint/fingerprint-image-frame-params.yaml
```yaml
# Copyright 2025 The Chromium OS Authors. All rights reserved.
# Use of this source code is governed by a BSD-style license that can be
# found in the LICENSE file.

description: |
  Image frame parameters for a single fingerprint sensor
  configuration.

compatible: "fingerprint-image-frame-params"

child-binding:
  properties:
    width:
      type: int
      required: true
      description: Fingerprint sensor width in pixels for this mode.

    height:
      type: int
      required: true
      description: Fingerprint sensor height in pixels for this mode.

    bits-per-pixel:
      type: int
      required: true
      description: Pixel resolution in bits for this mode.

    frame-size:
      type: int
      required: true
      description: Frame size (bytes) of captured fingerprint image.

    v4l2-pixel-format:
      type: string
      required: true
      enum:
        # Grey-scale image. It's a Y'CbCr format which contains no Cb or Cr data.
        # https://docs.kernel.org/userspace-api/media/v4l/pixfmt-yuv-luma.html
        - V4L2_PIX_FMT_GREY
      description: |
        Video4Linux2 pixel format type for this mode.
        See https://docs.kernel.org/userspace-api/media/v4l/pixfmt.html

    capture-type:
      type: int
      required: true
      description: |
        Type of image capture.
      enum:
        - 0  # FINGERPRINT_CAPTURE_TYPE_VENDOR_FORMAT
        - 1  # FINGERPRINT_CAPTURE_TYPE_DEFECT_PXL_TEST
        - 2  # FINGERPRINT_CAPTURE_TYPE_ABNORMAL_TEST
        - 3  # FINGERPRINT_CAPTURE_TYPE_NOISE_TEST
        - 4  # FINGERPRINT_CAPTURE_TYPE_SIMPLE_IMAGE
        - 8  # FINGERPRINT_CAPTURE_TYPE_PATTERN0
        - 12 # FINGERPRINT_CAPTURE_TYPE_PATTERN1
        - 16 # FINGERPRINT_CAPTURE_TYPE_QUALITY_TEST
        - 20 # FINGERPRINT_CAPTURE_TYPE_RESET_TEST
```

## zephyr/dts/bindings/fingerprint/fingerprint-sensor.yaml
```yaml
# Copyright 2023 The Chromium OS Authors. All rights reserved.
# Use of this source code is governed by a BSD-style license that can be
# found in the LICENSE file.

# Common fields for fingerprint sensors

description: Common fields for a single fingerprint sensor configuration.

compatible: "fingerprint-sensor"

child-binding:
  properties:
    width:
      type: int
      required: true
      description: Fingerprint sensor width in pixels for this mode.

    height:
      type: int
      required: true
      description: Fingerprint sensor height in pixels for this mode.

    bits-per-pixel:
      type: int
      required: true
      description: Pixel resolution in bits for this mode.

    frame-size:
      type: int
      required: true
      description: Frame size of captured fingerprint image.

    v4l2-pixel-format:
      type: string
      required: true
      description: |
        Video4Linux2 pixel format type for this mode.
        See https://docs.kernel.org/userspace-api/media/v4l/pixfmt.html
      enum:
        - "V4L2_PIX_FMT_GREY"
        # Add other common formats

    capture-type:
      type: int
      required: true
      description: |
        Type of image capture.
```

## zephyr/dts/bindings/fingerprint/ft,ft9865.yaml
```yaml
# Copyright 2025 The Chromium OS Authors. All rights reserved.
# Use of this source code is governed by a BSD-style license that can be
# found in the LICENSE file.

description: FT9865 fingerprint sensor

compatible: "ft,ft9865"

include: [spi-device.yaml, fingerprint-sensor.yaml]

properties:
  irq-gpios:
    type: phandle-array
    required: true
    description: |
      This property specifies the connection for sensor interrupt.

  reset-gpios:
    type: phandle-array
    required: true
    description: |
      This property specifies the connection for sensor reset.
```

## zephyr/dts/bindings/gpio/cros,ioex-chip.yaml
```yaml
description: IEOX chip definition

compatible: "cros,ioex-chip"

include: [base.yaml]

properties:
    port-named:
      type: string

    i2c-addr:
      type: int
      required: true

    flags:
      type: int
      required: true

    drv:
      type: string
      required: true
      enum:
        - "ccgxxf_ioexpander_drv"
        - "fake_ioexpander_drv"
        - "it8801_ioexpander_drv"
        - "nct38xx_ioexpander_drv"
        - "pca9675_ioexpander_drv"
        - "pcal6408_ioexpander_drv"
        - "tca64xxa_ioexpander_drv"

    int-gpios:
      type: phandle-array
      required: false
```

## zephyr/dts/bindings/gpio/cros-ec,gpio-interrupts.yaml
```yaml
description: GPIO interrupts list
#
# Uses device tree to configure the interrupt handling e.g
#
#	int_wp_l: wp_l {
#		gpio = <&gpio_ec_wp_odl>;
#		flags = <GPIO_INT_EDGE_BOTH>;
#		handler = "wp_interrupt";
#	};
#
# The interrupt can be enabled either using the DTS label:
#
#	gpio_interrupt_enable(GPIO_INTERRUPT(DT_NODELABEL(int_wp_l)));
#
# or the legacy:
#
#	gpio_enable_interrupt(GPIO_WP_L);
#

compatible: "cros-ec,gpio-interrupts"

child-binding:
  description: GPIO Interrupt definition.
  properties:
    gpio:
      type: phandle
      required: true
      description: The GPIO source of the interrupt.
    flags:
      type: int
      required: true
      description: The zephyr gpio interrupt config flags.
    handler:
      type: string
      description: The C function name attached to this interrupt.
```

## zephyr/dts/bindings/gpio/cros-ec,vci-gpios.yaml
```yaml
description: VCI GPIO definition

compatible: "cros-ec,vci-gpios"

include: [gpio-controller.yaml, base.yaml]

properties:
  "#gpio-cells":
    required: true
    const: 2
    description:
      Number of parameters describing the pin

  ngpios:
    required: true
    description:
      Number of pins per port

gpio-cells:
  - pin
  - flags
```

## zephyr/dts/bindings/gpio/crox,ioex-port.yaml
```yaml
description: IEOX port definition

compatible: "cros,ioex-port"

include: [gpio-controller.yaml, base.yaml]

properties:
    reg:
      required: true

    "#gpio-cells":
      const: 2

    ngpios:
      required: true
      const: 8

gpio-cells:
  - pin
  - flags
```

## zephyr/dts/bindings/gpio/generic,gpio-debounce.yaml
```yaml
# Copyright 2022 The Chromium OS Authors.
# Use of this source code is governed by a BSD-style license that can be
# found in the LICENSE file.
#
include: base.yaml

description: |
  GPIO Debounce.
   - Name
   - Type
   - GPIO handle
   - Debounce time (us)
   - Flags

compatible: "generic,gpio-debounce"

description: GPIO Debounce configuration
properties:
  button_type:
    type: int
    required: false
    description: Keyboard button type
  gpios:
    type: phandle-array
    required: true
  debounce_us:
    type: int
    required: true
    description: Debounce time in microseconds
```

## zephyr/dts/bindings/gpio/named-gpios.yaml
```yaml
description: Named GPIOs parent node

compatible: "named-gpios"

child-binding:
  description: Named GPIOs child node
  include: gpio-enum-name.yaml
  properties:
    gpios:
      type: phandle-array
      required: true
    "#gpio-cells":
      type: int
      required: false
      const: 0
    inactive:
      description:
        When not set, the GPIO h/w is configured and initialised at startup
        according to the flags in the gpios node.

        When set, the GPIO is not initialised, and can be
        initialised separately in code, but is still saved so that
        it appears in the list of GPIOs.
      type: boolean
      required: false
```

## zephyr/dts/bindings/gpio/named-ioexes.yaml
```yaml
description: Named IOEXes parent node

compatible: "named-ioexes"

child-binding:
    description: Named IOEXes child node
    include: ioex-enum-name.yaml
    properties:
       gpios:
          type: phandle-array
          required: true
       label:
          required: true
          type: string
          description: |
            Human readable string describing the device (used as
            device_get_binding() argument)
       "#gpio-cells":
          type: int
          required: false
          const: 0
```

## zephyr/dts/bindings/gpio/parade,ps8815-gpio-port.yaml
```yaml
# Copyright (c) 2021 Nuvoton Technology Corporation.
# SPDX-License-Identifier: Apache-2.0

description: |
    Parade PS8815 integrated GPIO expander

compatible: "parade,ps8815-gpio-port"

include: [gpio-controller.yaml, base.yaml]

properties:
  reg:
    required: true

  pin_mask:
    type: int
    required: true
    description: |
      Not every GPIOs are usable for different PS8815 series. This property
      indicates the usable GPIO mask.

  "#gpio-cells":
    const: 2

gpio-cells:
  - pin
  - flags
```

## zephyr/dts/bindings/gpio/sku.yaml
```yaml
description: Defines board version and sku id gpios

compatible: cros-ec,sku

properties:
  bits:
    type: phandles
    required: true
    description: GPIO list to read, LSB to MSB

  system:
    type: string
    description:
      Numeral system.
    enum:
      - binary
      - binary_first_base3
      - ternary
```

## zephyr/dts/bindings/gpio/unimplemented-gpios.yaml
```yaml
description: Unimplemented GPIOs for legacy GPIO enum names

compatible: "unimplemented-gpios"

properties:
  enum-names:
    description:
      The set of GPIO enum names that are to be mapped to
      GPIO_UNIMPLEMENTED.

      This is used to safely neutralise GPIO references in legacy
      common code so that that operations on that GPIO are
      null. This avoids having to conditionally compile out these
      references. This should only be used for legacy code.
    type: string-array
    required: true
```

## zephyr/dts/bindings/gpio_led/battery-led-colors.yaml
```yaml
# Copyright 2021 The Chromium OS Authors. All rights reserved.
# Use of this source code is governed by a BSD-style license that can be
# found in the LICENSE file.

description: Battery LED colors parent node

compatible: "battery-led-colors"

child-binding:
    description: Nodes based on charge state
    properties:
        charge-state:
            description: This property is used to describe the power state
                         of the node
            type: string
            required: true
            enum:
                - PWR_STATE_CHARGE
                - PWR_STATE_DISCHARGE
                - PWR_STATE_ERROR
                - PWR_STATE_IDLE
                - PWR_STATE_CHARGE_NEAR_FULL
        chipset-state:
            description: If the LED color depends on chipset state, this
                         property is used to describe it. ANY is used if
                         the color doesn't depend on the chipset state
            type: string
            required: true
            enum:
                - S0
                - S3
                - S5
                - ANY
        period:
            description: In case of blinking LEDs, this is ON_SEC + OFF_SEC
            type: int
            required: true

        on_sec:
            description: In case of blinking LEDs, this is the on time secs
            type: int
            required: true

        chflags:
            type: boolean
            required: false

    child-binding:
        description: Color nodes describing color to set for this power state
        properties:
            led-color:
                type: string
                required: true
                enum:
                    - LED_OFF
                    - LED_RED
                    - LED_GREEN
                    - LED_BLUE
                    - LED_YELLOW
                    - LED_WHITE
                    - LED_AMBER
```

## zephyr/dts/bindings/gpio_led/cros-ec,battery-led-colors.yaml
```yaml
# Copyright 2021 The Chromium OS Authors. All rights reserved.
# Use of this source code is governed by a BSD-style license that can be
# found in the LICENSE file.

description: Battery LED colors parent node

compatible: "cros-ec,battery-led-colors"

child-binding:
    description: Nodes based on charge state
    properties:
        charge-state:
            description: This property is used to describe the power state
                         of the node
            type: string
            required: false
            enum:
                - PWR_STATE_CHARGE
                - PWR_STATE_DISCHARGE
                - PWR_STATE_ERROR
                - PWR_STATE_IDLE
                - PWR_STATE_CHARGE_NEAR_FULL
        chipset-state:
            description: If the LED color depends on chipset state, this
                         property is used to describe it. ANY is used if
                         the color doesn't depend on the chipset state
            type: string
            required: false
            enum:
                - S0
                - S3
                - S5
                - ANY

        extra-flag:
            description: If the LED color depends on additional factors
            type: string
            required: false
            enum:
                - NONE
                - CHFLAG_FORCE_IDLE
                - CHFLAG_DEFAULT
                - BATT_BELOW_10
                - BATT_ABOVE_10

    child-binding:
        description: Color nodes describing color to set for this power state
        properties:
            led-color:
                type: string
                required: true
                enum:
                    - LED_OFF
                    - LED_RED
                    - LED_GREEN
                    - LED_BLUE
                    - LED_YELLOW
                    - LED_WHITE
                    - LED_AMBER
            period:
                description: In case of blinking LEDs, this is ON_SEC + OFF_SEC
                type: int
                required: false
```
