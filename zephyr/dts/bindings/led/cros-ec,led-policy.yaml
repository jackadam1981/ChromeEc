## zephyr/dts/bindings/led/cros-ec,led-policy.yaml
```yaml
# Copyright 2022 The Chromium OS Authors. All rights reserved.
# Use of this source code is governed by a BSD-style license that can be
# found in the LICENSE file.

description: LED inputs and triggers, used to drive LED actions

compatible: "cros-ec,led-policy"

include: base.yaml

properties:
  led:
    type: phandle
    required: true
    description: |
      Reference to the node lable of the LED to use
      for this policy.
      The inputs are checked in order and the first
      matching one is used.

child-binding:
  description: Input to check for match.
  properties:
    cpu:
      type: string
      required: false
      default: "ANY"
      description: |
        The AP state to check. ANY will match any state.
        This must be the same as enum led_ap_state.
      enum:
        - ANY
        - SUSPENDED
        - RUNNING
        - POWER_OFF
    charger:
      type: string
      required: false
      default: "ANY"
      description: |
        The charger state to match. ANY will match
        any charger state.
        This must be the same as enum led_charger_state.
      enum:
        - ANY
        - FULL
        - CHARGING
        - DISCHARGING
        - IDLE
        - ERROR
    battery:
      type: array
      required: false
      default: [0, 100]
      description: |
        Battery charge to match, as a percentage between 0 and 100.
        The current battery chrge is compared as

          if (charge >= battery[0] && charge <= battery[1])
                match...
    action:
      type: phandle
      required: true
      description: |
        Reference to the LED action, a child node of the LED driver
        configuration that defines the actual LED behaviour.
```

## zephyr/dts/bindings/led/cros-ec,multi-pwm-leds.yaml
```yaml
# Copyright 2022 The Chromium OS Authors. All rights reserved.
# Use of this source code is governed by a BSD-style license that can be
# found in the LICENSE file.

description: Multi-PWM LED configuration

compatible: "cros-ec,multi-pwm-leds"

include: base.yaml

properties:
  pwms:
    type: phandle-array
    required: true
    description: |
      List of the PWMs attached to the LEDs, up to 3 PWM devices.
      The duration is used when multiple colors are specified
      in a list, and indicates the duration the color is set for.

      For example
        led1 {
                compatible = "cros-ec,multi-pwm-leds";

                pwms = <&pwm1 0 PWM_POLARITY_INVERTED>,
                       <&pwm0 0 PWM_POLARITY_INVERTED>,
                       <&pwm2 0 PWM_POLARITY_INVERTED>;
        };

  frequency:
    type: int
    required: true
    description: |
      PWM frequency in Hz for LEDs.

  color-list:
    type: array
    required: true
    description: |
      Maps the requested colors from the EC host command
      to the appropriate PWM channel. So,

          color-list = <RED GREEN BLUE>;

      Would return the EC brightness array

          [255, 255, 255, 0, 0, 0]

child-binding:
  description: Colors and actions bound to this handler.
  properties:
    colors:
      type: array
      required: true
      description: |
        A list of colors/duration, as sets of four 8 bit values,
        interpreted as (R G B duration), where duration is
        tenths of a second. When more than one set is configured,
        the color sets are cycled through, with the duration
        providing the delay between changes.
        For example

          colors = <100 0 0 10>, <0 100 0 5>;

        This cycles through red (1 second) and green (1/2 second).
```

## zephyr/dts/bindings/led/cros-ec,pwm-leds.yaml
```yaml
# Copyright 2021 The Chromium OS Authors. All rights reserved.
# Use of this source code is governed by a BSD-style license that can be
# found in the LICENSE file.

description: PWM LED configuration

compatible: "cros-ec,pwm-leds"

include: base.yaml

properties:
  leds:
    type: phandles
    required: true
    description: |
      List of pwm-leds nodes. These are expected to have a pwms property
      pointing to the relevant PWMs, in red, green, blue and optionally sidesel
      order.

  color-map-red:
    type: array
    required: true
    description: |
      A map of PWM duty cycles per color, up to three channels.

  color-map-green:
    type: array
    required: true

  color-map-blue:
    type: array
    required: true

  color-map-yellow:
    type: array
    required: true

  color-map-white:
    type: array
    required: true

  color-map-amber:
    type: array
    required: true
```

## zephyr/dts/bindings/leds/cros-ec,led-id.yaml
```yaml
# Copyright 2022 The Chromium OS Authors. All rights reserved.
# Use of this source code is governed by a BSD-style license that can be
# found in the LICENSE file.

description: LED ID parent node

compatible: "cros-ec,led-id"

child-binding:
    description: List all the LED IDs supported as child nodes
                 Eg. led-id {
                        battery {
                          enum-name = "EC_LED_ID_BATTERY_LED";
                        };
                        power {
                          enum-name = "EC_LED_ID_BATTERY_LED";
                        };
                      };
    properties:
        enum-name:
            type: string
            required: true
            enum:
                - EC_LED_ID_BATTERY_LED
                - EC_LED_ID_POWER_LED
                - EC_LED_ID_ADAPTER_LED
                - EC_LED_ID_LEFT_LED
                - EC_LED_ID_RIGHT_LED
                - EC_LED_ID_RECOVERY_HW_REINIT_LED
                - EC_LED_ID_SYSRQ_DEBUG_LED
```

## zephyr/dts/bindings/leds/cros-ec,led-lightbar.yaml
```yaml
# Copyright 2024 The ChromiumOS Authors
# Use of this source code is governed by a BSD-style license that can be
# found in the LICENSE file.
description: CrOS EC Lightbar LED
compatible: "cros-ec,led-lightbar"
child-binding:
  description: |
    Node representing a specific color for the lightbar.
  properties:
    led-id:
      type: string
      description: |
        The EC LED ID for this lightbar. This should match one of the values
        from the ec_led_id enum.
      enum:
        - "EC_LED_ID_BATTERY_LED"
        - "EC_LED_ID_POWER_LED"
        - "EC_LED_ID_ADAPTER_LED"
        - "EC_LED_ID_LEFT_LED"
        - "EC_LED_ID_RIGHT_LED"
        - "EC_LED_ID_RECOVERY_HW_REINIT_LED"
        - "EC_LED_ID_SYSRQ_DEBUG_LED"
        - "EC_LED_ID_LIGHTBAR_LED"
    strip:
      type: phandles
      required: true
      description: Phandle to the LED strip device (e.g., ws2812).
  child-binding:
    description: Node representing a specific color for the lightbar.
    properties:
      led-color:
        type: string
        required: true
        description: |
          The color this node represents. This should match one of the values
          from the led_color enum.
        enum:
          - "LED_OFF"
          - "LED_RED"
          - "LED_GREEN"
          - "LED_BLUE"
          - "LED_YELLOW"
          - "LED_WHITE"
          - "LED_AMBER"
      color:
        type: int
        required: true
        description: RGB value for the color (e.g., 0xFF0000 for red).
```

## zephyr/dts/bindings/misc/cros-ec,prochot-vcmp.yaml
```yaml
# Copyright 2024 Google LLC
# Use of this source code is governed by a BSD-style license that can be
# found in the LICENSE file.

description: |
  PROCHOT signal detection, uses a voltage comparator device to detect
  transitions of the PROCHOT signal and log it on the console if the AP is
  active.

  Example configuration:

  prochot-vcmp {
      compatible = "cros-ec,prochot-vcmp";
      vcmp = <&vcmp0>;
      high-level-mv = <1050>;
      prochot {
          gpios = <&gpioi 0 (GPIO_ACTIVE_LOW | GPIO_LINE_OPEN_DRAIN)>;
          pinctrl-0 = <&adc0_ch0_gpi0_default>;
          pinctrl-1 = <&adc0_ch0_gpi0_gpio>;
          pinctrl-names = "default", "gpio";
      };
  };

  &vcmp0 {
      status = "okay";
      scan-period = <IT8XXX2_VCMP_SCAN_PERIOD_5MS>;
      comparison = <IT8XXX2_VCMP_GREATER>;
      threshold-mv = <0>;
      io-channels = <&adc0 0>;
  };

  &adc0 {
      pinctrl-0 = <&adc0_ch0_gpi0_default>; /* ...and other ADC signals */
      pinctrl-names = "default";
  };

  Note: the voltage comparator initial configuration is irrelevant, the device
  is reconfigured automatically in runtime.

compatible: "cros-ec,prochot-vcmp"

include: base.yaml

properties:
  vcmp:
    description: Voltage comparator device to use.
    type: phandle
    required: true

  high-level-mv:
    description: |
      Signal voltage for the high level, in millivolts, detection thresholds
      will be set to 10% and 90% of this value.
    type: int
    required: true

child-binding:
  description: |
    Optional PROCHOT GPIO settings.

    If a child node named "prochot" is present, then the prochot-vcmp driver
    supports both monitoring PROCHOT and asserting PROCHOT using the same
    pin on the EC.

    On initialization, the driver defaults to monitoring mode. If the EC
    application calls chipset_throttle_cpu(), then the driver reconfigures
    the PROCHOT pin as an output and asserts the pin.

  include:
    - name: pinctrl-device.yaml

  properties:
    gpios:
      type: phandle-array
      description: |
        The EC will assert this GPIO when an internal PROCHOT condition is
        triggered. This pin is typically an open-drain signal that is active
        low.

    pinctrl-0:
      required: true
      description: |
        Defines the pinctrl to configure the PROCHOT pin as an ADC input.

    pinctrl-1:
      required: true
      description: |
        Defines the pinctrl to configure the PROCHOT pin as GPIO output.

    pinctrl-names:
      required: true
```

## zephyr/dts/bindings/motionsense/cros-ec,motionsense-bodydetect.yaml
```yaml
# Copyright 2023 The ChromiumOS Authors
# Use of this source code is governed by a BSD-style license that can be
# found in the LICENSE file.

description: Body detection configuration parent node

compatible: "cros-ec,motionsense-bodydetect"

child-binding:
  description: Body detection configuration parameters
  properties:
    var_noise_factor:
      type: int
      required: false
      description: |
        The unit is percentage
        This is used for mitigate the effect of the noise from sensor.
        If set to 100%, the average noise is canceled out.
    var_threshold:
      type: int
      required: false
      description: |
        The unit is (mm/s^2)^2
        The motion confidence is calculated if the variance is within
        variance_threshold +/- confidence_delta. Otherwise, if variance
        is too high/low, confidence will be 100%/0%
    confidence_delta:
      type: int
      required: false
      description: |
        The unit is (mm/s^2)^2
        The motion confidence is calculated if the variance is within
        variance_threshold +/- confidence_delta. Otherwise, if variance
        is too high/low, confidence will be 100%/0%
#
# examples:
#
#  motionsense-bodydetect {
#         compatible = "cros-ec,motionsense-bodydetect";
#
#         base_bd_config: base_bd_config {
#             var_noise_factor = <150>;
#             var_threshold = <3000>;
#             confidence_delta = <2900>;
#         };
#
#         alternate_bd_config: alternate_bd_config {
#             var_noise_factor = <120>;
#             var_threshold = <550>;
#             confidence_delta = <525>;
#         };
# };
```

## zephyr/dts/bindings/motionsense/cros-ec,motionsense-mutex.yaml
```yaml
# Copyright (c) 2021 The Chromium OS Authors
# SPDX-License-Identifier: Apache-2.0

description: Motion sense mutex parent node

compatible: "cros-ec,motionsense-mutex"

child-binding:
  description: A mutex node is used to create a mutex_t instance and
               the instance is used by one or more motion sensor drivers.
  properties:
    label:
      required: true
      type: string
      description: Human readable string describing the mutex
```

## zephyr/dts/bindings/motionsense/cros-ec,motionsense-rotation-ref.yaml
```yaml
# Copyright (c) 2021 The Chromium OS Authors
# SPDX-License-Identifier: Apache-2.0

description: Motion sense rotation reference parent node

compatible: "cros-ec,motionsense-rotation-ref"

child-binding:
  description: A rotation matrix node is used to create a rotation matrix
               which is used by motion sensors.
  properties:
    mat33:
      required: true
      type: array
      description: 3x3 matrix to rotate x, y, and z axes.
```

## zephyr/dts/bindings/motionsense/cros-ec,motionsense-sensor-info.yaml
```yaml
# Copyright (c) 2021 The Chromium OS Authors
# SPDX-License-Identifier: Apache-2.0

description: The node has the information required by motion sense running

compatible: "cros-ec,motionsense-sensor-info"

properties:
  als-sensors:
    type: phandles
    required: false
    description: List of ALS sensors to create motion_als_sensors array
                 the ALS sensors listed in the motion_als_sensors array
                 are managed by motion sense task. the task reads the sensor
                 data from the sensors and put them into the designated part
                 in the ec mmap. For example, als_clear and als_rgb are aliases
                 of ALS sensor noded defined in motionsense-sensor node.
                 als-sensors = <&als_clear, &als_rgb>;
                 This will automatically generate motion_als_sensors array from it.

#
# examples:
#
# motionsense-sensor-info {
#        compatible = "cros-ec,motionsense-sensor-info";
#
#        /* list of entries for motion_als_sensors */
#        als-sensors = <&als_clear>;
# };
#
```

## zephyr/dts/bindings/motionsense/driver/cros-ec,bmi260-accel.yaml
```yaml
# Copyright (c) 2021 The Chromium OS Authors
# SPDX-License-Identifier: Apache-2.0

description: motion sense sensor node for BMI260 accel

compatible: "cros-ec,bmi260-accel"

include: bmi260.yaml
```

## zephyr/dts/bindings/motionsense/driver/cros-ec,bmi260-gyro.yaml
```yaml
# Copyright (c) 2021 The Chromium OS Authors
# SPDX-License-Identifier: Apache-2.0

description: motion sense sensor node for BMI260 gyro

compatible: "cros-ec,bmi260-gyro"

include: bmi260.yaml
```

## zephyr/dts/bindings/motionsense/driver/cros-ec,drv-bmi260-accel.yaml
```yaml
# Copyright (c) 2021 The Chromium OS Authors
# SPDX-License-Identifier: Apache-2.0

description: motion sense sensor node for BMI260 accel

compatible: "cros-ec,drv-bmi260-accel"

include: drv-bmi260.yaml
```

## zephyr/dts/bindings/motionsense/driver/cros-ec,drv-bmi260-gyro.yaml
```yaml
# Copyright (c) 2021 The Chromium OS Authors
# SPDX-License-Identifier: Apache-2.0

description: motion sense sensor node for BMI260 gyro

compatible: "cros-ec,drv-bmi260-gyro"

include: drv-bmi260.yaml
```

## zephyr/dts/bindings/motionsense/driver/cros-ec,drv-tcs3400-clear.yaml
```yaml
# Copyright (c) 2021 The Chromium OS Authors
# SPDX-License-Identifier: Apache-2.0

description: motion sense sensor node for TCS3400 CLEAR

compatible: "cros-ec,drv-tcs3400-clear"

include: drv-tcs3400.yaml
```

## zephyr/dts/bindings/motionsense/driver/cros-ec,drv-tcs3400-rgb.yaml
```yaml
# Copyright (c) 2021 The Chromium OS Authors
# SPDX-License-Identifier: Apache-2.0

description: motion sense sensor node for TCS3400 RGB

compatible: "cros-ec,drv-tcs3400-rgb"

include: drv-tcs3400.yaml
```

## zephyr/dts/bindings/motionsense/driver/cros-ec,tcs3400-clear.yaml
```yaml
# Copyright (c) 2021 The Chromium OS Authors
# SPDX-License-Identifier: Apache-2.0

description: motion sense sensor node for TCS3400 CLEAR

compatible: "cros-ec,tcs3400-clear"

include: tcs3400.yaml
```

## zephyr/dts/bindings/motionsense/driver/cros-ec,tcs3400-rgb.yaml
```yaml
# Copyright (c) 2021 The Chromium OS Authors
# SPDX-License-Identifier: Apache-2.0

description: motion sense sensor node for TCS3400 RGB

compatible: "cros-ec,tcs3400-rgb"

include: tcs3400.yaml
```
