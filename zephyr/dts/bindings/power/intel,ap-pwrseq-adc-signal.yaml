## zephyr/dts/bindings/temp/nxp,pct2075.yaml
```yaml
# Copyright 2022 The Chromium OS Authors. All rights reserved.
# Use of this source code is governed by a BSD-style license that can be
# found in the LICENSE file.

description: >
  Properties for a PCT2075 I2C temperature sensor

compatible: "nxp,pct2075"

include: i2c-device.yaml

properties:
  power-good-pin:
    type: phandle
    description:
      If this sensor will be unpowered some of the time, provide an input GPIO
      which can be referenced to detect whether the sensor is powered before
      reading.
```

## zephyr/dts/bindings/temp/temp-3v3-13k7-47k-4050b.yaml
```yaml
# Copyright 2021 The Chromium OS Authors. All rights reserved.
# Use of this source code is governed by a BSD-style license that can be
# found in the LICENSE file.

description: Thermistor 3v3-13k7-47k-4050b

compatible: "temp-3v3-13k7-47k-4050b"

properties:
    label:
      required: true
      type: string
      description:
        Human-readable string describing the device (used as
        device_get_binding() argument)
    adc:
      required: yes
      type: phandle
      description: named-adc child node connected to the thermistor
```

## zephyr/dts/bindings/temp/temp-3v3-51k1-47k-4050b.yaml
```yaml
# Copyright 2021 The Chromium OS Authors. All rights reserved.
# Use of this source code is governed by a BSD-style license that can be
# found in the LICENSE file.

description: Thermistor 3v3-51k1-47k-4050b

compatible: "temp-3v3-51k1-47k-4050b"

properties:
    label:
      required: true
      type: string
      description:
        Human-readable string describing the device (used as
        device_get_binding() argument)
    index:
      required: yes
      type: int
      description: Index used to get the mesurument - ADC channel
```

## zephyr/dts/bindings/temp/temp_sensor.yaml
```yaml
# Copyright 2021 The Chromium OS Authors. All rights reserved.
# Use of this source code is governed by a BSD-style license that can be
# found in the LICENSE file.

# Common properties for temperature sensors
# Zero values in degrees K(-273 in degrees C)in thermal thresholds will
# be ignored

properties:
    label:
      required: true
      type: string
      description:
        Human-readable string describing the device (used as
        device_get_binding() argument)

    enum-name:
      type: string
      required: true
      description:
        Enum values used in the source code to refer to the temperature sensors
      enum:
      - TEMP_SENSOR_CHARGER
      - TEMP_SENSOR_DDR_SOC
      - TEMP_SENSOR_FAN
      - TEMP_SENSOR_PP3300_REGULATOR

    get-temp-func:
      type: string
      required: true
      description: >
        Name of the board-provided function which reads the temperature. If you
        have different values and need to add a new function, you can add that
        here.

        The name is get_temp_<v>_<rs>_<rn>_<b>:

        v: voltage of resistor-divider circuit
        rs: value of the resistor that is in series with the thermistor
        rn: nominal resistance of thermistor at 25C
        b: B value for temperature range 25C to 100C

        See https://www.electronics-tutorials.ws/io/thermistors.html for more
        information.

      enum:
      - get_temp_3v0_22k6_47k_4050b
      - get_temp_3v3_13k7_47k_4050b
      - get_temp_3v3_30k9_47k_4050b
      - get_temp_3v3_51k1_47k_4050b
      - get_temp_6v0_51k1_47k_4050b

    temp_fan_off:
      required: false
      type: int
      default: -273
      description:
        Temperature threshold in degrees C when no active cooling
        is needed

    temp_fan_max:
      required: false
      type: int
      default: -273
      description:
        Temperature threshold in degrees C when max active cooling
        is needed

    temp_host_warn:
      required: false
      type: int
      default: -273
      description:
        Temperature threshold in degrees C of thermal warn.
        Temperatures above the thermal warn threshold generate a
        request to the AP to throttle itself.

    temp_host_high:
      required: false
      type: int
      default: -273
      description:
        Temperature threshold in degrees C of thermal high.
        Temperatures above the thermal high threshold cause the EC to
        assert a signal (usually PROCHOT) to the AP and force the AP to
        throttle.

    temp_host_halt:
      required: false
      type: int
      default: -273
      description:
        Temperature threshold in degrees C that forces AP to shutdown
        due to thermal reason

    temp_host_release_warn:
      required: false
      type: int
      default: -273
      description:
        Temperature release threshold in degrees C of thermal warn

    temp_host_release_high:
      required: false
      type: int
      default: -273
      description:
        Temperature release threshold in degrees C of thermal high

    temp_host_release_halt:
      required: false
      type: int
      default: -273
      description:
        Temperature release threshold in degrees C of thermal shutdown
```

## zephyr/dts/bindings/temp/thermistor.yaml
```yaml
# Copyright 2021 The Chromium OS Authors. All rights reserved.
# Use of this source code is governed by a BSD-style license that can be
# found in the LICENSE file.

# See https://www.electronics-tutorials.ws/io/thermistors.html for more information.

description: Common properties for thermistors

compatible: cros,thermistor

properties:

  scaling-factor:
    required: true
    type: int
    description: Scaling factor for voltage pairs

  num-pairs:
    required: true
    type: int
    description: Number of sample data points for linear interpolation

  steinhart-reference-mv:
    required: true
    type: int
    description: >
      Used only for testing.
      Is the reference voltage for temperature 25C.

  steinhart-reference-res:
    required: true
    type: int
    description: >
      Used only for testing.
      Is the reference resistance for temperature 25C.

child-binding:
  description: >
    Data samples derived from Steinhart-Hart equation in a resistor divider circuit.
    Used in linear interpolation.

  properties:
    milivolt:
      type: int
      required: true
      description: Voltage reading for a given temperature sample

    temp:
      type: int
      required: true
      description: Temperature in a datum sample

    sample-number:
      type: int
      required: true
      description: The index of a datum to maintain sample order to interpolate.
```

## zephyr/dts/bindings/touchpad/elan,ekth3000.yaml
```yaml
# Copyright 2023 The ChromiumOS Authors
# Use of this source code is governed by a BSD-style license that can be
# found in the LICENSE file.

description: Elan I2C touchpad

compatible: "elan,ekth3000"

include: i2c-device.yaml

properties:
  irq:
    type: phandle
    required: true
    description: Interrupt from touchpad
  en-pin:
    type: phandle
    required: false
    description:
      Optional enable pin. Logical high means enabled.

      If not defined, board must implement a customized
      reset callback function `board_touchpad_reset()`.
```

## zephyr/dts/bindings/touchpad/pixart,pct1x36.yaml
```yaml
# Copyright 2023 The ChromiumOS Authors
# Use of this source code is governed by a BSD-style license that can be
# found in the LICENSE file.

description: PIX I2C touchpad

compatible: "pixart,pct1x36"

include: i2c-device.yaml

properties:
  irq:
    type: phandle
    required: true
    description: Interrupt from touchpad

  logical_max_x:
    type: int
    required: true
    description: The logical maximum x-axis setting

  logical_max_y:
    type: int
    required: true
    description: The logical maximum y-axis setting

  physical_max_x:
    type: int
    required: true
    description: The physical maximum x-axis setting

  physical_max_y:
    type: int
    required: true
    description: The physical maximum y-axis setting
```
