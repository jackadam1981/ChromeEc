## zephyr/dts/bindings/power/intel,ap-pwrseq-adc-signal.yaml
```yaml
# Copyright 2022 The Chromium OS Authors. All rights reserved.
# Use of this source code is governed by a BSD-style license that can be
# found in the LICENSE file.

description: Power sequence analog signals container.

compatible: "intel,ap-pwrseq-adc-signal"

child-binding:
  description: ADC comparators used to produce power signal
  properties:
    trigger-high:
      description: Rising edge trigger adc comparator
      type: phandle
      required: true

    trigger-low:
      description: Falling edge trigger adc comparator
      type: phandle
      required: true

    pwrseq-signal-enum:
        type: string
        required: true
        description: Enumeration values for power signals
```

## zephyr/dts/bindings/power/intel,ap-pwrseq-interrupt.yaml
```yaml
# Copyright 2022 The Chromium OS Authors. All rights reserved.
# Use of this source code is governed by a BSD-style license that can be
# found in the LICENSE file.

description: For power signal as a cros-ec,gpio-interrupts node

compatible: "intel,ap-pwrseq-interrupt"

include: intel,ap-pwr-signal-base.yaml
properties:
    interrupt:
        type: phandle
        required: true
        description: |
          Named interrupt node to be used for power signal. The
          GPIO referenced in the interrupt node is used as the
          power signal input.

    no-enable:
        type: boolean
        description: Do not enable interrupt on start-up
```

## zephyr/dts/bindings/power/intel,ap-pwrseq-named-gpio.yaml
```yaml
# Copyright 2022 The Chromium OS Authors. All rights reserved.
# Use of this source code is governed by a BSD-style license that can be
# found in the LICENSE file.

description: Node for power signal named-gpio

compatible: "intel,ap-pwrseq-named-gpio"

include: intel,ap-pwr-signal-base.yaml
properties:
    pin:
        type: phandle
        required: true
        description: |
          Named GPIO to be used for power signal.

    output:
        type: boolean
        description: GPIO is used as an output.
```

## zephyr/dts/bindings/power/intel,ap-pwrseq-signal-list.yaml
```yaml
# Copyright 2022 The Chromium OS Authors. All rights reserved.
# Use of this source code is governed by a BSD-style license that can be
# found in the LICENSE file.

description: Power sequence signals information list.
    The signals could be GPIO signals, eSPI signals through virtual wire.

compatible: "intel,ap-pwrseq-signal-list"

properties:
    pwrseq-signals-required:
        description:
            Total of power signals in power sequence, including GPIOs and
            virtual wires
        type: int
        required: true

child-binding:
    description: Power sequence signals list child node
    properties:
        dbg-label:
            type: string
            required: true
            description: Label of power signals used in debug messages

        source:
            type: int
            required: true
            description: indicates which source generates the power signal
                         0 - GPIO pin
                         1 - ESPI through virtual wire
                         2 - Others, ADC, etc

        pwrseq-int-gpios:
            type: phandle-array
            required: false
            description: Associated GPIO interrupts pin

        pwrseq-int-flags:
            type: int
            required: false
            description: GPIO interrupt configuration flags.

        pwrseq-vw-enum:
            type: string
            required: false
            description: Enumeration value to eSPI signals that can be sent
              or received through virtual wire channel
            enum:
            - ESPI_VWIRE_SIGNAL_SLP_S3
            - ESPI_VWIRE_SIGNAL_SLP_S4
            - ESPI_VWIRE_SIGNAL_SLP_S5

        pwrseq-signal-enum:
            type: string
            required: true
            description: Enumeration values for power signals

        flags:
            type: int
            required: true
            description: bit 0 represents active in high or low state
                         bit 1 Disable signal at boot up
              bit[0] = 1 active high
              bit[0] = 0 active low
              bit[1] = 1 During boot up, disable interrupt of this signal
              bit[1] = 0 Enable interrupt of signal during boot up
```

## zephyr/dts/bindings/power/intel,ap-pwrseq.yaml
```yaml
 # Copyright 2022 The Chromium OS Authors. All rights reserved.
 # Use of this source code is governed by a BSD-style license that can be
 # found in the LICENSE file.

description: |
    Common fields for AP power sequence configuration
    The configuration consists of a number of mostly timing
    related values, as well as child nodes defining the
    different power signals and controls.

    Different types of power signal sources can be set, such as
    input GPIOs, output GPIOs ESPI virtual wire, and board specific sources.
    The source is determined by the properties set in the child node.
    They should be considered mutually exclusive.

compatible: "intel,ap-pwrseq"

properties:
    dsw-pwrok-delay:
      type: int
      required: false
      default: 10
      description: |
        Delay to set DSW_PWROK high to PCH after 3.3V rail stable,
        in milliseconds.

    rsmrst-delay:
      type: int
      required: false
      default: 10
      description: |
        Delay to set RSMRST from EC to SoC, in milliseconds.

    sys-pwrok-delay:
      type: int
      required: false
      default: 45
      description: |
        Delay from PG_EC_ALL_SYS_PWRGD high to set EC_PCH_SYS_PWROK high,
        in milliseconds.

    pm-pwrbtn-delay:
      type: int
      required: false
      default: 200
      description: |
        Power button delay, in milliseconds.

    pch-pwrok-delay:
      type: int
      required: false
      default: 2
      description: |
        Delay in ms from IMVP9_VRRDY high to PCH_PWROK high delay.

    vccst-pwrgd-delay:
      type: int
      required: false
      default: 2
      description: |
        Delay in ms from PG_EC_ALL_SYS_PWRGD high
        to VCCST_PWRGD high.

    sys-reset-delay:
      type: int
      required: false
      default: 32
      description: Debounce time for SYS_RESET_L.

    vrrdy-timeout:
      type: int
      required: false
      default: 50
      description: |
        Timeout in ms for IMVP9_VRRDY high.

    all-sys-pwrgd-timeout:
      type: int
      required: false
      default: 0
      description: |
        Timeout in ms for ALL_SYS_PWRGD input to EC to be high.

    wait-signal-timeout:
      type: int
      required: false
      default: 1000
      description: |
        Timeout in ms for monitoring power signals.

    pwrseq-espi-max-freq:
      type: int
      required: false
      default: 20
      description: |
        Maximum configured frequency for espi channel.

child-binding:
    description: |
        Power sequence signals list child node.

        All signals are treated as logical signals i.e a value of 1
        is an asserted signal. For signals that are inverted at the
        physical source, they should be configured to be read as an
        active low signal and converted to a logical signal e.g for
        GPIOs that are an active low signal, the GPIO_ACTIVE_LOW
        flag should be set in the GPIO flags.

    properties:
        # The first 2 properties are common for all types of sources
        dbg-label:
            type: string
            required: true
            description: Label of power signals used in debug messages

        enum-name:
            type: string
            required: true
            description: Enumeration values for power signals
            enum:
            - PWR_PG_EC_DSW_PWROK
            - PWR_EC_PCH_RSMRST
            - PWR_EN_PP5000_A
            - PWR_PG_EC_RSMRST
            - PWR_SLP_S3
            - PWR_ALL_SYS_PWRGD
            - PWR_SYS_RST
            - PWR_EC_PCH_SYS_PWROK
            - PWR_PCH_PWROK
            - PWR_IMVP9_VRRDY
            - PWR_VCCST_PWRGD
            - PWR_SLP_SUS

        # The next properties is specific for output GPIOs.
        output-gpios:
            type: phandle-array
            required: false
            description: Output GPIO.

        # The next 3 properties are specific for input GPIOs.
        input-gpios:
            type: phandle-array
            required: false
            description: |
              GPIO to be used for input signal. Input GPIOs can be
              configured to generate an interrupt if the 'interrupt-flags'
              property is set with the appropriate interrupt flags.

        interrupt-flags:
            type: int
            required: false
            description: GPIO interrupt configuration flags.

        enable-interrupt-on-boot:
            type: boolean
            description: true - Enable GPIO interrupt at boot up;
                         false - Do not enable GPIO interrupt at boot up.

        # Defined for a virtual wire signal source.
        virtual-wire:
            type: string
            required: false
            description: |
              Enumeration value to eSPI signals that can be sent
              or received through virtual wire channel

            enum:
            - ESPI_VWIRE_SIGNAL_SLP_S3
            - ESPI_VWIRE_SIGNAL_SLP_S4
            - ESPI_VWIRE_SIGNAL_SLP_S5

        # Defined for a board provided signal.
        external:
            type: boolean
            description: |
              A signal that is provided from an external board
              specific function.
```

## zephyr/dts/bindings/power/qcom,ap-pwr-signal-base.yaml
```yaml
# Copyright 2026 The ChromiumOS Authors
# Use of this source code is governed by a BSD-style license that can be
# found in the LICENSE file.

description: |
    Common base for Qualcomm AP power sequence signals.

properties:
  dbg-label:
    type: string
    required: true
    description: Label of power signals used in debug messages

  enum-name:
    type: string
    required: true
    description: Enumeration values for power signals.
    enum:
    - PWR_AP_RST_L
    - PWR_AP_SUSPEND
    - PWR_PMIC_KPD_PWR_L
    - PWR_PMIC_RESIN_L
    - PWR_POWER_GOOD
    - PWR_PS_HOLD

  reset-val:
    type: int
    default: 0
    description: |
      Logical level (active/inactive) to set this signal to on power sequencing
      reset.
```

## zephyr/dts/bindings/power/qcom,ap-pwrseq-gpio.yaml
```yaml
# Copyright 2026 The ChromiumOS Authors
# Use of this source code is governed by a BSD-style license that can be
# found in the LICENSE file.

description: Node for Qualcomm power signal GPIO

compatible: "qcom,ap-pwrseq-gpio"

include: qcom,ap-pwr-signal-base.yaml
properties:
  gpios:
    type: phandle-array
    required: true
    description: |
      GPIO to be used for power signal. Input GPIOs can be
      configured to generate an interrupt if the 'interrupt-flags'
      property is set with the appropriate interrupt flags.

  output:
    type: boolean
    description: Output GPIO. No interrupts used.

  interrupt-flags:
    type: int
    description: GPIO interrupt configuration flags.

  no-enable:
    type: boolean
    description: Do not enable interrupt on start-up.
```

## zephyr/dts/bindings/pwm/pwm-keys.yaml
```yaml
# Copyright (c) 2020 The Chromium OS Authors
# SPDX-License-Identifier: Apache-2.0

description: PWM KEYS parent node

compatible: "pwm-keys"

child-binding:
  description: PWM KEYS child node
  properties:
    pwms:
      type: phandle-array
      required: true
    label:
      required: true
      type: string
      description:
        Human readable string describing the device (used as
        device_get_binding() argument)
    frequency:
      required: true
      type: int
      description: PWM frequency, in Hz
```

## zephyr/dts/bindings/retimer/intel,jhl8040r.yaml
```yaml
# Copyright 2021 The Chromium OS Authors. All rights reserved.
# Use of this source code is governed by a BSD-style license that can be
# found in the LICENSE file.

description: Intel JHL8040R Thunderbolt 4 Retimer

compatible: "intel,jhl8040r"

include: base.yaml

properties:
    reg:
      required: true

    label:
      required: true

    reset-gpios:
      type: phandle-array
      required: true

    int-gpios:
      type: phandle-array
      required: false

    ls-en-gpios:
      type: phandle-array
      required: false
```

## zephyr/dts/bindings/tcpc/named-tcpc-ports.yaml
```yaml
# Copyright (c) 2021 The Chromium OS Authors
# SPDX-License-Identifier: Apache-2.0

description: Named TCPC ports parent node

compatible: "named-tcpc-ports"

child-binding:
  description: Named TCPC ports child node
    
  properties:
    tcpc-port:
      type: phandle
      required: true
    enum-name:
      type: string
      required: true
      description:
        Enum values used in the source code to refer to the TCPC port
      enum:
      - USBC_PORT_C0
      - USBC_PORT_C1
      - USBC_PORT_C2

    label:
      required: true
      type: string
      description:
        Human readable string describing the device (used as device_get_binding()
        argument).
```

## zephyr/dts/bindings/temp/amd,sb-tsi.yaml
```yaml
# Copyright 2021 The Chromium OS Authors. All rights reserved.
# Use of this source code is governed by a BSD-style license that can be
# found in the LICENSE file.

description: >
  Properties for an Side Band Temperature Sensor Interface sensor

compatible: "amd,sb-tsi"

include: i2c-device.yaml

properties:
    power-good-pin:
      type: phandle
      description:
        If this sensor will be unpowered some of the time, provide an input GPIO
        which can be referenced to detect whether the sensor is powered before
        reading.
```

## zephyr/dts/bindings/temp/cros-ec,temp-sensor-apl6012.yaml
```yaml
# Copyright 2025 The ChromiumOS Authors
# Use of this source code is governed by a BSD-style license that can be
# found in the LICENSE file.

description: >
  Properties for a APL6012 I2C temperature sensor

compatible: "cros-ec,temp-sensor-apl6012"

include: i2c-device.yaml

properties:
  temperature-type:
    type: string
    required: true
    description:
      One temperature sensor have 15 channel sensor types.
    enum:
      - APL6012_IDX_CH1
      - APL6012_IDX_CH2
      - APL6012_IDX_CH3
      - APL6012_IDX_CH4
      - APL6012_IDX_CH5
      - APL6012_IDX_CH6
      - APL6012_IDX_CH7
      - APL6012_IDX_CH8
      - APL6012_IDX_CH9
      - APL6012_IDX_CH10
      - APL6012_IDX_CH11
      - APL6012_IDX_CH12
      - APL6012_IDX_CH13
      - APL6012_IDX_CH14
      - APL6012_IDX_CH15
```

## zephyr/dts/bindings/temp/cros-ec,temp-sensor-thermistor.yaml
```yaml
# Copyright 2021 The Chromium OS Authors. All rights reserved.
# Use of this source code is governed by a BSD-style license that can be
# found in the LICENSE file.

description: >
  Properties for a thermistor temperature sensor

compatible: "cros-ec,temp-sensor-thermistor"

properties:
    adc:
      required: true
      type: phandle
      description: The named adc channel

    thermistor:
      type: phandle
      description: Underlying thermistor device

    power-good-pin:
      type: phandle
      description:
        If this sensor will be unpowered some of the time, provide an input GPIO
        which can be referenced to detect whether the sensor is powered before
        reading.
```
