## zephyr/dts/bindings/intel/intel,modular-aic-slot.yaml
```yaml
# Copyright 2024 The ChromiumOS Authors
# Use of this source code is governed by a BSD-style license that can be
# found in the LICENSE file.

description: Intel modular add-in card (AIC) slot

compatible: "intel,modular-aic-slot"

properties:
  reg:
    type: array
    required: true
    description: |
      Number associated to modular AIC slot. Each AIC slot must be associated
      with an id, starting from zero, this is the index of each instance within
      the instances array.
  detect-gpios:
    type: phandle-array
    required: true
    description: |
      GPIO used to detect AIC presence in platform. This is a required property
      since it is the most basic mechanism used for card detection in case
      EEPROM is not available. If EEPROM is not assigned, slot properties are
      obtained from devicetree.
  detection-power-state:
    type: string
    default: AP_POWER_STATE_UNDEF
    description: |
      AP power state that will trigger AIC detection. In case `detect-gpios`
      power rail is turned on during an AP Power state, this
      node property can be used to associate detection with AP power state.
      If power state is not provided, detection will be executed during EC
      system initialization.
  available-ports:
    type: int
    default: 1
    description: |
      Number of available ports supported by this slot.
  ports:
    type: phandles
    required: false
    description: |
      List of ports that can be connected to this slot based on parameters,
      connection is established dybamically.
  conn-type:
    type: string
    default: INTEL_MODULAR_AIC_PORT_CONN_TYPE_RESERVED
    description: |
      Determines the type of connection this slot supports.
    enum:
      - INTEL_MODULAR_AIC_PORT_CONN_TYPE_RESERVED
      - INTEL_MODULAR_AIC_PORT_CONN_TYPE_USBA
      - INTEL_MODULAR_AIC_PORT_CONN_TYPE_USBC
      - INTEL_MODULAR_AIC_PORT_CONN_TYPE_HDMI
      - INTEL_MODULAR_AIC_PORT_CONN_TYPE_DP
      - INTEL_MODULAR_AIC_PORT_CONN_TYPE_EDP
  max-data-speed:
    type: string
    default: INTEL_MODULAR_AIC_PORT_DATA_SPEED_UNDEFINED
    description: |
      Sets the speed the IO lines shall be expecting from external device.
    enum:
      - INTEL_MODULAR_AIC_PORT_DATA_SPEED_UNDEFINED
      - INTEL_MODULAR_AIC_PORT_DATA_SPEED_6GBPS
      - INTEL_MODULAR_AIC_PORT_DATA_SPEED_12GBPS
      - INTEL_MODULAR_AIC_PORT_DATA_SPEED_20GBPS
      - INTEL_MODULAR_AIC_PORT_DATA_SPEED_40GBPS
      - INTEL_MODULAR_AIC_PORT_DATA_SPEED_80GBPS
```

## zephyr/dts/bindings/intel/intel,modular-aic-usbc-port.yaml
```yaml
# Copyright 2025 The ChromiumOS Authors
# Use of this source code is governed by a BSD-style license that can be
# found in the LICENSE file.

description: Intel modular add-in card (AIC) USB-C port

compatible: "intel,modular-aic-usbc-port"

properties:
  devices:
    type: phandles
    required: false
    description: |
      List of devices bound to an AIC depending on its properties. Any driver
      whose execution depends on device detection by an AIC, can be listed in
      this property to condition its initialization, and establish
      initialization order in case multiple drivers are dependant.
      It is mandatory that all drivers listed here must have property
      `zephyr,deferred-init` set as part of its node definition; this is to
      ensure its initialization is executed at the right time once AIC detection
      has been completed.
  retimer-status:
    type: string
    default: INTEL_MODULAR_AIC_PORT_RETIMER_NOT_PRESENT
    description: |
      Sets the retimer type in the AIC, this property is relevant only when
      connection type is configured as USBC.
    enum:
      - INTEL_MODULAR_AIC_PORT_RETIMER_NOT_PRESENT
      - INTEL_MODULAR_AIC_PORT_RETIMER_SINGLE
      - INTEL_MODULAR_AIC_PORT_RETIMER_DUAL
  pd-cntrl-type:
    type: string
    default: INTEL_MODULAR_AIC_PORT_PD_CNTRL_UNDEFINED
    description: |
      Determines the PD chip vendor a slot is capable of recognizing.
      This property is also relevant only when the connection type is USBC.
    enum:
      - INTEL_MODULAR_AIC_PORT_PD_CNTRL_UNDEFINED
      - INTEL_MODULAR_AIC_PORT_PD_CNTRL_TI
      - INTEL_MODULAR_AIC_PORT_PD_CNTRL_CYPRESS
      - INTEL_MODULAR_AIC_PORT_PD_CNTRL_REALTEK
      - INTEL_MODULAR_AIC_PORT_PD_CNTRL_GOTHIC_BRIDGE
  tbt-status:
    type: string
    default: INTEL_MODULAR_AIC_PORT_TBT_NOT_CAPABLE
    description: |
      Sets if AIC is Thunderbolt (TBT) capable. This property is also relevant
      only when the connection type is USBC.
    enum:
      - INTEL_MODULAR_AIC_PORT_TBT_NOT_CAPABLE
      - INTEL_MODULAR_AIC_PORT_TBT_CAPABLE
  data-speed:
    type: string
    default: INTEL_MODULAR_AIC_PORT_DATA_SPEED_UNDEFINED
    description: |
      Sets the speed the IO lines shall be expecting from external device.
    enum:
      - INTEL_MODULAR_AIC_PORT_DATA_SPEED_UNDEFINED
      - INTEL_MODULAR_AIC_PORT_DATA_SPEED_6GBPS
      - INTEL_MODULAR_AIC_PORT_DATA_SPEED_12GBPS
      - INTEL_MODULAR_AIC_PORT_DATA_SPEED_20GBPS
      - INTEL_MODULAR_AIC_PORT_DATA_SPEED_40GBPS
      - INTEL_MODULAR_AIC_PORT_DATA_SPEED_80GBPS
```

## zephyr/dts/bindings/intelrvp/intelrvp-board-id.yaml
```yaml
# Copyright 2022 The Chromium OS Authors. All rights reserved.
# Use of this source code is governed by a BSD-style license that can be
# found in the LICENSE file.

description: Intel RVP Board id

compatible: "intelrvp-board-id"

properties:
    i2c-port:
      type: phandle
      required: true
      description:
        I2C port to read intel RVP board ID.

    i2c-addr:
      type: int
      required: true
      description:
        I2C address to read Intel RVP board ID.
```

## zephyr/dts/bindings/led/cros-ec,gpio-leds.yaml
```yaml
# Copyright 2022 The Chromium OS Authors. All rights reserved.
# Use of this source code is governed by a BSD-style license that can be
# found in the LICENSE file.

description: GPIO LED configuration

compatible: "cros-ec,gpio-leds"

include: base.yaml

properties:
  gpios:
    type: phandle-array
    required: true
    description: |
      List of the GPIOs controlling the LEDs. GPIO_ACTIVE_LOW
      can be used for open drain inverted driving of the signal.

      For example
        led1 {
                compatible = "cros-ec,gpio-leds";

                pwms = <&gpioc 3 GPIO_ACTIVE_LOW>,
                       <&gpioc 4 GPIO_ACTIVE_LOW>;
        };

  color-list:
    type: array
    required: true
    description: |
      Maps the requested colors from the EC host command
      to the appropriate GPIO channel. So,

          color-list = <BLUE YELLOW>;

      Would return the EC brightness array

          [0, 0, 1, 1, 0, 0]

child-binding:
  description: Colors and actions bound to this handler.
  properties:
    colors:
      type: array
      required: true
      description: |
        A list of colors/duration, as sets of 8 bit values,
        interpreted as (colors.. duration), where the number
        of colors matches the number of GPIOs, and duration is
        tenths of a second. The colors can be set as {0,1}
        for off and on.  When more than one set is configured,
        the color sets are cycled through, with the duration
        providing the delay between changes.
        For example

          colors = <1 0 10>, <0 1 5>;

        This cycles through blue (1 second) and yellow (1/2 second).
```
