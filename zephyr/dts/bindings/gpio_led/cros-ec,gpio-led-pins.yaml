## zephyr/dts/bindings/gpio_led/cros-ec,gpio-led-pins.yaml
```yaml
# Copyright 2022 The Chromium OS Authors. All rights reserved.
# Use of this source code is governed by a BSD-style license that can be
# found in the LICENSE file.

description: GPIO LED pins parent node

compatible: "cros-ec,gpio-led-pins"

child-binding:
    description: Each child node describes all the GPIO pins that need to be
                 altered to set a specific color for a particular LED type.

                 Eg. for a board supporting Blue and Amber BAT LEDs on left
                 and right ports, to set LED_AMBER color on left port,
                 Amber LED will need to be set to 1 and blue LED to 0.
                 color-amber-left {
                              led-color = "LED_AMBER";
                              led-type = BATT_LED_LEFT;
                              led-pins = <&gpio_ec_chg_led_y_c1 1>,
                                         <&gpio_ec_chg_led_b_c1 0>;
                                         <&gpio_ec_chg_led_y_c0 0>;
                                         <&gpio_ec_chg_led_b_c0 0>;
                             };
    properties:
        led-color:
            type: string
            required: true
            enum:
                - LED_OFF
                - LED_RED
                - LED_GREEN
                - LED_BLUE
                - LED_YELLOW
                - LED_WHITE
                - LED_AMBER
        led-type:
            type: string
            required: false
            enum:
                - BATT_LED_ANY
                - BATT_LED_LEFT
                - BATT_LED_RIGHT
                - POWER_LED
        led-pins:
            type: phandle-array
            required: false
```

## zephyr/dts/bindings/gpio_led/cros-ec,led-brightness-range.yaml
```yaml
# Copyright 2022 The Chromium OS Authors. All rights reserved.
# Use of this source code is governed by a BSD-style license that can be
# found in the LICENSE file.

description: Brightness range array to specifiy which LEDs are enabled

compatible: "cros-ec,led-brightness-range"

properties:
    brightness-range-battery:
        type: array
        required: true
        description: Brightness range values for gpio leds,
                     1 for the enabled LEDs, otherwise 0

    brightness-range-power:
        type: array
        required: false
        description: Brightness range values for gpio leds,
                     1 for the enabled LEDs, otherwise 0
```

## zephyr/dts/bindings/gpio_led/cros-ec,led-color-enums.yaml
```yaml
# Copyright 2022 The Chromium OS Authors. All rights reserved.
# Use of this source code is governed by a BSD-style license that can be
# found in the LICENSE file.

description: GPIO LED color enums. This is used to create board specific
             LED_COLOR enums for the supported colors

compatible: "cros-ec,led-color-enums"

child-binding:
    description: LED color nodes with enum prop
    properties:
      enum-name:
        type: string
        required: true
        enum:
            - LED_RED
            - LED_GREEN
            - LED_BLUE
            - LED_YELLOW
            - LED_AMBER
            - LED_WHITE
```

## zephyr/dts/bindings/gpio_led/cros-ec,led-id-enums.yaml
```yaml
# Copyright 2022 The Chromium OS Authors. All rights reserved.
# Use of this source code is governed by a BSD-style license that can be
# found in the LICENSE file.

description: GPIO LED ID enum.

compatible: "cros-ec,led-id-enums"

child-binding:
    description: LED ID nodes with enum prop
    properties:
      enum-name:
        type: string
        required: true
        enum:
            - EC_LED_ID_BATTERY_LED
            - EC_LED_ID_POWER_LED
            - EC_LED_ID_ADAPTER_LED
            - EC_LED_ID_LEFT_LED
            - EC_LED_ID_RIGHT_LED
            - EC_LED_ID_RECOVERY_HW_REINIT_LED
            - EC_LED_ID_SYSRQ_DEBUG_LED
```

## zephyr/dts/bindings/gpio_led/current-board.yaml
```yaml
# Copyright 2021 The Chromium OS Authors. All rights reserved.
# Use of this source code is governed by a BSD-style license that can be
# found in the LICENSE file.
description: Current board name

compatible: "current-board"

properties:
    current-board-name:
        type: string 
        required: true
        description: Current board name
        enum:
            - COACHZ
            - HOMESTAR
            - LAZOR
            - MARZIPAN
            - MRBLAND
            - PAZQUEL
            - POMPOM
            - WORMDINGLER
```

## zephyr/dts/bindings/gpio_led/led-id-enum.yaml
```yaml
# Copyright 2021 The Chromium OS Authors. All rights reserved.
# Use of this source code is governed by a BSD-style license that can be
# found in the LICENSE file.

description: LED ID enum parent node

compatible: "led-id-enum"

child-binding:
    description: IDs for the LEDs supported on the device
    properties:
        enum-name:
            type: string
            required: true
            enum:
                - EC_LED_ID_BATTERY_LED
                - EC_LED_ID_POWER_LED
```

## zephyr/dts/bindings/gpio_led/power-led-colors.yaml
```yaml
# Copyright 2021 The Chromium OS Authors. All rights reserved.
# Use of this source code is governed by a BSD-style license that can be
# found in the LICENSE file.

description: Power LED colors parent node

compatible: "power-led-colors"

child-binding:
    description: These properties set the LED color based on the power
                 state of the system.
    properties:
        led-color:
            type: string
            required: false
            enum:
                - LED_OFF
                - LED_RED
                - LED_GREEN
                - LED_BLUE
                - LED_YELLOW
                - LED_AMBER
                - LED_WHITE

        led-color-1:
            type: string
            required: false
            enum:
                - LED_OFF
                - LED_RED
                - LED_GREEN
                - LED_BLUE
                - LED_YELLOW
                - LED_AMBER
                - LED_WHITE

        led-color-2:
            type: string
            required: false
            enum:
                - LED_OFF
                - LED_RED
                - LED_GREEN
                - LED_BLUE
                - LED_YELLOW
                - LED_AMBER
                - LED_WHITE

        period:
            type: int
            required: false
            description: If blinking LEDs, what's the period value
```

## zephyr/dts/bindings/i2c/cros-ec,i2c-port-eeprom.yaml
```yaml
# Copyright (c) 2021 The Chromium OS Authors
# SPDX-License-Identifier: Apache-2.0

description: I2C port properties for the EEPROM node

compatible: "cros-ec,i2c-port-eeprom"

include: [cros-ec-i2c-port.yaml]

properties:
  flags:
    type: int
    description:
      EEPROM flags.
```

## zephyr/dts/bindings/i2c/cros-ec,i2c-port-power.yaml
```yaml
# Copyright (c) 2021 The Chromium OS Authors
# SPDX-License-Identifier: Apache-2.0

description: I2C port attached to the power button

compatible: "cros-ec,i2c-port-power"
```

## zephyr/dts/bindings/i2c/cros-i2c-port-power.yaml
```yaml
# Copyright (c) 2021 The Chromium OS Authors
# SPDX-License-Identifier: Apache-2.0

description: I2C port attached to the power button

compatible: "cros,i2c-port-power"
```

## zephyr/dts/bindings/input/cros-ec,col-gpio.yaml
```yaml
# Copyright 2023 Google LLC
# Use of this source code is governed by a BSD-style license that can be
# found in the LICENSE file.

description: |
  Keyboard matrix device GPIO column drive

  This can be used to handle specific keyboard matrix columns using GPIOs.
  Instantiate as a child node of the keyboard matrix device itself.

  The 'col-num', 'col-gpios', and 'settle-time-us' properties must all have
  the same number of elements.

  Example configuration:

  &kbd {
      ...
      kso-gpio {
          compatible = "cros-ec,col-gpio";
          col-num = <2>;
          col-gpios = <&gpio1 7 GPIO_ACTIVE_HIGH>;
          settle-time-us = <30>;
      };
  };

compatible: "cros-ec,col-gpio"

include: base.yaml

properties:
  col-num:
    type: array
    required: true
    description: Array of column numbers to handle

  col-gpios:
    type: phandle-array
    required: true
    description: Array of GPIOs to use to handle the corresponding columns

  settle-time-us:
    type: array
    required: true
    description: |
      Array of extra delays after changing the column state, note that this
      adds up to the parent device settle-time-us.
```

## zephyr/dts/bindings/input/cros-ec,runtime-keys.yaml
```yaml
# Copyright 2024 Google LLC
# Use of this source code is governed by a BSD-style license that can be
# found in the LICENSE file.

description: |
  Runtime keys definition.

  TODO This can be used to define the key combinations that trigger boot key events:
  TODO recovery mode, force memory retraining and boot without starting the AP.

  Example configuration:

  boot-keys {
      compatible = "cros-ec,runtime-keys";
      left-alt-rc = <KBD_RC(?, ?)>;
      right-alt-rc = <KBD_RC(?, ?)>;
      h-rc = <KBD_RC(?, ?)>;
      r-rc = <KBD_RC(?, ?)>;
  };

compatible: "cros-ec,runtime-keys"

include: base.yaml

properties:
  vol-up-rc:
    type: int
    required: true
    description: Row-column position of the "volume up" key.

  left-alt-rc:
    type: int
    required: true
    description: Row-column position of the "left alt" key.

  right-alt-rc:
    type: int
    required: true
    description: Row-column position of the "right alt" key.

  h-rc:
    type: int
    required: true
    description: Row-column position of the "h" key.

  r-rc:
    type: int
    required: true
    description: Row-column position of the "r" key.
```

## zephyr/dts/bindings/intel/intel,board-id.yaml
~~~~yaml
# Copyright 2025 The ChromiumOS Authors
# Use of this source code is governed by a BSD-style license that can be
# found in the LICENSE file.

description: |
    This binds drivers with specific board ID obtained from CBI. The list
    for `devices` initialization will be performed only if current board id
    matches with `board-version`.

    For instance:
    ````
    board-id0 {
        compatible = "intel,board-id";
        board-version = <257>;
        devices = <&pca95xx_0 &pca95xx_1>;
    };
    board-id1 {
        compatible = "intel,board-id";
        board-version = <258>;
        devices = <&ioex_it8801_port0 &ioex_it8801_port1 &ioex_it8801_port2>;
    };
    ````
    During system initialization board version will be obtained from CBI and
    drivers `pca95xx_0` & `pca95xx_1` will be initialized only if board id matches
    with value `257`.

    Please note that each driver listed on any `intel,board-id` node must have
    property `zephyr,deferred-init` set.

compatible: "intel,board-id"

properties:
  board-version:
    type: int
    required: true
    description: ID of board associated to these devices.
  devices:
    required: true
    type: phandles
    description: Devices to be initialized.
~~~~

## zephyr/dts/bindings/intel/intel,modular-aic-hdmi-port.yaml
```yaml
# Copyright 2024 The ChromiumOS Authors
# Use of this source code is governed by a BSD-style license that can be
# found in the LICENSE file.

description: Intel modular add-in card (AIC) hdmi port

compatible: "intel,modular-aic-hdmi-port"

properties:
  devices:
    type: phandles
    required: false
    description: |
      List of devices bound to an AIC depending on its properties. Any driver
      whose execution depends on device detection by an AIC, can be listed in
      this property to condition its initialization, and establish
      initialization order in case multiple drivers are dependant.
      It is mandatory that all drivers listed here must have property
      `zephyr,deferred-init` set as part of its node definition; this is to
      ensure its initialization is executed at the right time once AIC detection
      has been completed.
  data-speed:
    type: string
    default: MODULAR_AIC_PORT_DATA_SPEED_UNDEFINED
    description: |
      Sets the speed the IO lines shall be expecting from external device.
    enum:
      - MODULAR_AIC_PORT_DATA_SPEED_UNDEFINED
      - MODULAR_AIC_PORT_DATA_SPEED_6GBPS
      - MODULAR_AIC_PORT_DATA_SPEED_12GBPS
      - MODULAR_AIC_PORT_DATA_SPEED_20GBPS
      - MODULAR_AIC_PORT_DATA_SPEED_40GBPS
      - MODULAR_AIC_PORT_DATA_SPEED_80GBPS
```

## zephyr/dts/bindings/intel/intel,modular-aic-port.yaml
```yaml
# Copyright 2025 The ChromiumOS Authors
# Use of this source code is governed by a BSD-style license that can be
# found in the LICENSE file.

description: Intel modular add-in card (AIC) port

compatible: "intel,modular-aic-port"

properties:
  devices:
    type: phandles
    required: false
    description: |
      List of devices bound to an AIC depending on its properties. Any driver
      whose execution depends on device detection by an AIC, can be listed in
      this property to condition its initialization, and establish
      initialization order in case multiple drivers are dependant.
      It is mandatory that all drivers listed here must have property
      `zephyr,deferred-init` set as part of its node definition; this is to
      ensure its initialization is executed at the right time once AIC detection
      has been completed.
```

## zephyr/dts/bindings/intel/intel,modular-aic-props.yaml
```yaml
# Copyright 2024 The ChromiumOS Authors
# Use of this source code is governed by a BSD-style license that can be
# found in the LICENSE file.

description: Intel modular add-in card (AIC) properties

compatible: "intel,modular-aic-props"

properties:
  type:
    type: string
    default: MODULAR_AIC_PORT_TYPE_FIXED
    description: Type of modular AIC.
    enum:
      - MODULAR_AIC_PORT_TYPE_FIXED
      - MODULAR_AIC_PORT_TYPE_MODULAR
  conn-type:
    type: string
    default: MODULAR_AIC_PORT_CONN_TYPE_RESERVED
    description: Type of modular AIC.
    enum:
      - MODULAR_AIC_PORT_CONN_TYPE_RESERVED
      - MODULAR_AIC_PORT_CONN_TYPE_TYPEA
      - MODULAR_AIC_PORT_CONN_TYPE_TYPEC
      - MODULAR_AIC_PORT_CONN_TYPE_HDMI
      - MODULAR_AIC_PORT_CONN_TYPE_DP
      - MODULAR_AIC_PORT_CONN_TYPE_EDP
  retimer-status:
    type: string
    default: MODULAR_AIC_PORT_RETIMER_NOT_PRESENT
    description: Type of modular AIC.
    enum:
      - MODULAR_AIC_PORT_RETIMER_NOT_PRESENT
      - MODULAR_AIC_PORT_RETIMER_SINGLE
      - MODULAR_AIC_PORT_RETIMER_DUAL
  pd-cntrl-type:
    type: string
    default: MODULAR_AIC_PORT_PD_CNTRL_UNDEFINED
    description: Type of modular AIC.
    enum:
      - MODULAR_AIC_PORT_PD_CNTRL_UNDEFINED
      - MODULAR_AIC_PORT_PD_CNTRL_TI
      - MODULAR_AIC_PORT_PD_CNTRL_CYPRESS
      - MODULAR_AIC_PORT_PD_CNTRL_REALTEK
      - MODULAR_AIC_PORT_PD_CNTRL_GOTHIC_BRIDGE
  tbt-status:
    type: string
    default: MODULAR_AIC_PORT_TBT_NOT_CAPABLE
    description: Type of modular AIC.
    enum:
      - MODULAR_AIC_PORT_TBT_NOT_CAPABLE
      - MODULAR_AIC_PORT_TBT_CAPABLE
  data-speed:
    type: string
    default: MODULAR_AIC_PORT_DATA_SPEED_UNDEFINED
    description: Type of modular AIC.
    enum:
      - MODULAR_AIC_PORT_DATA_SPEED_UNDEFINED
      - MODULAR_AIC_PORT_DATA_SPEED_6GBPS
      - MODULAR_AIC_PORT_DATA_SPEED_12GBPS
      - MODULAR_AIC_PORT_DATA_SPEED_20GBPS
      - MODULAR_AIC_PORT_DATA_SPEED_40GBPS
      - MODULAR_AIC_PORT_DATA_SPEED_80GBPS
```
