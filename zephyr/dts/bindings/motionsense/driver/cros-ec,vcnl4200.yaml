## zephyr/dts/bindings/motionsense/driver/drv-bmi260.yaml
```yaml
# Copyright (c) 2021 The Chromium OS Authors
# SPDX-License-Identifier: Apache-2.0

include: motionsense-sensor-base.yaml

properties:
    i2c-spi-addr-flags:
        type: string
        required: true
        description: i2c address or SPI slave logic GPIO
        enum:
            - "BMI260_ADDR0_FLAGS"
```

## zephyr/dts/bindings/motionsense/driver/drv-tcs3400.yaml
```yaml
# Copyright (c) 2021 The Chromium OS Authors
# SPDX-License-Identifier: Apache-2.0

include: motionsense-sensor-base.yaml

properties:
    i2c-spi-addr-flags:
        type: string
        required: false
        description: i2c address or SPI slave logic GPIO
        enum:
            - "TCS3400_I2C_ADDR_FLAGS"
```

## zephyr/dts/bindings/motionsense/drvdata/cros-ec,drvdata-bma255.yaml
```yaml
# Copyright (c) 2021 The Chromium OS Authors
# SPDX-License-Identifier: Apache-2.0

description: BMA255 driver data node

compatible: "cros-ec,drvdata-bma255"

include: drvdata-base.yaml

#
# examples:
#
# bma255_data: bma255-drv-data {
#       compatible = "cros-ec,drvdata-bma255";
#       status = "okay";
# };
#
```

## zephyr/dts/bindings/motionsense/drvdata/cros-ec,drvdata-bmi260.yaml
```yaml
# Copyright (c) 2021 The Chromium OS Authors
# SPDX-License-Identifier: Apache-2.0

description: BMI260 driver data node

compatible: "cros-ec,drvdata-bmi260"

include: drvdata-base.yaml

#
# examples:
#
# bmi260_data: bmi260-drv-data {
#        compatible = "cros-ec,drvdata-bmi260";
#        status = "okay";
# };
#
```

## zephyr/dts/bindings/motionsense/drvdata/cros-ec,drvdata-tcs3408-rgb.yaml
```yaml
# Copyright 2021 The ChromiumOS Authors
# Use of this source code is governed by a BSD-style license that can be
# found in the LICENSE file.

description: TCS3408 RGB driver data

compatible: "cros-ec,drvdata-tcs3408-rgb"

include: drvdata-base.yaml

child-binding:
  description: saturation auto-adjustment
  properties:
    again:
      type: int
      required: false
      description: Gain Scaling; must be value between 0 and 3
    atime:
      type: int
      required: false
      description: Acquisition Time, controlled by the ATIME register
```

## zephyr/dts/bindings/motionsense/drvdata/drvdata-base.yaml
```yaml
# Copyright (c) 2021 The Chromium OS Authors
# SPDX-License-Identifier: Apache-2.0

# common fields for driver data

include: base.yaml

properties:
  status:
    required: true
```

## zephyr/dts/bindings/motionsense/drvinfo/cros-ec,drv-bma255.yaml
```yaml
# Copyright (c) 2021 The Chromium OS Authors
# SPDX-License-Identifier: Apache-2.0

description: BMA255 driver node

compatible: "cros-ec,drv-bma255"

include: base.yaml

properties:
    status:
        required: true
    i2c-spi-addr-flags:
        type: int
        required: true
        description: i2c address or SPI slave logic GPIO
```

## zephyr/dts/bindings/motionsense/drvinfo/drv-tcs3400.yaml
```yaml
# Copyright (c) 2021 The Chromium OS Authors
# SPDX-License-Identifier: Apache-2.0

include: base.yaml

properties:
    status:
        required: true
    i2c-spi-addr-flags:
        type: int
        required: false
        description: i2c address or SPI slave logic GPIO
```

## zephyr/dts/bindings/one_wire_uart/cros-ec,one-wire-uart.yaml
```yaml
# Copyright 2022 The ChromiumOS Authors
# Use of this source code is governed by a BSD-style license that can be
# found in the LICENSE file.

description: One wire UART module

compatible: "cros-ec,one-wire-uart"

include: base.yaml

properties:
  id:
    type: int
    enum:
      - 0
      - 1
    required: true
    description: |
      ID bit for loopback detection. The implementation uses this ID to detect
      if a packet is sent from remote or not.

      For CrOS detachable devices, use 0 for keyboard, and 1 for tablet.
```

## zephyr/dts/bindings/power/adl-ap-pwrseq.yaml
```yaml
# Copyright 2021 The Chromium OS Authors. All rights reserved.
# Use of this source code is governed by a BSD-style license that can be
# found in the LICENSE file.

description: Alderlake fields for power sequence

compatible: "adl-ap-pwrseq"

properties:
    pwrseq-gpios-required:
        description:
            Number of gpios in power sequence
        type: int

child-binding:
    description: Power Sequence GPIO List child node
    properties:
        dbg-label:
            type: string
            required: true
            description: Label of power signal used in debug messages

        power-gpio-pin:
            type: phandle
            required: true
            description: phandle to associated GPIO

        power-signal-enum:
            type: string
            required: true
            description: Enumeration values for power-signal-list

        flags:
            type: int
            required: true
            description: bit 0 represents active in high or low state,
              bit [0] = 1 active high
              bit [0] = 0 active low
```

## zephyr/dts/bindings/power/ap-pwr-signal-emul.yaml
```yaml
 # Copyright 2022 The Chromium OS Authors. All rights reserved.
 # Use of this source code is governed by a BSD-style license that can be
 # found in the LICENSE file.

description: |
  Enables emulating power signal behavior to allow testing AP power sequence.

compatible: "ap-pwr-signal-emul"

properties:
  output-signal:
    type: phandle
    required: true
    description: |
      Output signal that will trigger associated input signals in child node.

  assert-value:
    type: int
    required: false
    default: 1
    description: |
      Value that output signal requires to be considered asserted.

  edge:
    type: string
    required: false
    description: |
      Output signal edge that will activate corresponding input signals.
    default: EDGE_ACTIVE_ON_BOTH
    enum:
      - EDGE_ACTIVE_ON_ASSERT
      - EDGE_ACTIVE_ON_DEASSERT
      - EDGE_ACTIVE_ON_BOTH

  init-value:
    type: int
    required: false
    description: |
      Value set to output signal when initialized.

child-binding:
  description: |
    Input power signal associated to output signal in parent node.

  properties:
    input-signal:
      type: phandle
      required: true
      description: |
        Input signal that will be triggered by output signal in parent node.

    assert-value:
      type: int
      required: false
      default: 1
      description: |
        Value that will be assigned to input signal when parent outut signal
        gets asserted.

    assert-delay-ms:
      type: int
      required: false
      default: 10
      description: |
        Amount of ms to set `assert-value` to input signal when output signal
        gets asserted.

    deassert-value:
      type: int
      required: false
      default: 0
      description: |
        Value that will be assigned to input signal when parent outut signal
        gets deasserted.

    deassert-delay-ms:
      type: int
      required: false
      default: 10
      description: |
        Amount of ms to set `deassert-value` to input signal when output signal
        gets deasserted.

    init-value:
      type: int
      required: false
      description: |
        Value set to output signal when initialized.

    invert-value:
      type: boolean
      description: |
        Flag to invert this input signal assertion logic.
```

## zephyr/dts/bindings/power/ap-pwr-test-platform.yaml
```yaml
 # Copyright 2022 The Chromium OS Authors. All rights reserved.
 # Use of this source code is governed by a BSD-style license that can be
 # found in the LICENSE file.

description: |
  Power sequence test platform.

compatible: "ap-pwr-test-platform"

properties:
  name-id:
    type: string
    required: true
    description: |
      Name of set of related emulated IO power signals for this test platform.

  io-signals:
    type: phandles
    required: true
    description: |
       phandle array of emulated power signals fir this test platform.
```

## zephyr/dts/bindings/power/ap-pwrseq-signal-list.yaml
```yaml
# Copyright 2022 The Chromium OS Authors. All rights reserved.
# Use of this source code is governed by a BSD-style license that can be
# found in the LICENSE file.

description: Power sequence signals information list.
    The signals could be GPIO signals, eSPI signals through virtual wire.

compatible: "ap-pwrseq-signal-list"

properties:
    pwrseq-signals-required:
        description:
            Total of power signals in power sequence, including GPIOs and
            virtual wires
        type: int
        required: true

child-binding:
    description: Power sequence signals list child node
    properties:
        dbg-label:
            type: string
            required: true
            description: Label of power signals used in debug messages

        pwrseq-gpio-node:
            type: phandle
            required: false
            description: phandle to associated GPIO

        pwrseq-vw-enum:
            type: string
            required: false
            description: Enumeration value to eSPI signals that can be sent
              or received through virtual wire channel
            enum:
            - ESPI_VWIRE_SIGNAL_SLP_S3
            - ESPI_VWIRE_SIGNAL_SLP_S4
            - ESPI_VWIRE_SIGNAL_SLP_S5

        pwrseq-signal-enum:
            type: string
            required: true
            description: Enumeration values for power signals

        flags:
            type: int
            required: true
            description: bit 0 represents active in high or low state,
              bit [0] = 1 active high
              bit [0] = 0 active low
```

## zephyr/dts/bindings/power/ap-pwrseq-state.yaml
```yaml
 # Copyright 2022 The Chromium OS Authors. All rights reserved.
 # Use of this source code is governed by a BSD-style license that can be
 # found in the LICENSE file.

description: |
    Power sequence implemented states

compatible: "ap-pwrseq-state"

child-binding:
  description: |
    Each defined power state level implemented in project.
  properties:
    arch-action-enabled:
      type: boolean
      required: false
      description: |
        Architecture level power state action handlers enabled, use
        AP_POWER_ARCH_STATE_DEFINE to define action handler function.
    chipset-action-enabled:
      type: boolean
      required: false
      description: |
        Chipset level power state action handlers enabled, use
        AP_POWER_CHIPSET_STATE_DEFINE to define action handler functions.
    action-enabled:
      type: boolean
      required: false
      description: |
        Power state action handlers enabled, use AP_POWER_STATE_DEFINE to
        define action handler functions.
    state:
      type: string
      required: true
      description: |
        Supported power states.
      enum:
      - AP_POWER_STATE_G3
      - AP_POWER_STATE_S5
      - AP_POWER_STATE_S4
      - AP_POWER_STATE_S3
      - AP_POWER_STATE_S2
      - AP_POWER_STATE_S1
      - AP_POWER_STATE_S0
```

## zephyr/dts/bindings/power/ap-pwrseq-sub-state.yaml
```yaml
 # Copyright 2022 The Chromium OS Authors. All rights reserved.
 # Use of this source code is governed by a BSD-style license that can be
 # found in the LICENSE file.

description: |
  Complementary power sequence states

compatible: "ap-pwrseq-sub-state"

child-binding:
  description: |
    Complementary power sequence states
  properties:
    state:
      type: string
      required: true
      description: |
        User defined power subtstates, use AP_POWER_SUB_STATE_DEFINE, to define
        any additional substate action handler functions.
```

## zephyr/dts/bindings/power/ap-pwrseq.yaml
```yaml
 # Copyright 2022 The Chromium OS Authors. All rights reserved.
 # Use of this source code is governed by a BSD-style license that can be
 # found in the LICENSE file.

description: Common fields for AP power sequence

compatible: "intel,ap-pwrseq"

properties:
    dsw-pwrok-delay:
      type: int
      required: false
      default: 10
      description: |
        Delay to set DSW_PWROK high to PCH after 3.3V rail stable,
        in milliseconds.

    rsmrst-delay:
      type: int
      required: false
      default: 10
      description: |
        Delay to set RSMRST, in milliseconds.

    sys-pwrok-delay:
      type: int
      required: false
      default: 45
      description: |
        Delay from PG_EC_ALL_SYS_PWRGD high to set EC_PCH_SYS_PWROK high,
        in milliseconds.

    pm-pwrbtn-delay:
      type: int
      required: false
      default: 200
      description: |
        Power button delay, in milliseconds.

    pch-pwrok-delay:
      type: int
      required: false
      default: 2
      description: |
        Delay in ms from IMVP9_VRRDY high to PCH_PWROK high delay.

    vccst-pwrgd-delay:
      type: int
      required: false
      default: 2
      description: |
        Delay in ms from PG_EC_ALL_SYS_PWRGD high
        to VCCST_PWRGD high.

    sys-reset-delay:
      type: int
      required: false
      default: 32
      description: Debounce time for SYS_RESET_L.

    vrrdy-timeout:
      type: int
      required: false
      default: 50
      description: |
        Timeout in ms for IMVP9_VRRDY high.

    all-sys-pwrgd-timeout:
      type: int
      required: false
      default: 0
      description: |
        Timeout in ms for ALL_SYS_PWRGD to EC to be high.

    wait-signal-timeout:
      type: int
      required: false
      default: 1000
      description: |
        Timeout in ms for monitoring power signals.

    pg-ec-dsw-pwroks-gpios:
      type: phandle-array
      required: false
      description: |
        VR/Circuit to EC 3.3V power good signal.

    ec-pch-rsmrst-odl-gpios:
      type: phandle-array
      required: false
      description: |
        EC to PCH RSMRST power good signal.

    en-pp5000-s5-gpios:
      type: phandle-array
      required: false
      description: |
        Enable 5V rail.

    pg-ec-rsmrst-odl-gpios:
      type: phandle-array
      required: false
      description: |
        VR/Circuit to EC RSMRST power good signal.


    slp-s3-l-gpios:
      type: phandle-array
      required: false
      description: |
        SLP_S3 signal from SoC.

    pg-ec-all-sys-pwrgd-gpios:
      type: phandle-array
      required: false
      description: |
        VR/Circuit to EC ALL SYS power good signal.

    sys-rst-l-gpios:
      type: phandle-array
      required: false
      description: |
        VR/Circuit to EC ALL SYS power good signal.

    ec-pch-sys-pwrok-gpios:
      type: phandle-array
      required: false
      description: |
        VR/Circuit to EC ALL SYS power good signal.

    pch-pwrok-gpios:
      type: phandle-array
      required: false
      description: |
        VR/Circuit to EC ALL SYS power good signal.

    imvp9-vrrdy-od-gpios:
      type: phandle-array
      required: false
      description: |
        VR/Circuit to EC ALL SYS power good signal.

    vccst-pwrgd-od-gpios:
      type: phandle-array
      required: false
      description: |
        VR/Circuit to EC ALL SYS power good signal.

    slp-sus-l-gpios:
      type: phandle-array
      required: false
      description: |
        SLP_SUS signal from SoC.
```
