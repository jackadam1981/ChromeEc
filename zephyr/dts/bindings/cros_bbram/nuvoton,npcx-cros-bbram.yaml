## zephyr/dts/bindings/cros_bbram/nuvoton,npcx-cros-bbram.yaml
```yaml
# Copyright (c) 2021 Google Inc.
# SPDX-License-Identifier: Apache-2.0

description: Nuvoton, NPCX Battery Backed RAM node

compatible: "nuvoton,npcx-cros-bbram"

include: base.yaml

properties:
    "#address-cells":
        type: int
        required: true
        const: 1
    "#size-cells":
        type: int
        required: true
        const: 1
    reg:
        required: true

child-binding:
    description: Battery-backed RAM region memory, offset by the bbram address.
    properties:
        reg:
            type: array
            required: true
        label:
            required: true
            type: string
            description: Human readable string describing the memory region (used as device_get_binding() argument)
```

## zephyr/dts/bindings/cros_cec_bitbang/ite,it8xxx2-cros-cec-bitbang.yaml
```yaml
# Copyright 2025 Google LLC
# SPDX-License-Identifier: Apache-2.0

description: ITE, it8xxx2-cros-cec-bitbang node

compatible: "ite,it8xxx2-cros-cec-bitbang"

include: [base.yaml, pinctrl-device.yaml]
```

## zephyr/dts/bindings/cros_flash/cros-ec,flash-layout.yaml
```yaml
# Copyright 2021 The Chromium OS Authors. All rights reserved.
# Use of this source code is governed by a BSD-style license that can be
# found in the LICENSE file.

description: Describes the size and offset of the RO and RW regions

compatible: "cros-ec,flash-layout"

include: base.yaml

properties:
  type:
    type: string
    required: true
  offset:
    type: int
    required: true
  size:
    type: int
    required: true
  read-only:
    type: boolean
    required: false
```

## zephyr/dts/bindings/cros_flash/jedec,spi-nor-cros-flash.yaml
```yaml
# Copyright 2020 Google LLC
# SPDX-License-Identifier: Apache-2.0

description: SPI NOR 

compatible: "jedec,spi-nor-cros-flash"

include: cros-flash-controller.yaml
```

## zephyr/dts/bindings/cros_flash/microchip,write-protect.yaml
```yaml
# Copyright 2025 The ChromiumOS Authors
# Use of this source code is governed by a BSD-style license that can be
# found in the LICENSE file.

description: Microchip Internal Write Protect gpios

compatible: "microchip,write-protect"

properties:
  wp-gpios:
    type: phandle-array
    required: true
    description: Internal GPIOs that controls WP status for the EC SPI Not exposed to the SOC.

  wp-ex-gpios:
    type: phandle-array
    required: true
    description: External GPIOs that controls WP status from the SOC to the EC.
```

## zephyr/dts/bindings/cros_flash/microchip,xec-cros-flash.yaml
```yaml
# Copyright 2021 Microchip Technology Inc.
# SPDX-License-Identifier: Apache-2.0

description: Microchip, XEC-cros-flash node

compatible: "microchip,xec-cros-flash"

include: cros-flash-controller.yaml
```

## zephyr/dts/bindings/cros_flash/realtek,rtkfp-cros-flash.yaml
```yaml
# Copyright 2025 Google LLC
# SPDX-License-Identifier: Apache-2.0

description: REALTEK, RTKFP-cros-flash node

compatible: "realtek,rtkfp-cros-flash"

include: cros-flash-controller.yaml
```

## zephyr/dts/bindings/cros_kb_raw/cros-ec,cros-kb-raw.yaml
```yaml
# Copyright 2020 Google LLC
# SPDX-License-Identifier: Apache-2.0

description: cros-ec, cros-kb-raw node

compatible: "cros-ec,cros-kb-raw"

include: cros-kb-raw-controller.yaml
```

## zephyr/dts/bindings/cros_kb_raw/ite,it8xxx2-cros-kb-raw.yaml
```yaml
# Copyright 2022 Google LLC
# SPDX-License-Identifier: Apache-2.0

description: ITE, it8xxx2-cros-kb-raw node

compatible: "ite,it8xxx2-cros-kb-raw"

include: cros-kb-raw-controller.yaml

properties:
    reg:
      required: true

    interrupts:
      required: true

    wucctrl-0:
      type: phandles
      description: |
        Pin configurations for the state. Content is specific to the
        selected pin controller interface implementation.
```

## zephyr/dts/bindings/cros_kb_raw/microchip,xec-cros-kb-raw.yaml
```yaml
# Copyright 2021 Microchip Technologies Inc.
# SPDX-License-Identifier: Apache-2.0

description: Microchip, xec-cros-kb-raw node

compatible: "microchip,xec-cros-kb-raw"

include: [cros-kb-raw-controller.yaml, pinctrl-device.yaml]

properties:
    reg:
        required: true

    pinctrl-0:
      required: true

    pinctrl-names:
      required: true
```

## zephyr/dts/bindings/cros_kb_raw/nuvoton,npcx-cros-kb-raw.yaml
```yaml
# Copyright 2020 Google LLC
# SPDX-License-Identifier: Apache-2.0

description: Nuvoton, NPCX-cros-kb-raw node

compatible: "nuvoton,npcx-cros-kb-raw"

include: cros-kb-raw-controller.yaml
```

## zephyr/dts/bindings/cros_pwr_signal/mediatek,mt8186-power-signal-list.yaml
```yaml
# Copyright 2021 Google LLC
# SPDX-License-Identifier: Apache-2.0

description: MediaTek MT8186, Power Signal List
compatible: "mediatek,mt8186-power-signal-list"

include: power-signal-list.yaml

properties:
  power-signals-required:
    default: 6

child-binding:
  properties:
    power-enum-name:
      enum:
        - AP_IN_RST
        - AP_IN_S3
        - AP_WDT_ASSERTED
        - AP_WARM_RST_REQ
        - PG_PP4200_S5
        - PMIC_AP_RST
```

## zephyr/dts/bindings/cros_pwr_signal/power-signal-list.yaml
```yaml
# Copyright 2021 Google LLC
# SPDX-License-Identifier: Apache-2.0

description: Power Signal List
child-binding:
  description: Power Signal List child node
  properties:
    gpios:
      type: phandle-array
      required: true
    power-enum-name:
      description:
        Enumeration values for power-signal-list
      type: string
      required: true
```

## zephyr/dts/bindings/cros_rtc/microchip,xec-cros-rtc.yaml
```yaml
# Copyright 2021 Microchip Technology Inc.
# SPDX-License-Identifier: Apache-2.0

description: Microchip, XEC Real time clock (RTC) node

compatible: "microchip,xec-cros-rtc"

include: base.yaml

properties:
    reg:
      required: true

    label:
      required: true
```

## zephyr/dts/bindings/cros_shi/cros-shi,espi.yaml
```yaml
# Copyright 2022 The Chromium OS Authors. All rights reserved.
# Use of this source code is governed by a BSD-style license that can be
# found in the LICENSE file.
#
description: |
  ESPI device initialisation

  Configures the ESPI device using device tree.

    espi-init {
      compatible = "cros-shi,espi";
      device = <&espi>;
      frequency = 50;
      io-caps = <ESPI_IO_MODE_QUAD_LINES>;
      channel-caps = <(ESPI_CHANNEL_VWIRE | ESPI_CHANNEL_PERIPHERAL)>;
    };

    Defaults are provided.

compatible: "cros-shi,espi"

properties:
  device:
    type: phandle
    required: true
    description: The ESPI device to configure
  frequency:
    type: int
    required: false
    default: 50
    description: The max bus frequency
    enum:
      - 20
      - 25
      - 33
      - 50
  io-caps:
    type: int
    default: 4
    required: false
    description: The I/O mode capabilities, default quad lines
  channel-caps:
    type: int
    default: 7
    required: false
    description: Channel capabilities, default PERIPHERAL|VWIRE|OOB
```

## zephyr/dts/bindings/emul/cros,ps8xxx-emul.yaml
```yaml
# Copyright 2021 The Chromium OS Authors. All rights reserved.
# Use of this source code is governed by a BSD-style license that can be
# found in the LICENSE file.

description: Zephyr PS8xxx emulator

compatible: "cros,ps8xxx-emul"

include: base.yaml

properties:
    tcpci-i2c:
      type: phandle
      required: true
      description:
        Base TCPCI emulator

    p0-i2c-addr:
      type: int
      required: true
      description:
        First hidden I2C address

    p1-i2c-addr:
      type: int
      required: true
      description:
        Second hidden I2C address
```

## zephyr/dts/bindings/emul/cros,sm5803-chg-emul.yaml
```yaml
# Copyright 2023 The ChromiumOS Authors
# Use of this source code is governed by a BSD-style license that can be
# found in the LICENSE file.

description: SM5803 charger emulator (charger registers)

compatible: "cros,sm5803-chg-emul"

include: base.yaml

properties:
  reg:
    required: true
  emul-base:
    type: phandle
    required: false
    description:
      Reference to cros,sm5803-emul device this is part of.
  battery:
    type: phandle
    required: false
    description:
      Reference to battery emulator.
```

## zephyr/dts/bindings/emul/cros,sm5803-emul.yaml
```yaml
# Copyright 2023 The ChromiumOS Authors
# Use of this source code is governed by a BSD-style license that can be
# found in the LICENSE file.

description: SM5803 charger emulator

compatible: "cros,sm5803-emul"

include: base.yaml

properties:
  main-addr:
    type: int
    default: 0x30
    description: |
      I2C address of the charger base registers. This is always 0x30 on
      hardware.
  meas-addr:
    type: int
    default: 0x31
    description: |
      I2C address of the charger measurement registers. This is always 0x31 on
      hardware.
  battery:
    type: phandle
    required: false
    description:
      Reference to battery emulator.
```

## zephyr/dts/bindings/emul/cros,tcpc-emul.yaml
```yaml
# Copyright 2021 The Chromium OS Authors. All rights reserved.
# Use of this source code is governed by a BSD-style license that can be
# found in the LICENSE file.

description: Zephyr TCPC Emulator

compatible: "cros,tcpc-emul"

include: base.yaml

properties:
    error-on-ro-write:
        type: boolean
        description:
          Flag indicating if error should be generated when read only register
          is being written.

    error-on-reserved-bit-write:
        type: boolean
        description:
          Flag indicating if error should be generated when reserved bit
          is being written.

    error-on-sequential-read:
        type: boolean
        description:
          Flag indicating if error should be generated when trying to read
          more than one register at once

    error-on-sequential-write:
        type: boolean
        description:
          Flag indicating if error should be generated when trying to write
          more than one register at once
```
