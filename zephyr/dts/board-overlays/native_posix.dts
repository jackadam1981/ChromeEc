/* Copyright 2021 The Chromium OS Authors. All rights reserved.
 * Use of this source code is governed by a BSD-style license that can be
 * found in the LICENSE file.
 */

#include <dt-bindings/gpio/gpio.h>

/ {
	resources {
		compatible = "test,gpio-basic-api";
		out-gpios = <&gpio0 0 0>; /* Pin 0 */
		in-gpios = <&gpio0 1 0>; /* Pin 1 */
	};
};

&gpio0 {
	ngpios = <2>;
};
