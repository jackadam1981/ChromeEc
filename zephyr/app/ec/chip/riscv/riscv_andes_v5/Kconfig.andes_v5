## zephyr/app/shell/Kconfig
```kconfig
# Copyright 2022 The Chromium OS Authors. All rights reserved.
# Use of this source code is governed by a BSD-style license that can be
# found in the LICENSE file.

config CONSOLE_CMD_GPIO_ZEPHYR
	bool "Console command: gpioget/gpioset"
	default n
	depends on GPIO
	help
	  Enable the zephyr based 'gpioget/gpioset' console commands.
	  This comamnd is used to view and change the current
	  value of GPIOs in the system.

	  The GPIOs must have name entries in the gpio-line-names
	  property of the GPIO controllers. Only GPIOs that have
	  a non-zero length string name will be available for
	  display and setting.

	  A last-displayed value is kept so that changes can be
	  easily highlighted.
```

## zephyr/boards/arm/madoo/madoo_defconfig
```kconfig
# Copyright 2021 The Chromium OS Authors. All rights reserved.
# Use of this source code is governed by a BSD-style license that can be
# found in the LICENSE file.

# Zephyr Kernel Configuration
CONFIG_SOC_SERIES_NPCX7=y

# Platform Configuration
CONFIG_SOC_NPCX7M7FC=y
CONFIG_BOARD_MADOO=y

# Serial Drivers
CONFIG_SERIAL=y
CONFIG_UART_INTERRUPT_DRIVEN=y
CONFIG_SPI=y

# Enable console
CONFIG_CONSOLE=y
CONFIG_UART_CONSOLE=y

# Pinmux Driver
CONFIG_PINMUX=y

# GPIO Controller
CONFIG_GPIO=y

# Clock configuration
CONFIG_CLOCK_CONTROL=y

# Flash
CONFIG_FLASH=y
CONFIG_SPI_NOR=y
CONFIG_FLASH_JESD216_API=y

# BBRAM
CONFIG_BBRAM=y
CONFIG_BBRAM_NPCX=y
```

## zephyr/boards/arm/mchp_evb/mec172x_evb_defconfig
```kconfig
# Copyright 2022 The Chromium OS Authors. All rights reserved.
# Use of this source code is governed by a BSD-style license that can be
# found in the LICENSE file.

# Zephyr Kernel Configuration
CONFIG_SOC_SERIES_MEC172X=y

# Platform Configuration
CONFIG_SOC_MEC172X_NSZ=y
CONFIG_BOARD_MEC172X_EVB=y
CONFIG_RTOS_TIMER=y
CONFIG_SYS_CLOCK_HW_CYCLES_PER_SEC=32768
CONFIG_SYS_CLOCK_TICKS_PER_SEC=32768

# Serial Drivers
CONFIG_SERIAL=y
CONFIG_UART_INTERRUPT_DRIVEN=y

# Enable console
CONFIG_CONSOLE=y
CONFIG_UART_CONSOLE=y

# Pinmux Driver
CONFIG_PINMUX=y

# Pinctrl Driver
CONFIG_PINCTRL=y

# GPIO Controller
CONFIG_GPIO=y

# Clock configuration
CONFIG_CLOCK_CONTROL=y

# Power Management
# MCHP TODO CONFIG_SOC_POWER_MANAGEMENT=y
# MCHP TODO CONFIG_PM=y
# MCHP TODO CONFIG_PM_POLICY_APP=y
# MCHP TODO CONFIG_UART_CONSOLE_INPUT_EXPIRED=y
# MCHP TODO CONFIG_SOC_POWER_MANAGEMENT_TRACE=y

# WATCHDOG configuration
# CONFIG_WATCHDOG=y
# CONFIG_WDT_XEC=y
# DEBUG disable
CONFIG_WATCHDOG=n
CONFIG_WDT_XEC=n

# BBRAM
CONFIG_BBRAM=y
CONFIG_BBRAM_XEC=y

# SPI
CONFIG_SPI=y
# MCHP build config error CONFIG_SPI_FLASH=y

# Flash
CONFIG_FLASH=y
CONFIG_SPI_NOR=y
# disabling this causes build error: calling function to read JEDEC ID
# MEC1727 internal SST25PF040 does not support SFDP
CONFIG_FLASH_JESD216_API=y
```

## zephyr/boards/arm/stm32f072/Kconfig.board
```kconfig
# STM32F072XB board configuration

# Copyright (c) 2017 Clage GmbH
# SPDX-License-Identifier: Apache-2.0

config BOARD_STM32F072XB
	bool "STM32F072 Board"
	depends on SOC_STM32F072XB
```

## zephyr/boards/arm/stm32f072/Kconfig.defconfig
```kconfig
# STM32F072XB board configuration

# Copyright (c) 2017 Clage GmbH
# SPDX-License-Identifier: Apache-2.0

if BOARD_STM32F072XB

config BOARD
	default "stm32f072xb"

config SPI_STM32_INTERRUPT
	default y
	depends on SPI

endif # BOARD_STM32F072
```

## zephyr/boards/arm/stm32f4/stm32f412cg_defconfig
```kconfig
# Copyright 2022 The ChromiumOS Authors.
# Use of this source code is governed by a BSD-style license that can be
# found in the LICENSE file.

# Zephyr Kernel Configuration
CONFIG_SOC_SERIES_STM32F4X=y
CONFIG_SOC_STM32F412CX=y

# Platform Configuration
CONFIG_BOARD_STM32F412CX=y

# DMA
CONFIG_DMA=y

# Serial Drivers
CONFIG_SERIAL=y
CONFIG_UART_ASYNC_API=n # Disable UART DMA for now (problem with lost characters)
CONFIG_UART_INTERRUPT_DRIVEN=y

# Console
CONFIG_CONSOLE=y
CONFIG_UART_CONSOLE=y
CONFIG_UART_CONSOLE_INPUT_EXPIRED=y

# GPIO Controller
CONFIG_GPIO=y

# Clock Controller
CONFIG_CLOCK_CONTROL=y

# Pin Controller
CONFIG_PINCTRL=y

# Power management
CONFIG_PM=y

# WATCHDOG configuration
CONFIG_WATCHDOG=y
CONFIG_IWDG_STM32_INITIAL_TIMEOUT=10000

# RTC
CONFIG_COUNTER=y
CONFIG_COUNTER_RTC_STM32=y
CONFIG_COUNTER_RTC_STM32_CLOCK_LSI=y
CONFIG_COUNTER_RTC_STM32_BACKUP_DOMAIN_RESET=n

# Timer
CONFIG_COUNTER_TIMER_STM32=y

# BBRAM
CONFIG_BBRAM=y
CONFIG_BBRAM_STM32=y

# Flash
CONFIG_FLASH=y
CONFIG_SOC_FLASH_STM32=y
CONFIG_FLASH_PAGE_LAYOUT=y
```

## zephyr/boards/google/it51xxx/board.yml
```yaml
board:
  name: it51xxx
  full_name: IT51XXX series
  vendor: google
  socs:
    - name: it51526aw
    - name: it51526bw
      variants:
        - name: "512"
```

## zephyr/boards/google/it8xxx2/board.yml
```yaml
board:
  name: it8xxx2
  vendor: google
  socs:
    - name: it81202bx
    - name: it81202cx
    - name: it81302bx
    - name: it81302cx
    - name: it82002aw
    - name: it82202ax
    - name: it82202bw
      variants:
        - name: "512"
```

## zephyr/boards/google/it8xxx2/it8xxx2_it82000bw_defconfig
```kconfig
# Copyright (c) 2025 ITE Corporation. All Rights Reserved.
# SPDX-License-Identifier: Apache-2.0

# Console
CONFIG_CONSOLE=y

# GPIO Controller
CONFIG_GPIO=y
CONFIG_GPIO_GET_CONFIG=y

# Clock Controller
CONFIG_CLOCK_CONTROL=n

# Serial Drivers
CONFIG_SERIAL=y

# WATCHDOG configuration
CONFIG_WATCHDOG=y

# BBRAM
CONFIG_BBRAM=y
```
