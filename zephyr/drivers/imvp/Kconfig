## zephyr/drivers/peci/Kconfig
```kconfig
# Copyright 2026 The ChromiumOS Authors
# Use of this source code is governed by a BSD-style license that can be
# found in the LICENSE file.

config ESPI_PECI
	bool "Support PECI over eSPI"
	depends on DT_HAS_INTEL_ESPI_PECI_ENABLED
	depends on ESPI_OOB_CHANNEL
	default y
	help
	  EC supports Platform Environment Control Interface (PECI) over eSPI
	  using OOB messages.

if ESPI_PECI

config PLATFORM_EC_ESPI_PECI_CONSOLE
	bool "Support PECI over eSPI console commands"
	default y
	help
	  EC supports PECI over eSPI console command.

config ESPI_PECI_TRANSFER_DEBUG_PRINT
	bool "Prints PECI over eSPI transfer data"
	default y
	help
	  EC supports prining PECI over eSPI transer Tx/Rx/ data.

config PLATFORM_EC_ESPI_PECI_CONSOLE_XFER_RAW
	bool "Support raw data transfer over concole"
	depends on ESPI_PECI_TRANSFER_DEBUG_PRINT
	help
	  EC supports generating raw eSPI PECI data over console.
endif
```

## zephyr/drivers/rtk_wake/Kconfig
```kconfig
# Copyright 2026 The ChromiumOS Authors
# Use of this source code is governed by a BSD-style license that can be
# found in the LICENSE file.

config RTK_WAKE
	bool "Realtek wake pin driver"
	default y
	depends on DT_HAS_RTK_WAKE_ENABLED
	help
	  Enable the Realtek wake pin driver. This driver configures a GPIO
	  as an active low wake source.

if RTK_WAKE

module = RTK_WAKE
module-str = rtk_wake
source "subsys/logging/Kconfig.template.log_config"

config RTK_WAKE_INIT_PRIORITY
	int "Initialization priority"
	default 50
	help
	  Initialization priority for the Realtek wake pin driver.

endif # RTK_WAKE
```

## zephyr/drivers/usbc/Kconfig
```kconfig
# Copyright 2023 The ChromiumOS Authors
# Use of this source code is governed by a BSD-style license that can be
# found in the LICENSE file.

if PLATFORM_EC_USBC

config USBC_INTEL_ALTMODE
	bool "USB-C Intel alternate mode configuration driver"
	default y if DT_HAS_INTEL_PD_ALTMODE_ENABLED
	help
	  This option enables a driver for communicating between the USB PD
	  chip and EC for configuring the USB-C alternate mode muxes inside
	  Intel AP.

config USBC_PDC_CCG8
	bool "Infineon CCG8 Power Delivery Controller driver"
	default y if DT_HAS_INFINEON_CCG8_ENABLED
	help
	  This option enable the Infineon CCG8 Power Delivery Controller. This
	  chip family supports both single port and multiple port
	  configurations. For multiple port configurations, each port must
	  create a separate devicetree entry.

config CONSOLE_CMD_PDC_CCG8
	bool "Console command: CCG8 read/write"
	default y if USBC_PDC_CCG8
	help
	  Enable console command to read/write to the power path registers of
	  CCG8 Power Delivery chip.

config USBC_PDC_RTS54XX
	bool "Realtek RTS545x Power Delivery Controller driver"
	default y if DT_HAS_REALTEK_RTS54_PDC_ENABLED
	select SMF
	select SMF_ANCESTOR_SUPPORT
	help
	  This option enables the Realtek RTS545x Power Delivery Controller.

config USBC_PDC_RTS54XX_STACK_SIZE
        int "USB-C Realtek RTS545x PDC thread stack size"
        default 1024
	depends on USBC_PDC_RTS54XX
        help
          Stack size of thread created for each instance.

config USBC_PDC_RTS54XX_THREAD_PRIORITY
        int "USB-C Realtek RTS545x PDC thread priority"
        default 0
	depends on USBC_PDC_RTS54XX
        help
          Set thread priority of the USB-C PDC

config USBC_PDC_TRACE_MSG
	bool "USB-C PDC message tracing"
	depends on USBC_PDC_RTS54XX
	help
	  Enable communication tracing between the EC and the PDC.
	  Messages between the EC and PDC are saved in a pre-allocated
	  FIFO so they can be retrieved by EC host and console commands.

config USBC_PDC_TRACE_MSG_FIFO_SIZE
	int "PDC message tracing FIFO size"
	range 7 16
	default 10
	depends on USBC_PDC_TRACE_MSG
	help
	  This is the byte size of the PDC message tracing FIFO
	  expressed as log2. A value of 10 results in a 1024 byte deep
	  FIFO. When tracing is active, the FIFO needs to be deep enough
	  to abosrb delays on the AP side when retrieving messages. When
	  the FIFO is full, messages are tail-dropped which effectively
	  disables tracing until the FIFO drains.
	  The FIFO is allocated in EC RAM, so some sizing judgement may
	  be necessary on ECs with limited RAM.

config USBC_PDC_TRACE_MSG_VERBOSE
	bool "Verbose USB-C PDC message tracing"
	depends on USBC_PDC_TRACE_MSG
	help
	  Enable console output for PDC message tracing operations.
	  Used primarily for debugging.

config USBC_PDC_TRACE_MSG_CONSOLE_CMD
	bool "Enable pdctrace console command"
	default y if USBC_PDC_TRACE_MSG
	help
	  Enable console command for printing PDC communication trace
	  messages.

config USBC_PDC_TRACE_MSG_HOST_CMD
	bool "Enable PDC_TRACE host command"
	default y if USBC_PDC_TRACE_MSG
	help
	  Enable host command for collecting PDC communication trace
	  messages.

endif # PLATFORM_EC_USBC
```

## zephyr/drivers/usbc/Kconfig.pdc_trace
```kconfig
# Copyright 2024 The ChromiumOS Authors
# Use of this source code is governed by a BSD-style license that can be
# found in the LICENSE file.

if PLATFORM_EC_USBC

config USBC_PDC_TRACE_MSG_FIFO_SIZE
	int "PDC message tracing FIFO size"
	range 128 65536
	default 1024
	depends on USBC_PDC_TRACE_MSG
	help
	  This is the byte size of the PDC message tracing FIFO. This
	  must be a power of 2. When tracing is active, the FIFO needs
	  to be deep enough to absorb delays on the AP side when
	  retrieving messages. When the FIFO is full, messages are
	  tail-dropped which effectively disables tracing until the FIFO
	  drains. The FIFO is allocated in EC RAM, so some sizing
	  judgment may be necessary on ECs with limited RAM.

config USBC_PDC_TRACE_MSG_VERBOSE
	bool "Verbose USB-C PDC message tracing"
	depends on USBC_PDC_TRACE_MSG
	help
	  Enable extra console output for PDC message tracing
	  operations. This primarily reports what is being stored and
	  retrieved from the trace FIFO for gaining visibility into
	  access operations. FIFO content is not affected. Console
	  output is reported at `LOG_LEVEL_DBG`.

config USBC_PDC_TRACE_MSG_CONSOLE_CMD
	bool "Enable pdctrace console command"
	default y if USBC_PDC_TRACE_MSG
	help
	  Enable console command for printing PDC communication trace
	  messages.

config USBC_PDC_TRACE_MSG_HOST_CMD
	bool "Enable PDC_TRACE host command"
	default y if USBC_PDC_TRACE_MSG
	help
	  Enable host command for collecting PDC communication trace
	  messages.

endif # PLATFORM_EC_USBC
```

## zephyr/dts/bindings/adc/cros-adc-threshold.yaml
```yaml
description: ADC Threshold IRQ Configuration
compatible: "cros-adc-thresholds"
child-binding:
  description:
    Configure threshold interruptions during initialization.
  properties:
    callback:
      required: true
      type: string
      description:
        Set ADC threshold callback function name.
    channel:
      required: true
      type: int
      description:
        Set ADC channel to be used to read signal.
    assert-value:
      required: true
      type: int
      description:
        Set ADC threshold assert value in mV.
      default: 0
    assert-mode:
      required: true
      type: string
      description:
        Determines relation between measured value and assertion threshold.
      enum:
      - ADC_THR_ASSERT_MODE_NONE
      - ADC_THR_ASSERT_MODE_RISE
      - ADC_THR_ASSERT_MODE_FALL
      - ADC_THR_ASSERT_MODE_MAX
      default: ADC_THR_ASSERT_MODE_NONE
    enabled:
      required: false
      type: boolean
      description:
        Enables ADC trheshold interruption.
```

## zephyr/dts/bindings/battery/as3fxxd3kb,c340152.yaml
```yaml
description: "AS3FXXD3KB C340152"
compatible: "as3fxxd3kb,c340152"

include: battery-smart.yaml

properties:
   enum-name:
      type: string
      default: "atl,cfd72"

   # Fuel Gauge
   manuf_name:
      default: "AS3FXXD3KB"
   device_name:
      default: "C340152"
   ship_mode_reg_addr:
      default: 0x00
   ship_mode_reg_data:
      default: [ 0x0010, 0x0010 ]
   fet_mfgacc_support:
      default: 0
   fet_reg_addr:
      default: 0x99
   fet_reg_mask:
      default: 0x000C
   fet_disconnect_val:
      default: 0x000C
   fet_cfet_mask:
      default: 0x0004
   fet_cfet_off_val:
      default: 0x0004

   # Battery info
   voltage_max:
      default: 13350
   voltage_normal:
      default: 11985
   voltage_min:
      default: 9000
   precharge_current:
      default: 256
   start_charging_min_c:
      default: 0
   start_charging_max_c:
      default: 45
   charging_min_c:
      default: 0
   charging_max_c:
      default: 60
   discharging_min_c:
      default: -20
   discharging_max_c:
      default: 60
```

## zephyr/dts/bindings/battery/atc,5413ab450001.yaml
```yaml
# Copyright 2025 The ChromiumOS Authors
# Use of this source code is governed by a BSD-style license that can be
# found in the LICENSE file.

description: "ATC 5413AB450001"
compatible: "atc,5413ab450001"

include: battery-smart.yaml

properties:
  enum-name:
    type: string
    default: "atc,5413ab450001"

  # Fuel gauge
  manuf_name:
    default: "5413AB450001"
  device_name:
    default: "BTY-M4B"
  ship_mode_reg_addr:
    default: 0x00
  ship_mode_reg_data:
    default: [0x00, 0x00]
  flags:
    default: 0x0004
  fet_reg_addr:
    default: 0x0054
  fet_reg_mask:
    default: 0x0006
  fet_disconnect_val:
    default: 0x0000
  fet_cfet_mask:
    default: 0x0004
  fet_cfet_off_val:
    default: 0x0000

  # Battery info
  voltage_max:
    default: 13200
  voltage_normal:
    default: 11550
  voltage_min:
    default: 9000
  precharge_current:
    default: 256
  start_charging_min_c:
    default: 0
  start_charging_max_c:
    default: 60
  charging_min_c:
    default: 0
  charging_max_c:
    default: 60
  discharging_min_c:
    default: -20
  discharging_max_c:
    default: 60
```

## zephyr/dts/bindings/battery/battery-fuel-gauge.yaml
```yaml
# Copyright 2021 The Chromium OS Authors. All rights reserved.
# Use of this source code is governed by a BSD-style license that can be
# found in the LICENSE file.

description: |
   Battery fuel gauge parameters

compatible: "battery-fuel-gauge"

properties:
   manuf_name:
      description: Manufacturer name
      type: string
   device_name:
      description: Model/Device name
      type: string
   ship_mode_wb_support:
      description: |
         Write Block Support. If wb_support is true, then we use a i2c write
         block command instead of a 16-bit write. The effective difference is
         that the i2c transaction will prefix the length (2) when wb_support
         is enabled.
      default: 0
      type: int
   ship_mode_reg_addr:
      type: int
   ship_mode_reg_data:
      type: array
   sleep_mode_support:
      type: int
   sleep_mode_reg_addr:
      type: int
   sleep_mode_reg_data:
      type: int
   fet_mfgacc_support:
      description: Manufacturer access data support
      type: int
   fet_reg_addr:
      type: int
   fet_reg_mask:
      type: int
   fet_disconnect_val:
      type: int
   fet_cfet_mask:
      description: CHG FET status mask
      type: int
   fet_cfet_off_val:
      description: CHG FET offset value
      type: int
   imbalance_mv:
      description: |
         This property is used if CONFIG_BATTERY_MEASURE_IMBALANCE is defined.
         It should be an enum and its value should be a name of function
         which will be assigned to imbalance_mv pointer.
      type: string
```

## zephyr/dts/bindings/battery/battery-info.yaml
```yaml
# Copyright 2021 The Chromium OS Authors. All rights reserved.
# Use of this source code is governed by a BSD-style license that can be
# found in the LICENSE file.

description:
   Information about battery
   Voltage is in millivolts
   Current is in milliamperes
   Temperature is in Celsius degrees

compatible: "battery-info"

properties:
   voltage_max:
      type: int
   voltage_normal:
      type: int
   voltage_min:
      type: int
   precharge_voltage:
      type: int
   precharge_current:
      type: int
   start_charging_min_c:
      type: int
   start_charging_max_c:
      type: int
   charging_min_c:
      type: int
   charging_max_c:
      type: int
   discharging_min_c:
      type: int
   discharging_max_c:
      type: int
```

## zephyr/dts/bindings/battery/cosmx,ap25cbk.yaml
```yaml
description: "COSMX AP25CBK"
compatible: "cosmx,ap25cbk"

include: battery-smart.yaml

properties:
  enum-name:
    type: string
    default: "cosmx,ap25cbk"

  # Fuel gauge
  manuf_name:
    default: "COSMX KT0030B008"
  device_name:
    default: "AP25CBK"
  ship_mode_reg_addr:
    default: 0x3A
  ship_mode_reg_data:
    default: [0xC574, 0xC574]

  flags:
    default: 0x04
  fet_reg_addr:
    default: 0x0054
  fet_reg_mask:
    default: 0x2000
  fet_disconnect_val:
    default: 0x2000
  fet_cfet_mask:
    default: 0x4000
  fet_cfet_off_val:
    default: 0x4000

  # Battery info
  voltage_max:
    default: 13200
  voltage_normal:
    default: 11310
  voltage_min:
    default: 9000
  precharge_current:
    default: 404
  start_charging_min_c:
    default: 0
  start_charging_max_c:
    default: 50
  charging_min_c:
    default: 0
  charging_max_c:
    default: 60
  discharging_min_c:
    default: -20
  discharging_max_c:
    default: 75
```

## zephyr/dts/bindings/battery/cosmx,l26x2pk1.yaml
```yaml
description: "COSMX L26X2PK1"
compatible: "cosmx,l26x2pk1"

include: battery-smart.yaml

properties:
  enum-name:
    type: string
    default: "cosmx,l26x2pk1"

  # Fuel gauge
  manuf_name:
    default: "COSMX"
  device_name:
    default: "L26X2PK1"
  ship_mode_reg_addr:
    default: 0x34
  ship_mode_reg_data:
    default: [0x0000, 0x1000]
  # Manufacturer Access 0x0054
  # b13: D-FET
  # b14: C-FET
  flags:
    default: 0x00
  fet_reg_addr:
    default: 0x0054
  fet_reg_mask:
    default: 0x2000
  fet_disconnect_val:
    default: 0x0000
  fet_cfet_mask:
    default: 0x4000
  fet_cfet_off_val:
    default: 0x0000

  # Battery info
  voltage_max:
    default: 8800
  voltage_normal:
    default: 7540
  voltage_min:
    default: 6000
  precharge_current:
    default: 226
  start_charging_min_c:
    default: 0
  start_charging_max_c:
    default: 50
  charging_min_c:
    default: 0
  charging_max_c:
    default: 60
  discharging_min_c:
    default: -20
  discharging_max_c:
    default: 70
```

## zephyr/dts/bindings/battery/cosmx,pg01lj3353.yaml
```yaml
description: "COSMX PG01LJ3353"
compatible: "cosmx,pg01lj3353"

include: battery-smart.yaml

properties:
  enum-name:
    type: string
    default: "cosmx,pg01lj3353"

  # Fuel gauge
  manuf_name:
    default: "PG01LJ3353"
  device_name:
    default: "CA14J43"
  ship_mode_reg_addr:
    default: 0x00
  ship_mode_reg_data:
    default: [0x0010, 0x0010]
  # Documentation: b/257860663#comment7
  # Manufacturer Access 0x00
  # b14: Charging Disabled (0: Off, 1: On)
  # b13: Discharging Disabled (0: Off, 1: On)
  flags:
    default: 0x04
  fet_reg_addr:
    default: 0x0
  fet_reg_mask:
    default: 0x2000
  fet_disconnect_val:
    default: 0x2000
  fet_cfet_mask:
    default: 0x4000
  fet_cfet_off_val:
    default: 0x4000

  # Battery info
  voltage_max:
    default: 13200
  voltage_normal:
    default: 11550
  voltage_min:
    default: 9000
  precharge_current:
    default: 256
  start_charging_min_c:
    default: 0
  start_charging_max_c:
    default: 50
  charging_min_c:
    default: 0
  charging_max_c:
    default: 60
  discharging_min_c:
    default: -20
  discharging_max_c:
    default: 60
```
