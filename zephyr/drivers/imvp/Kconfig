## zephyr/dts/bindings/battery/smp,pc-vp-bp144.yaml
```yaml
# Copyright 2022 The Chromium OS Authors. All rights reserved.
# Use of this source code is governed by a BSD-style license that can be
# found in the LICENSE file.
description: "SMP PC-VP-BP144"
compatible: "smp,pc-vp-bp144"
include: battery-smart.yaml
properties:
   enum-name:
      type: string
      default: "smp,pc-vp-bp144"
   # Fuel gauge
   manuf_name:
      default: "SIMPLO"
   device_name:
      default: "PC-VP-BP144"
   ship_mode_reg_addr:
      default: 0x34
   ship_mode_reg_data:
      default: [ 0x0000, 0x1000 ]
   fet_mfgacc_support:
      default: 0
   fet_reg_addr:
      default: 0x00
   fet_reg_mask:
      default: 0x0010
   fet_disconnect_val:
      default: 0x0000
   # Battery info
   voltage_max:
      default: 13050
   voltage_normal:
      default: 11250
   voltage_min:
      default: 9000
   precharge_current:
      default: 128
   start_charging_min_c:
      default: 0
   start_charging_max_c:
      default: 45
   charging_min_c:
      default: 0
   charging_max_c:
      default: 60
   discharging_min_c:
      default: -20
   discharging_max_c:
      default: 60
```

## zephyr/dts/bindings/battery/sunwoda,l21d2pg2.yaml
```yaml
# Copyright 2021 The Chromium OS Authors. All rights reserved.
# Use of this source code is governed by a BSD-style license that can be
# found in the LICENSE file.

description: "Sunwoda L21D2PG2"
compatible: "sunwoda,l21d2pg2"

include: battery-smart.yaml

properties:
   enum-name:
      type: string
      default: "sunwoda,l21d2pg2"

   # Fuel gauge
   manuf_name:
      default: "Sunwoda"
   device_name:
      default: "L21D2PG2"
   ship_mode_reg_addr:
      default: 0x34
   ship_mode_reg_data:
      default: [ 0x0000, 0x1000 ]
   fet_mfgacc_support:
      default: 1
   fet_reg_addr:
      default: 0x34
   fet_reg_mask:
      default: 0x0100
   fet_disconnect_val:
      default: 0x0

   # Battery info
   voltage_max:
      default: 8860
   voltage_normal:
      default: 7700
   voltage_min:
      default: 6000
   precharge_current:
      default: 200
   start_charging_min_c:
      default: 0
   start_charging_max_c:
      default: 50
   charging_min_c:
      default: 0
   charging_max_c:
      default: 63
   discharging_min_c:
      default: -20
   discharging_max_c:
      default: 63
```

## zephyr/dts/bindings/board_names/board-names-enum.yaml
```yaml
# Copyright 2021 The Chromium OS Authors. All rights reserved.
# Use of this source code is governed by a BSD-style license that can be
# found in the LICENSE file.
description: Trogdor board names

compatible: "board-names-enum"

child-binding:
    description: Trogdor board names
    properties:
        enum-name:
            type: string
            required: true
            enum:
                - COACHZ
                - HOMESTAR
                - LAZOR
                - MARZIPAN
                - MRBLAND
                - PAZQUEL
                - POMPOM
                - WORMDINGLER
```

## zephyr/dts/bindings/button/cros-ec,button.yaml
```yaml
# Copyright 2022 The Chromium OS Authors.
# Use of this source code is governed by a BSD-style license that can be
# found in the LICENSE file.
#
include: base.yaml

description: |
  Button config.
   - Name
   - Type
   - GPIO handle
   - Debounce time (us)
   - Flags

compatible: "cros-ec,button"

description: Button configuration
properties:
  button_type:
    type: int
    required: false
    description: Keyboard button type
  gpios:
    type: phandle-array
    required: true
  debounce_us:
    type: int
    required: true
    description: Debounce time in microseconds
```

## zephyr/dts/bindings/cbi/named-cbi-board-version.yaml
```yaml
# Copyright 2021 The Chromium OS Authors. All rights reserved.
# Use of this source code is governed by a BSD-style license that can be
# found in the LICENSE file.

description: CBI Board Version

compatible: "named-cbi-board-version"

child-binding:
    description:
        CBI Board Version.
    properties:
        range:
            type: array
            required: true
            description:
              Range of the board version
        alternative-device:
            type: phandle
            description:
              Alternative device that should be used
```

## zephyr/dts/bindings/cbi/named-cbi-ssfc-value.yaml
```yaml
# Copyright 2021 The Chromium OS Authors. All rights reserved.
# Use of this source code is governed by a BSD-style license that can be
# found in the LICENSE file.

description:
    Possible CBI SSFC field values.
    It has to be defied as grandchild on the "named-cbi-ssfc"

compatible: "named-cbi-ssfc-value"

properties:
    value:
        type: int
        required: true
        description:
          Unique value of CBI SSFC field
    devices:
        type: phandles
        required: true
        description:
          Pointers to alternative devices which has to be used if
          CBI SSFC matches the defined value

# Example:
#
# cbi-ssfc {
#     compatible = "named-cbi-ssfc";
#
#     base_sensor {
#         enum-name = "BASE_SENSOR";
#         size = <3>;
#         bmi160 {
#             compatible = "named-cbi-ssfc-value";
#             status = "okay";
#
#             value = <1>;
#             devices = <&alt_base_accel &alt_base_gyro>;
#         };
#         kx022 {
#             compatible = "named-cbi-ssfc-value";
#             status = "okay";
#
#             value = <3>;
#             devices = <&base_accel_kx022>;
#         };
#     };
# };
```

## zephyr/dts/bindings/charger/hpb-charger.yaml
```yaml
# Copyright 2025 The ChromiumOS Authors
# SPDX-License-Identifier: Apache-2.0

description: |
  Properties common to all Hybrid Power Boost (HBP) charger chips

properties:
  minimum-voltage-required:
    type: int
    required: true
    default: 15000
    description: |
      Minimum voltage (in millivolts) required to charge battery for hybrid
      boost chargers.
```
