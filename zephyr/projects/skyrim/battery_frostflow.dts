/* Copyright 2022 The ChromiumOS Authors
 * Use of this source code is governed by a BSD-style license that can be
 * found in the LICENSE file.
 */

/ {
	batteries {
		default_battery: c340152 {
			compatible = "as3fxxd3kb,c340152", "battery-smart";
		};
	};
};
