/* Copyright 2022 The Chromium OS Authors. All rights reserved.
 * Use of this source code is governed by a BSD-style license that can be
 * found in the LICENSE file.
 */

/ {
	chosen {
		zephyr,ec-host-interface = &host_cmd;
	};

	host_cmd: host-cmd {
		compatible = "zephyr,ec-host-cmd-periph-shi";
		label = "host-cmd-shi";
		bus = <&shi0>;
	};
};

/* host interface */
&shi0 {
	status = "okay";
	pinctrl-0 = <&shi_gp46_47_53_55>;
	pinctrl-1 = <&shi_gpio_gp46_47_53_55>;
	pinctrl-names = "default", "sleep";
};
