/* Copyright 2021 The Chromium OS Authors. All rights reserved.
 * Use of this source code is governed by a BSD-style license that can be
 * found in the LICENSE file.
 */

/ {
	batteries {
		default_battery: sunwoda_l21d2pg2 {
			compatible = "sunwoda,l21d2pg2";
		};
		byd_l21b2pg2 {
			compatible = "byd,l21b2pg2";
		};
	};
};
