/* Copyright 2022 The Chromium OS Authors. All rights reserved.
 * Use of this source code is governed by a BSD-style license that can be
 * found in the LICENSE file.
 */

/ {
	batteries {
		default_battery: batgqa05l22 {
			compatible = "pow-tech,batgqa05l22";
		};
		lgc_l17l3pb0 {
			compatible = "lgc,l17l3pb0";
		};
	};
};
