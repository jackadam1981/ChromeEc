/* Copyright 2021 The Chromium OS Authors. All rights reserved.
 * Use of this source code is governed by a BSD-style license that can be
 * found in the LICENSE file.
 */

/ {
	pwmleds {
		compatible = "pwm-leds";
		pwm_led0: pwm_led_0 {
			pwms = <&led1
				&led2
				&led3>; /* same color-map color order */
		};
	};

	cros-pwmleds {
		compatible = "cros-ec,pwm-leds";

		leds = <&pwm_led0>;

		color-map-red    = <100   0   0>;
		color-map-green  = <  0 100   0>;
		color-map-blue   = <  0   0 100>;
		color-map-yellow = <100  70   0>;
		color-map-white  = <100  70 100>;
		color-map-amber  = <100  20   0>; /* hayato needn't these map */

		brightness-range = <0 0 0 0 15 15>; /* via led_get_brightness_range(), then need't */
	};
};
