/* Copyright 2022 The Chromium OS Authors. All rights reserved.
 * Use of this source code is governed by a BSD-style license that can be
 * found in the LICENSE file.
 */

/ {
	cros-keyscan {
		compatible = "cros-keyscan";

		actual-key-mask = <
			0x1C	/* C0 */
			0xff	/* C1 */
			0xff	/* C2 */
			0xff	/* C3 */
			0xff	/* C4 */
			0xff	/* C5 */
			0xff	/* C6 */
			0x86	/* C7 */
			0xff	/* C8 */
			0xff	/* C9 */
			0x55	/* C10 */
			0xff	/* C11 */
			0xff	/* C12 */
			0xff	/* C13 */
			0xff	/* C14 */
		>;
	};

	kblight {
		compatible = "cros-ec,kblight-pwm";
		pwms = <&pwm3 0 PWM_KHZ(10) PWM_POLARITY_NORMAL>;
		frequency = <10000>;
		generic-pwm-channel = <0>;
	};
};

&pwm3 {
	status = "okay";
};
