/* Copyright 2022 The Chromium OS Authors. All rights reserved.
 * Use of this source code is governed by a BSD-style license that can be
 * found in the LICENSE file.
 */

/ {
	kblight {
		compatible = "cros-ec,kblight-pwm";
		pwms = <&pwm6 6 PWM_KHZ(10) PWM_POLARITY_NORMAL>;
		frequency = <10000>;
	};
};

&pwm6 {
	status = "okay";
	pinctrl-0 = <&pwm6_gpc0>;
	pinctrl-names = "default";
};

&cros_kb_raw {
	status = "okay";
	/* No KSO2 (it's inverted and implemented by GPIO) */
	pinctrl-0 = <
		&alt7_no_ksi0_sl
		&alt7_no_ksi1_sl
		&alt7_no_ksi2_sl
		&alt7_no_ksi3_sl
		&alt7_no_ksi4_sl
		&alt7_no_ksi5_sl
		&alt7_no_ksi6_sl
		&alt7_no_ksi7_sl
		&alt8_no_kso00_sl
		&alt8_no_kso01_sl
		&alt8_no_kso03_sl
		&alt8_no_kso04_sl
		&alt8_no_kso05_sl
		&alt8_no_kso06_sl
		&alt8_no_kso07_sl
		&alt9_no_kso08_sl
		&alt9_no_kso09_sl
		&alt9_no_kso10_sl
		&alt9_no_kso11_sl
		&alt9_no_kso12_sl
		&alt9_no_kso13_sl
		&alt9_no_kso14_sl
	>;
};
