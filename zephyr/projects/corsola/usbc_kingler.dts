/* Copyright 2021 The Chromium OS Authors. All rights reserved.
 * Use of this source code is governed by a BSD-style license that can be
 * found in the LICENSE file.
 */

/ {
	usbc {
		port0 {
			compatible = "named-usbc-port";
			port = <0>;
		};

		port1 {
			compatible = "named-usbc-port";
			port = <1>;
		};
	};
};
