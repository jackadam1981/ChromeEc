/* Copyright 2021 The Chromium OS Authors. All rights reserved.
 * Use of this source code is governed by a BSD-style license that can be
 * found in the LICENSE file.
 */

/ {
	named-gpios {
		compatible = "named-gpios";

		gpio_ec_voldn_btn_odl: ec_voldn_btn_odl {
			gpios = <&gpioe 9 GPIO_INPUT>;
			enum-name = "GPIO_VOLUME_DOWN_L";
		};
	};
};
