## zephyr/Kconfig.usbc_common_altmode
```kconfig
# Copyright 2023 The ChromiumOS Authors
# Use of this source code is governed by a BSD-style license that can be
# found in the LICENSE file.

if PLATFORM_EC_USB_POWER_DELIVERY || PLATFORM_EC_USB_PD_CONTROLLER

config PLATFORM_EC_USB_PD_DP_MODE
	bool "EC-driven DP support"
	depends on !PLATFORM_EC_USB_PD_VDM_AP_CONTROL
	default y
	help
	  This enables support for entering DisplayPort alternate mode as a
	  DFP from the Embedded Controller directly.  This flag gates all the
	  on-EC logic for determining specifics such as VDM contents.

config PLATFORM_EC_USB_PD_REV30
	bool "USB PD Rev3.0 functionality"
	default y
	help
	  Enable this to allow Rev3.0 functionality, including features such as
	  Fast Role Swap, advertising the available power across all ports of a
	  multi-port charger, and USB4. If disabled, only USB Power Delivery
	  Rev2.0 functionality is supported.

	  This defaults to y because PD Rev3.0 is required for USB4
	  functionality.

config PLATFORM_EC_USB_PD_TBT_COMPAT_MODE
	bool "Thunderbolt-compatible mode support"
	depends on PLATFORM_EC_USB_PD_REV30
	default n
	help
	  Enable this to allow entering into Thunderbolt-compatible mode between
	  two port partners. This does not require that USB4 mode be enabled.

config PLATFORM_EC_USB_PD_USB4
	bool "USB4 support"
	depends on PLATFORM_EC_USB_PD_REV30
	default n
	help
	  This enables support for entering into USB4 mode between two port
	  partners. The provides new features such as higher speeds and more
	  flexible multiplexing of data on the cable for different purposes,
	  e.g. attaching multiple displays and storage devices on the same bus.

config PLATFORM_EC_USB_PD_3A_PORTS
	int "Number of USBC ports that can supply 3A"
	default 1
	help
	  Specifies the number of ports the platform can source 3.0A on
	  simultaneously.  When this setting is lower than the total number
	  of USB Type-C ports on the platform, the source policy logic
	  provides 3.0A to connected partners in this order.

	  1. PD capabable sinks that request more than 1.5A in their Get Sink
	     Caps response.
	  2. FRS capable sources that request 3.0A FRS current.
	  3. Non-PD sinks

	  To turn off 3.0A currnet allocation, set this field to 0.

config PLATFORM_EC_USB_PD_3A_NO_DOWNGRADE
	bool "Disable downgrade sourcing 3A to 1.5A"
	help
	  The deafault USB sourcing policy automatically offers 3.0A to a
	  PD capabable sink partner when the partner's sink capabilities
	  request more than 1.5A current.  Once the chromebook offers a
	  5V/3A source capability PDO to the partner, if the partner's
	  subsequent Request RDO asks for 1.5A or less, the sourcing policy
	  will downgrade the partner back to 5V/1.5A so that 3.0A can be offered
	  to another port.

	  Enable this option to disable the downgrade to 1.5A, regardless of
	  the Request RDO sent by the partner.

	  This setting should typically be enabled to pass USB PD compliance
	  tests, as the PD compliance testers typically do not have the
	  sophistication to handle the source current downgrade.

endif # PLATFORM_EC_USB_POWER_DELIVERY || PLATFORM_EC_USB_PD_CONTROLLER
```

## zephyr/Kconfig.usbdc
```kconfig
# Copyright 2023 The ChromiumOS Authors
# Use of this source code is governed by a BSD-style license that can be
# found in the LICENSE file.

config PLATFORM_EC_USB_DC
	bool "USB Device Controller Support"
	default y
	help
	  Enable USB Device Controller

config USB_DC_TRANS
	bool "USB HID Keycode Translation Module"
	depends on PLATFORM_EC_USB_DC
	help
	  Enable USB HID Keycode Translation Module

config USB_DC_TRANS_AUTOSTART
	bool "USB DC Thread Loop Enable"
	help
	  Enable the USB DC Thread Loop

config USB_DC_THREAD_PRIORITY
        int "usb dc thread priority"
        default 12
        help
          This option determines usb dc thread priority, this number
          must be selected in such way thread priority is in the middle of
          all the enabled threads.

config USB_DC_STACK_SIZE
        int "usb dc stack size (in bytes)"
        help
          This must be set in a board configuration. If a default
          is set here, it cannot be overridden (if necessary), since
          this Kconfig appears before the EC chip specific stack
          sizes.

config USB_KEYCODE_TRANS
	bool "USB Keycode Translation Enable"
	depends on USB_DC_TRANS
	help
	  Enable USB HID Keycode Translation Function
```

## zephyr/Kconfig.wireless_charger
```kconfig
# Copyright 2022 The ChromiumOS Authors
# Use of this source code is governed by a BSD-style license that can be
# found in the LICENSE file.

config PLATFORM_EC_PERIPHERAL_CHARGER
	bool "Enable peripheral charger task"
	help
	  Enable peripheral charger task.

if PLATFORM_EC_PERIPHERAL_CHARGER

config PLATFORM_EC_CPS8100
	bool "Use CPS8100 driver"
	help
	  Use CPS8100 driver. CPS8100 is a Qi wireless power transmitter.

config PLATFORM_EC_DYNAMIC_WIRELESS_CHARGER_COUNT
	bool "Dynamic Wireless Charger Count"
	help
	  Some hardware skus may not have wireless charger but share the same EC firmware,
	  enable this to allow charger count to be determined at runtime.
	  CONFIG_DYNAMIC_WIRELESS_CHARGER_COUNT removes the const assumption for the
	  global variable pchg_count.

endif # PLATFORM_EC_PERIPHERAL_CHARGER
```
