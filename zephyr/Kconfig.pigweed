## zephyr/Kconfig.rollback
```kconfig
# Copyright 2023 The ChromiumOS Authors
# Use of this source code is governed by a BSD-style license that can be
# found in the LICENSE file.

config PLATFORM_EC_ROLLBACK
	bool "Rollback support"
	help
	  Enable rollback support.

config PLATFORM_EC_ROLLBACK_VERSION
	int "Rollback version stored in the image data"
	default 0
	help
	  This value is used by the RW signature verification to check if RW
	  part of firmware wasn't downgraded to vulnerable version. Minimal
	  rollback version is stored in rollback regions.

if PLATFORM_EC_ROLLBACK

config PLATFORM_EC_ROLLBACK_SECRET_SIZE
	int "Size of rollback secret"
	default 32
	help
	  Size of the rollback secret.

config PLATFORM_EC_ROLLBACK_UPDATE
	bool "Allow rollback secret updating"
	default n
	help
	  If enabled, rollback secret can be updated (e.g. by adding more
	  entropy to it).

config PLATFORM_EC_ROLLBACK_MPU_PROTECT
	bool "Enable MPU protection of rollback regions"
	depends on MPU
	default y
	help
	  If enabled, flash area that contains rollback data will be protected
	  against unwanted read/write.

endif  # PLATFORM_EC_ROLLBACK
```

## zephyr/Kconfig.rsa
```kconfig
# Copyright 2023 The ChromiumOS Authors
# Use of this source code is governed by a BSD-style license that can be
# found in the LICENSE file.

config PLATFORM_EC_RSA
	bool "Support verifying RSA signature"
	help
	  Includes a library for verifying RSA signature.

	  The algorithm parameters are pre-defined and configurable using
	  following config variables.

if PLATFORM_EC_RSA

config PLATFORM_EC_RSA_KEY_SIZE
	int "RSA key size"
	default 2048
	help
	  This option specifies the key size used by RSA algorithm.

config PLATFORM_EC_RSA_EXPONENT_3
	bool "Use RSA exponent 3"
	help
	  Use public exponent 3 instead of F4(65537). Keys with exponent 3 are
	  much quicker to verify, can be used on time critical tasks.

endif # PLATFORM_EC_RSA

config PLATFORM_EC_RWSIG
	bool "Verify the RW firmware using the RSA signature."
	select HAS_TASK_RWSIG
	select PLATFORM_EC_RSA
	help
	  For accessories without software sync, enable this option to allow RO
	  verify the RW firmware using RSA signature.

	  This requires RO firmware contains a 1kB KEY_RO section that holds
	  the public key in vboot v2.1 format, and RW firmware contains a 1kB
	  SIG_RW section that holds the signature.

	  Board should specify the path to the private key using
	  PLATFORM_EC_RWSIG_KEY_PATH config variable.

if PLATFORM_EC_RWSIG

config PLATFORM_EC_RWSIG_KEY_PATH
	string "Path to the RSA private key for RWSIG signing"
	help
	  Path to the RSA private key in PEM format, relative to the platform/ec
	  repo.

endif # PLATFORM_EC_RWSIG
```

## zephyr/Kconfig.sensor_devices
```kconfig
# Copyright 2021 The Chromium OS Authors. All rights reserved.
# Use of this source code is governed by a BSD-style license that can be
# found in the LICENSE file.

menu "Sensor Devices"

config PLATFORM_EC_ACCEL_BMA255
	bool "BMA2X2 Accelerometer Family Driver"
	help
	  The driver supports Bosch's a triaxial, low-g acceleration sensor.
	  It allows measurements of acceleration in three perpendicular axes.
	  Currently the driver supports BMA253, BMA255, BMA355, BMA280, BMA282,
	  BMA223, BMA254, BMA284, BMA250E, BMA222E, BMC150 BMC056, BMC156.

config PLATFORM_EC_ACCELGYRO_BMI260
	bool "BMI260 Accelgyrometer Driver"
	help
	  The driver supports Bosch's BMI260 which is an IMU consisting of
	  a 16-bit tri-axial gyroscope and a 16-bit tri-axial accelerometer.

config PLATFORM_EC_ALS_TCS3400
	bool "TCS3400 Ambient Light Senseor Driver"
	help
	  The driver supports TCS3400 which provides color and
	  IR (red, green, blue, clear and IR) ambient light sensing.

choice
	prompt "Accelgyro ICM's communication mode"
	help
	  When using the ICM drivers, there's the option to communicate with the
	  chip via several methods. This choice helps improve code size by only
	  compiling the needed communication channels.

config PLATFORM_EC_ACCELGYRO_ICM_SPI
	bool "Use SPI communication"
	help
	  The ICM chip is using SPI communication. This config value is used to
	  save on code size as only the SPI communication code will be included
	  for the ICM chip.

config PLATFORM_EC_ACCELGYRO_ICM_I2C
	bool "Use I2C communication"
	help
	  The ICM chip is using I2C communication. This config value is used to
	  save on code size as only the I2C communication code will be included
	  for the ICM chip.

endchoice

endmenu # Sensor devices
```

## zephyr/Kconfig.stacks
```kconfig
# Copyright 2021 The Chromium OS Authors. All rights reserved.
# Use of this source code is governed by a BSD-style license that can be
# found in the LICENSE file.

##############################################################################

# Zephyr internal stack sizes
#
# The intent is to try and keep the stack sizes in one place.

config MAIN_STACK_SIZE
	default 1536 if SOC_SERIES_RISCV32_IT8XXX2
	default 1200

config IDLE_STACK_SIZE
	default 192 if SOC_SERIES_NPCX7
	default 400

config ISR_STACK_SIZE
	default 800 if SOC_SERIES_RISCV32_IT8XXX2
	default 1024

config SHELL_STACK_SIZE
	default 1536

config SYSTEM_WORKQUEUE_STACK_SIZE
	default 1200 if SOC_SERIES_RISCV32_IT8XXX2
	default 1024

# Chromium EC stack sizes

config TASK_CHARGER_STACK_SIZE
	default 1280 if SOC_SERIES_RISCV32_IT8XXX2
	default 704 if SOC_SERIES_NPCX7
	default 1056 if SOC_SERIES_NPCX9

config TASK_CHIPSET_STACK_SIZE
	default 820 if SOC_SERIES_RISCV32_IT8XXX2
	default 1056 if AP_x86
	default 684 if AP_ARM && SOC_SERIES_NPCX7
	default 1056 if AP_ARM && SOC_SERIES_NPCX9
	default 1200 # Safe default

config TASK_HOSTCMD_STACK_SIZE
	default 1024 if SOC_SERIES_RISCV32_IT8XXX2
	default 800

config TASK_KEYPROTO_STACK_SIZE
	default 640

config TASK_KEYSCAN_STACK_SIZE
	default 1024

config TASK_MOTIONSENSE_STACK_SIZE
	default 920 if SOC_SERIES_RISCV32_IT8XXX2
	default 800

config TASK_POWERBTN_STACK_SIZE
	default 672

config TASK_PD_STACK_SIZE
	default 1536 if SOC_SERIES_RISCV32_IT8XXX2
	default 1184

config TASK_PD_INT_STACK_SIZE
	default 736

config TASK_USB_CHG_STACK_SIZE
	default 1024 if SOC_SERIES_RISCV32_IT8XXX2
	default 800
```

## zephyr/Kconfig.system
```kconfig
# Copyright 2021 The Chromium OS Authors. All rights reserved.
# Use of this source code is governed by a BSD-style license that can be
# found in the LICENSE file.

if PLATFORM_EC

config PLATFORM_EC_SYSTEM_PRE_INIT_PRIORITY
	int "System pre-initialization priority"
	default 20
	range 0 99
	help
	  CROS system uses some critical data (e.g., system reset cause) for
	  initialization. We define a PLATFORM_EC_SYSTEM_PRE_INIT_PRIORITY and
	  specify system should prepare those data before this priority for the
	  following initialization. Also, chip drivers should and only initial 
	  the critical processing for system_pre_init() before
	  PLATFORM_EC_SYSTEM_PRE_INIT_PRIORITY. This config sets the system
	  pre-initialization priority. We should let the priority as higher as
	  we can.

endif # PLATFORM_EC
```

## zephyr/Kconfig.temperature
```kconfig
# Copyright 2021 The Chromium OS Authors. All rights reserved.
# Use of this source code is governed by a BSD-style license that can be
# found in the LICENSE file.

menuconfig PLATFORM_EC_TEMP_SENSOR
	bool "Temperature sensors"
	default y
	help
	  Support for temperature sensors. Once enabled, "temps" console
	  command and EC_CMD_TEMP_SENSOR_GET_INFO host command are available.

if PLATFORM_EC_TEMP_SENSOR

config PLATFORM_EC_THERMISTOR
	bool "Thermistor support"
	depends on PLATFORM_EC_ADC
	help
	  Enables support for thermistors (resistor whose resistance is
	  strongly dependent on temperature) as temperature-sensor type.

config PLATFORM_EC_STEINHART_HART_3V0_22K6_47K_4050B
	bool "Steinhart-hart 3V0_22K6_47K_4050B"
	depends on PLATFORM_EC_THERMISTOR
	help
	  Enables support for 3V0_22K6_47K_4050B thermistor with
	  Steinhart–Hart equation (a model of the resistance of at
	  different temperatures).

config PLATFORM_EC_STEINHART_HART_3V3_13K7_47K_4050B
	bool "Steinhart-hart 3V3_13K7_47K_4050B"
	depends on PLATFORM_EC_THERMISTOR
	help
	  Enables support for 3V3_13K7_47K_4050B thermistor with
	  Steinhart–Hart equation (a model of the resistance of at
	  different temperatures).

config PLATFORM_EC_STEINHART_HART_3V3_30K9_47K_4050B
	bool "Steinhart-hart 3V3_30K9_47K_4050B"
	depends on PLATFORM_EC_THERMISTOR
	help
	  Enables support for 3V3_30K9_47K_4050B thermistor with
	  Steinhart–Hart equation (a model of the resistance of at
	  different temperatures).

config PLATFORM_EC_STEINHART_HART_3V3_51K1_47K_4050B
	bool "Steinhart-hart 3V3_51K1_47K_4050B"
	depends on PLATFORM_EC_THERMISTOR
	default y
	help
	  Enables support for 3V3_51K1_47K_4050B thermistor with
	  Steinhart–Hart equation (a model of the resistance of at
	  different temperatures).
endif # PLATFORM_EC_TEMP_SENSOR
```

## zephyr/Kconfig.test
```kconfig
# Copyright 2023 The ChromiumOS Authors
# Use of this source code is governed by a BSD-style license that can be
# found in the LICENSE file.

# Common location for test related Kconfigs

if ZTEST

config PLATFORM_EC_TEST_CC_USBPD
	bool "Enable USBPD console channel"
	help
	  Enable USBPD console channel

endif # ZTEST

config HW_TEST
	bool "Include tests that will be run on hardware"
	help
	  Enables building full image with zmake that includes tests.
	  The tests can be run via console or are run automatically depending
	  on a test framework and other configs.

if HW_TEST

config HW_TEST_ON
	bool

config HW_TEST_RW_ONLY
	bool "Include harwdware tests only in the RW copy"
	default y

if HW_TEST_RW_ONLY

config CROS_EC_RW
	select HW_TEST_ON

endif # HW_TEST_RW_ONLY

if !HW_TEST_RW_ONLY

# If !HW_TEST_RW_ONLY enable tests for RO and RW
config HW_TEST_ON
	default y

endif # !HW_TEST_RW_ONLY

if HW_TEST_ON

rsource "test/hwtest/Kconfig"

choice HW_TEST_FRAMEWORK
	prompt "Test Framework for tests on hardware"
	default HW_TEST_ZTEST

config HW_TEST_ZTEST
	bool "ZTEST"
	select ZTEST

endchoice # HW_TEST_FRAMEWORK

endif # HW_TEST_ON
endif # HW_TEST
```

## zephyr/Kconfig.touchpad
```kconfig
# Copyright 2023 The ChromiumOS Authors
# Use of this source code is governed by a BSD-style license that can be
# found in the LICENSE file.

config PLATFORM_EC_TOUCHPAD
	bool "Touchpad support"
	select HAS_TASK_TOUCHPAD
	help
	  Enable touchpad support. Enabling this automatically enables
	  HAS_TASK_TOUCHPAD to have a dedicated task for touchpad data
	  pipeline.

	  Must pick a driver from the options below.

config PLATFORM_EC_TOUCHPAD_ELAN
	bool "Elan touchpad driver"
	default y if DT_HAS_ELAN_EKTH3000_ENABLED
	select PLATFORM_EC_TOUCHPAD
	help
	  Adds support for Elan I2C touchpad.

config PLATFORM_EC_TOUCHPAD_PCT1X36
	bool "PIX touchpad driver"
	select PLATFORM_EC_TOUCHPAD
	depends on USB_DEVICE_STACK
	default n
	help
	  Adds support for pixart I2C touchpad.

config USB_DC_TOUCHPAD_PCT1X36_HID_NUM
	int "Set the HID number for touchpad instance name"
	depends on PLATFORM_EC_TOUCHPAD_PCT1X36
	default 1
	help
	  Set the hid number for touchpad instance name.
	  The format of hid instance name is name_n, where the name can be
	  configured by CONFIG_USB_HID_DEVICE_NAME and n(hid number) should be in
	  the range of 0 to (CONFIG_USB_HID_DEVICE_COUNT - 1).
```

## zephyr/Kconfig.usba
```kconfig
# Copyright 2022 The Chromium OS Authors. All rights reserved.
# Use of this source code is governed by a BSD-style license that can be
# found in the LICENSE file.

menuconfig PLATFORM_EC_USBA
	bool "USB Type-A support"
	help
	  Enable USB Type A ports

	  To use this your board code must provide a usb_port_enable[] array
	  with the GPIOs to use for each port. This implements the
	  EC_CMD_USB_CHARGE_SET_MODE host command and provides a 'usbchargemode'
	  console command.

if PLATFORM_EC_USBA

config PLATFORM_EC_USB_A_PORT_COUNT
	int "Number of USB-A ports"
	default 0
	help
	  This sets the number of USB-A ports on the device. These ports do
	  not support USB Power Delivery features but can be used to power
	  external devices (according to the USB 3 spec, not the Battery Charger
	  standard) and to charge devices slowly if power is enabled to them.

choice
	prompt "Port power control mode"
	depends on PLATFORM_EC_USB_A_PORT_COUNT > 0

config PLATFORM_EC_USB_PORT_POWER_DUMB
	bool "Dumb"
	help
	  USB-A ports are controlled with a single GPIO each, where turning it
	  on enables the port and turning it off disables the port.

config PLATFORM_EC_USB_PORT_POWER_SMART
	bool "Smart"
	help
	  USB-A ports are controlled via a smart switch, which allows dynamic
	  selection of port current limits and BC1.2 charging modes.

endchoice

config PLATFORM_EC_USB_PORT_POWER_DUMB_CUSTOM_HOOK
	bool "Disable default dumb port power hooks"
	depends on PLATFORM_EC_USB_PORT_POWER_DUMB
	help
	  Enable this if your board does not want to use the default S3 hooks
	  from USB_PORT_POWER_DUMB.

config PLATFORM_EC_USB_PORT_POWER_SMART_CDP_SDP_ONLY
	bool "CDP/SDP mode only"
	depends on PLATFORM_EC_USB_PORT_POWER_SMART
	help
	  Enable this if the USB-A smart switch mode selection is fixed and
	  the only control is for CDP or SDP mode via current limit selection.

endif # PLATFORM_EC_USBA
```
