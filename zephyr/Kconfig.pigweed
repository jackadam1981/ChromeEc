## zephyr/Kconfig.usbc
```kconfig
# Copyright 2020 The Chromium OS Authors. All rights reserved.
# Use of this source code is governed by a BSD-style license that can be
# found in the LICENSE file.

# TODO: Should we have a config to enable TCPC?

config PLATFORM_EC_USBC
	bool "Enable USB Type-C functionality"
	default y
	help
	  Enable this to support various USB Type-CC features chosen by the
	  options below. USB-C is widely used on modern Chromebooks and the EC's
	  role is to deal with power delivery, including negotiating power
	  contracts, role changes and dealing with low-power situations.

if PLATFORM_EC_USBC

config PLATFORM_EC_USB_POWER_DELIVERY
	bool "Enable support for USB Type-C Power Delivery"
	default y
	help
	  USB has always provided basic power to an attached peripheral. USB-C
	  PD is part of the USB 3.0 standard and allows a lot more functionality
	  than the basic 500mA @ 5V. It allows negotiating power delivery over
	  the USB cable to select voltages up to 20V with current up to 5A.

config PLATFORM_EC_CHARGE_MANAGER
	bool "Enable the charge manager"
	default y
	help
	  This does some managing of charging. I suppose it enables and disables
	  charging and decides how much voltage / current to request?

	  TODO: Fix this up in code review

config PLATFORM_EC_CHARGER_INPUT_CURRENT
	int "Charger input current in mA"
	help
	  This is the default input current for the board in mA.  Many boards
	  also use this as the least maximum input current during transients.

	  This value should depend on external power adapter, designed charging
	  voltage, and the maximum power of the running system. For type-C chargers,
	  this should be set to 512 mA in order to not brown-out low-current USB
	  charge ports in accordance with USB-PD r3.0 Sec. 7.3

config PLATFORM_EC_USBC_OCP
	bool
	help
	  Enable this to handle over-current conditions.

	  This should be enabled by drivers which can detect over-current. It
	  cannot be set otherwise, even in prj.conf

config PLATFORM_EC_USB_PD_HOST_CMD
	bool "Enable host commands related to USB Power Delivery"
	default y
	help
	  This enables host commands which allow finding out the capabilities
	  of USB PD, checking is status and controlling how it operates. For
	  devices which support firmware update, this is provided as well,
	  with the firmware being sent from the AP.

config PLATFORM_EC_USB_PD_VBUS_MEASURE_NOT_PRESENT
	bool "Vbus voltage cannot be read"
	help
	  Enable this if there is no way to measure the Vbus voltage (e.g. using
	  an EC.

	  TODO: Consider making this a choice with these:

	     CONFIG_USB_PD_VBUS_MEASURE_CHARGER
	     CONFIG_USB_PD_VBUS_MEASURE_TCPC
	     CONFIG_USB_PD_VBUS_MEASURE_ADC_EACH_PORT

	  or perhaps we should put it into the device tree.

config PLATFORM_EC_USB_PD_DUAL_ROLE
	bool "Board can act as a dual-role Power Delivery port"
	default y
	help
	  This enables support for switching between source and sink during
	  operation. This means that the port can accept power (e.g. to charge
	  up its battery), or send out power to an attached device on the same
	  port.

	  TODO: Default y?

config PLATFORM_EC_USB_PD_DUAL_ROLE_AUTO_TOGGLE
	bool "Board can used TCPC-controlled DRP toggle"
	depends on PLATFORM_EC_USB_PD_DUAL_ROLE
	default y
	help
	  Enable this if the board can switch power roles (source / sink) on
	  its Dual-Role Port under control of the USB Type-C Port Controller
	  (TCPC). This means that the devices can negotiate their power roles
	  dynamically during operations.

	  TODO: Default y?

config PLATFORM_EC_USB_PD_DISCHARGE
	bool "Board can enable Vbus discharge"
	default y
	help
	  Enable this if the board can enable VBUS discharge (eg. through a
	  GPIO-controlled discharge circuit, or through port controller
	  registers) to discharge VBUS rapidly on disconnect

choice "Discharge method"
	prompt "Select the discharge method"

config PLATFORM_EC_USB_PD_DISCHARGE_GPIO
	bool "GPIO control"
	help
	  Enable this if the discharge circuit is controlled by a GPIO

	  TODO: How to specify the GPIO?

config PLATFORM_EC_USB_PD_DISCHARGE_TCPC
	bool "GPIO control"
	help
	  Enable this if the discharge circuit is provided by Power-Delivery
	  resistors on the USB Type-C Port Controller (TCPC).

	  TODO: Anything else to say?

config PLATFORM_EC_USB_PD_DISCHARGE_PPC
	bool "Discharge circuit is using PD discharge registers on PPC"
	help
	  Enable this if the discharge circuit is using Power Delivery
	  resistors on the Power Path Controller.

	  TODO: What else to say here?

endchoice  # Discharge method

config PLATFORM_EC_USB_PD_TCPMV2
	bool "Use the USB Power Delivery state machine version 2"
	default y
	help
	   This enables version 2 of the Power Delivery state machine. This
	   deals with the various state changes in the system as devices are
	   plugged and unplugged, as well as changes in power requirements
	   from those devices.

	   Version 1 is deprecated and is not used on newer devices. At present
	   this cannot be enabled for use with Zephyr.

if PLATFORM_EC_USB_PD_TCPMV2

config PLATFORM_EC_CONFIG_USB_PD_REV30
	bool "Enable USB PD Rev3.0 functionality"
	help
	  By default only USB Power Delivery Rev2.0 functionality is supported.
	  Enable this to allow Rev3.0 functionality as well. New features
	  include Fast Role Swap and advertising the available power across
	  all ports of a multi-port charger.

choice "Vbus detection method"
	prompt "Select the method to detect Vbus"

config PLATFORM_EC_USB_PD_VBUS_DETECT_TCPC
	bool "TCPC detects Vbus"
	help
	  Choose this option if the TCPC can detect the presence of Vbus

config PLATFORM_EC_USB_PD_VBUS_DETECT_CHARGER
	bool "Charger detects Vbus"
	help
	  Choose this option if the battery charger can detect the presence
	  of Vbus

config PLATFORM_EC_USB_PD_VBUS_DETECT_GPIO
	bool "TCPC detects Vbus"
	help
	  Choose this option if a GPIO can detect the presence of Vbus
	  TODO: Specify the GPIO

config PLATFORM_EC_USB_PD_VBUS_DETECT_PPC
	bool "TCPC detects Vbus"
	help
	  Choose this option if the Power-Path Controller (PPC) can detect the
	  presence of Vbus

config PLATFORM_EC_USB_PD_VBUS_DETECT_NONE
	bool "No way to detect Vbus"
	help
	  Choose this option if it is not possible to detect Vbus.

endchoice  # Vbus detection method

config PLATFORM_EC_USB_TYPEC_SM
	bool "Enable dealing with Configuration Channel (CC)"
	default y
	help
	  This enables handling of the bottom layer of the TCPMv2 state
	  machine which handles using CC lines to set the voltage-level
	  of the power supplied. You should normally define this unless you want
	  to override it in your board code, which is not recommended.

config PLATFORM_EC_USB_PRL_SM
	bool "Enable flow and chunking of transmit and receive messages"
	default y
	help
	  This enables handling of the middle layer of the power-delivery (PD)
	  protocol, which deals with the flow of power messages across the USB
	  Type-C interface. You should normally define this unless you want to
	  override it in your board code, which is not recommended.

config PLATFORM_EC_USB_PE_SM
	bool "Enable PD communication flow"
	default y
	help
	  This enables handling the top layer of the power-delivery (PD)
	  protocol, which deals with the actually PD messages that are
	  exchanged with attached USB devices. ou should normally define this
	  unless you want to override it in your board code, which is not
	  recommended.

config PLATFORM_EC_USB_PD_DECODE_SOP
	def_bool y  # Required for TCPMV2
	help
	  This enables support for encoding of the message's Start Of Packet
	  (SOP, SOP' and SOP'', collectively called SOP*) in bits 31-28 of the
	  32-bit msg header type

choice "USB-C device type"
	prompt "Select the USB-C device type"
	default PLATFORM_EC_USB_DRP_ACC_TRYSRC

config PLATFORM_EC_USB_VPD
	bool "Vconn-Powered Device"
	help
	  This enables support for supplying power to devices that accept power
	  over the USB Vconn line.

	  TODO: Add more detail with help from reviewers

	  See here for details:

	  https://www.usb.org/sites/default/files/D1T2-3a%20-%20CTVPDs%20and%20Making%20Your%20Own%20USB-C%20Thingamajig.pdf

config PLATFORM_EC_USB_CTVPD
	bool "Charge Through Vconn-Powered Device"
	help
	  This enables support for supplying power to devices, with a circuit
	  that deals with this without needing the involvement of the main
	  device.

	  TODO: Add more detail with help from reviewers

config PLATFORM_EC_USB_DRP_ACC_TRYSRC
	bool "Dual-Role Port, Audio Accessory, and Try.SRC Device"
	help
	  This is the most flexible option, allowing the port to operate in
	  a dual-role capacity, so that power can be accepted or supplied on
	  a port.

	  TODO: Add more detail with help from reviewers

endchoice  # USB-C device type

endif

config PLATFORM_EC_USBC_PPC
	bool "Enable support for USB Type-C Power Path Controller"
	default y
	help
	  Enable this to support the USB Type-C PPC on your board. This enables
	  common routines for things like figuring out whether power is being
	  supplied to the Chromebook over USB-C, whether the Chromebook is
	  supplying power to another device, etc.

if PLATFORM_EC_USBC_PPC

config PLATFORM_EC_USB_PD_PORT_MAX_COUNT
	int "Maximum number of USB PD ports supported"
	default 2
	help
	  This sets the limit on the number of PD ports supported on the
	  device. This is used to set the size for tables used by devices.

	  TODO: Can we calculate this from the devicetree at some point? Or
	  update the sn5S330 driver to use an 8-bit flag byte for
	  source_enabled[] so that plenty of ports are supported without this
	  configuration option?

config PLATFORM_EC_USBC_PPC_SN5S330
	bool "Support the TI SN5S330 PD 3.0 power mux"
	select PLATFORM_EC_USBC_OCP
	help
	  This is a USB Type-C Power Delivery 3.0 Bidirectional Power Mux with
	  CC and SBU short-to-VBUS Protection and Integrated Dead Battery
	  LDO. This chips provides protection against pins shorting to Vbus as
	  well as ESD (Electostatic discharge) protection. It provides a simple
	  I2C interface for for Mode Selection, Fast Role Swap, and Fault
	  Reporting.

config PLATFORM_EC_USBC_PPC_SYV682X
	bool "Support the SYV682X which is some kind of chip"
	select PLATFORM_EC_USBC_OCP
	help
	  TODO: Get some info in here once I find the datasheet

config PLATFORM_EC_USB_PD_TCPM_TUSB422
	bool "Support the TI TUSB422 Port Control with USB PD"
	help
	  This is a a USB PD PHY that enables a USB Type-C port with the\
	  Configuration Channel (CC) logic needed for USB Type-C ecosystems. It
	  integrates the physical layer of the USB BMC power delivery (PD)
	  protocol to allow up to 100-W of power and support for alternate mode
	  interfaces. An external microprocessor, containing USB Type-C Port
	  Manager (TCPM), communicates with the TUSB422 through an I2C
	  interface.

choice "Type-C Port Manager (TCPM)"
	prompt "Choose a Type-C Port Manager (TCPM) to manage TCPC"

config PLATFORM_EC_USB_PD_TCPM_TCPCI
	bool "Use TCPCI"
	help
	  TODO: Put some help here once we know what this is

# TODO: Add other choices:
#  CONFIG_USB_PD_TCPM_STUB
#  CONFIG_USB_PD_TCPM_FUSB302
#  CONFIG_USB_PD_TCPM_ITE_ON_CHIP
#  CONFIG_USB_PD_TCPM_ANX3429
#  CONFIG_USB_PD_TCPM_ANX740X
#  CONFIG_USB_PD_TCPM_ANX741X
#  CONFIG_USB_PD_TCPM_ANX7447
#  CONFIG_USB_PD_TCPM_ANX7688
#  CONFIG_USB_PD_TCPM_NCT38XX
#  CONFIG_USB_PD_TCPM_MT6370
#  CONFIG_USB_PD_TCPM_TUSB422
#  CONFIG_USB_PD_TCPM_RAA489000
#  CONFIG_USB_PD_TCPM_RT1715
#  CONFIG_USB_PD_TCPM_FUSB307
#  CONFIG_USB_PD_TCPM_STM32GX

endchoice  # Type-C Port Manager (TCPM)

config PLATFORM_EC_CONSOLE_CMD_PPC_DUMP
	bool "Enable ppc_dump command"
	depends on PLATFORM_EC_USBC_PPC
	default y

config PLATFORM_EC_CMD_TCPC_DUMP
	bool "Enable tcpi_dump command"
	default y
	# TODO: depends on ??

endif  # PLATFORM_EC_USBC_PPC

endif  # PLATFORM_EC_USBC
```

## zephyr/Kconfig.usbc_altmode
```kconfig
# Copyright 2023 The ChromiumOS Authors
# Use of this source code is governed by a BSD-style license that can be
# found in the LICENSE file.

if PLATFORM_EC_USBC

config PLATFORM_EC_USB_PD_INTEL_ALTMODE
	bool "PD task to configure USB-C Alternate modes on Intel SoC"
	select PLATFORM_EC_USBC_SS_MUX
	select PLATFORM_EC_USB_MUX_VIRTUAL
	select PLATFORM_EC_USB_PD_HOST_CMD
	help
	  Enable this to support configuring the USB-C alternate modes on
	  Intel SoC when using PD chips in PD mode.

config PLATFORM_EC_CONSOLE_CMD_INTEL_ALTMODE
	bool "Console command: altmode"
	depends on PLATFORM_EC_USB_PD_INTEL_ALTMODE
	default y
	help
	  Enable this to read/write to the status/control registers of
	  PD that are compliant with Intel alternate mode configuration
	  specification.

endif #  PLATFORM_EC_USBC
```

## zephyr/Kconfig.usbc_common
```kconfig
# Copyright 2023 The ChromiumOS Authors
# Use of this source code is governed by a BSD-style license that can be
# found in the LICENSE file.

if PLATFORM_EC_USBC

choice PLATFORM_EC_USBC_STACK
	prompt "Select the USB-C software stack used by the platform"
	default PLATFORM_EC_USB_PD_TCPMV2
	help
	  Select a software stack used by the platform for USB-C power
	  delivery and USB-C alternate mode configurations.

config PLATFORM_EC_USB_PD_TCPMV2
	bool "USB-C Power Delivery TCPM Version 2"
	help
	  Enable USB-C Power Delivery Type-C Port Manager Version 2. It
	  implements a layered, state-based design which tracks more closely
	  with the USB Type-C and USB PD specifications.
	  Zephyr only supports v2 if the platform uses TCPC chips and EC
	  handles the TCPM, so we always define this.

config PLATFORM_EC_USB_PD_CONTROLLER
	bool "USB-C Power Delivery using a dedicated controller"
	help
	  Enable USB-C Power Delivery Type-C Port Manager using a dedicated
	  power delivery controller. The dedicated controller controls TCPM
	  and the EC manages platform power and alternate mode policies.

endchoice # PLATFORM_EC_USBC_STACK

endif # PLATFORM_EC_USBC
```
