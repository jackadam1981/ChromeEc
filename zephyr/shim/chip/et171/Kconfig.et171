## zephyr/subsys/usbd_service/Kconfig
```kconfig
# Copyright 2023 The ChromiumOS Authors
# Use of this source code is governed by a BSD-style license that can be
# found in the LICENSE file.

config USBD_HID_KEYBOARD
	bool "Enable support USB HID keyboard"
	depends on USB_DEVICE_STACK_NEXT
	default n
	help
	  Enable keyboard support.

config USBD_HID_VIVALDI
	bool "Enable support vivaldi keyboard"
	depends on USBD_HID_KEYBOARD
	default n
	help
	  Enable code for Vivaldi keyboard (standard for new Chromium OS
	  devices).

config USBD_KEYBOARD_NUM_TOP_ROW_KEYS
	int "Keyboard top raw key number"
	depends on USBD_HID_VIVALDI
	default 10
	range 10 15
	help
	  The number of top raw keys.
	  The number should be between 10 and 15.

config USBD_KEYBOARD_ASSISTANT_KEY
	bool "Enable support assistant key"
	depends on USBD_HID_KEYBOARD
	default n
	help
	  Enable assistant key for keyboard device.

config USBD_KEYBOARD_TABLET_MODE_SWITCH
	bool "Enable support tablet mode switch key"
	depends on USBD_HID_KEYBOARD
	default n
	help
	  Enable tablet mode switch for keyboard device.

config USBD_HID_TOUCHPAD
	bool "Enable support USB HID touchpad"
	depends on (USB_DEVICE_STACK || USB_DEVICE_STACK_NEXT)
	default n
	help
	  Enable touchpad support.

menu "USB device options"
	depends on USB_DEVICE_STACK_NEXT

config USB_DEVICE_MANUFACTURER
	string "USB device manufacturer string"
	default "Google"
	help
	  USB device manufacturer string.

config USB_DEVICE_PRODUCT
	string "USB device product string"
	default "HID KB and TP Sample"
	help
	  USB device product stringa.

config USB_DEVICE_SN
	string "USB device serial number string"
	default "0123456789ABCDEF"
	help
	  Placeholder for USB device serial number string.

config USB_DEVICE_VID
	hex "USB device Vendor ID"
	default 0x18D1
	help
	  USB device Vendor ID.

config USB_DEVICE_PID
	hex "USB device Product ID"
	default 0x0000
	help
	  USB device Product ID.

config USB_DEVICE_SELF_POWERED
	bool "USB device HID Self-powered attribute"
	default n
	help
	  Set the Self-powered attribute in the HID configuration.

config USB_DEVICE_REMOTE_WAKEUP
	bool "USB device HID Remote Wakeup attribute"
	default y
	help
	  Set the Remote Wakeup attribute in the HID configuration.

config USB_DEVICE_MAX_POWER
	int "USB device HID bMaxPower value"
	default 125
	range 0 250
	help
	  bMaxPower value in the HID configuration in 2 mA units.

endmenu

rsource "Kconfig.gupdate"
rsource "Kconfig.gi2c"
```

## zephyr/subsys/usbd_service/Kconfig.gupdate
```kconfig
# Copyright 2024 The ChromiumOS Authors
# Use of this source code is governed by a BSD-style license that can be
# found in the LICENSE file.

config USBD_GOOGLE_UPDATE_SUPPORT
	bool "USB Google update support"
	depends on USB_DEVICE_STACK_NEXT
	depends on PLATFORM_EC_USB_UPDATE
	select NET_BUF
	default y
	help
	  Enable Google vender specific class.

config GOOGLE_UPDATE_THREAD_PRIORTY
	int "Google update thread priority"
	depends on USBD_GOOGLE_UPDATE_SUPPORT
	default 8
	help
	  Set thread priority of the Google update.

config GOOGLE_UPDATE_STACK_SIZE
	int "Size of the thread stack"
	depends on USBD_GOOGLE_UPDATE_SUPPORT
	default 2048
	help
	  Size of the Google update thread stack.
```

## zephyr/test/amd_power/testcase.yaml
```yaml
common:
  platform_allow: native_posix
tests:
  ec.ro:
    extra_args:
      - EXTRA_CFLAGS=-DSECTION_IS_RO
  ec.rw:
    extra_args:
      - EXTRA_CFLAGS=-DSECTION_IS_RW
  amd_power.default:
    extra_dtc_overlay_files:
      - boards/native_posix.overlay
```

## zephyr/test/boot_keys/testcase.yaml
```yaml
common:
  platform_allow: native_sim
tests:
  boot_keys.default: {}
  boot_keys.ignore_key:
    extra_configs:
      - CONFIG_BOOT_KEYS_COL2_WORKAROUND=y
```

## zephyr/test/brox/Kconfig
```kconfig
# Copyright 2022 The ChromiumOS Authors
# Use of this source code is governed by a BSD-style license that can be
# found in the LICENSE file.

choice TEST_PROJECT_TYPE
	prompt "Select board variant for tests"
	help
	  Board variant to use for tests

config TEST_PROJECT_BROX
	bool "Enable rex-specific tests"
	help
	  Enable tests for brox variant.
endchoice # TEST_PROJECT_TYPE

config TEST_PROJECT_NAME
	string "Board name"
	default "brox" if TEST_PROJECT_REX

config TEST_PROGRAM_BOARD_POWER
	bool "Run the tests intended for board_power"
	help
	  Include board_power.c into the binary and test
	  their functions.

config TEST_DISABLE_AP_PWRSEQ
	bool "Disable CONFIG_AP_PWRSEQ"
	default n
	help
	  This is used to disable CONFIG_AP_PWRSEQ for testing purposes
	  directly.

module = BROX
module-str = Brox board-specific code
source "subsys/logging/Kconfig.template.log_config"

source "Kconfig.zephyr"
```
