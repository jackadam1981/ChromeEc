## zephyr/shim/chip/mchp/Kconfig.xec
```kconfig
# Copyright 2022 The ChromiumOS Authors
# Use of this source code is governed by a BSD-style license that can be
# found in the LICENSE file.

if PLATFORM_EC

config CROS_SYSTEM_XEC_PRE_INIT_PRIORITY
	int "System pre-initialization priority"
	default 15
	range 10 19
	depends on SOC_FAMILY_MICROCHIP_MEC
	help
	  This sets the priority of the MCHP XEC chip system initialization.
	  The chip system initialization verifies the integrity of the BBRAM
	  must be a lower priority than CONFIG_BBRAM_INIT_PRIORITY and
	  must be a higher priority than PLATFORM_EC_SYSTEM_PRE_INIT.

config CROS_SYSTEM_XEC_VCI_GPIO
	bool
	default y if PLATFORM_EC_HIBERNATE_VCI && DT_HAS_CROS_EC_VCI_GPIOS_ENABLED
	help
	  Use VCI pins as GPIOS, this is useful in case VCI_INx pin is not
	  multiplexed with any GPIO.


if CROS_SYSTEM_XEC_VCI_GPIO

config VCI_GPIO_IN0_RISING_TIMER
	bool
	default y
	help
	  VCI_IN0 pin does not support configuring risin edge interruption,
	  this will use SW solution for this limitation.
endif
endif # PLATFORM_EC
```

## zephyr/shim/chip/npcx/Kconfig.npcx
```kconfig
# Copyright 2021 The Chromium OS Authors. All rights reserved.
# Use of this source code is governed by a BSD-style license that can be
# found in the LICENSE file.

if PLATFORM_EC

config CROS_SYSTEM_NPCX_PRE_INIT_PRIORITY
	int "System pre-initialization priority"
	default 15
	range 10 19
	depends on SOC_FAMILY_NPCX
	help
	  This sets the priority of the NPCX chip system initialization. The
	  chip system initialization verifies the integrity of the BBRAM and
	  must be a lower priority than CONFIG_CROS_BBRAM_NPCX_INIT_PRIORITY and
	  must be a higher priority than PLATFORM_EC_SYSTEM_PRE_INIT.

config CROS_SHI_NPCX_TEST
	bool "Nuvoton NPCX Serial Host Interface driver for the Zephyr shim"
	depends on SOC_FAMILY_NPCX
	default n
	help
	  This option enables the test version Serial Host Interface driver for
	  the NPCX family of processors. This is used for host command
	  communication on the platform which AP is ARM-based SoC.

endif # PLATFORM_EC
```

## zephyr/shim/src/usb/Kconfig
```kconfig
config USB_Trans
    bool "USB Trans"
    help
        This option enables USB communication for the USB Trans module.
```

## zephyr/subsys/altersense/Kconfig
```kconfig
menuconfig ALTERSENSE
	bool "Alternate Sensor Selection"
	help
	  This option enables the alternate sensor selection module which allows
	  boards to select between various sensors at runtime.

if ALTERSENSE

module = ALTERSENSE
module-str = Alternate Sensor Selection
source "subsys/logging/Kconfig.template.log_config"

config ALTERSENSE_CBI_MODE_SSFC
	bool
	help
	  Select alternate sensor based on Second Source Firmware Cache value

config ALTERSENSE_CBI_MODE_BOARD_VERSION
	bool
	help
	  Select alternate sensor based on board version

endif # ALTERSENSE

endmenu # ALTERSENSE
```

## zephyr/subsys/ap_pwrseq/Kconfig
```kconfig
# Copyright 2022 The Chromium OS Authors. All rights reserved.
# Use of this source code is governed by a BSD-style license that can be
# found in the LICENSE file.

if AP_PWRSEQ

module = AP_PWRSEQ
module-str = AP power sequencing
source "subsys/logging/Kconfig.template.log_config"

config X86_NON_DSX_PWRSEQ
	bool
	default n
	help
	  This option enables Non Deep Sleep Well power sequencing for
	  Intel x86 chips.

config X86_NON_DSX_PWRSEQ_ADL
	bool "x86 Non Deep Sx power sequencing on ADL"
	depends on AP_X86_INTEL_ADL
	select X86_NON_DSX_PWRSEQ
	default n
	help
	  This enables AP power sequencing support for Intel Alderlake
	  family of chipset.

config X86_NON_DSX_PWRSEQ_MTL
	bool "x86 Non Deep Sx power sequencing on MTL"
	depends on AP_X86_INTEL_MTL
	select X86_NON_DSX_PWRSEQ
	default n
	help
	  This enables AP power sequencing support for Intel Meteorlake
	  family of chipset.

config X86_NON_DSX_PWRSEQ_CONSOLE
	bool "Console commands for x86 Non Deep Sx power sequencing"
	depends on X86_NON_DSX_PWRSEQ
	default n
	help
	  This option enables Non Deep Sleep Well power sequencing shell
	  console commands to debug.

config X86_NON_DSX_PWRSEQ_HOST_CMD
	bool "Host commands for x86 Non Deep Sx power sequencing"
	depends on X86_NON_DSX_PWRSEQ
	default y
	help
	  This option enables Non Deep Sleep Well power sequencing host
	  commands to debug.

config AP_PWRSEQ_HOST_SLEEP
	bool "Handle host sleep state changes"
	help
	  Enable AP power sequencing to receive and process host command
	  host sleep state changes.

config AP_PWRSEQ_S0IX
	bool "Enable power state S0ix for Intel x86 chipset"
	select AP_PWRSEQ_HOST_SLEEP
	default n
	help
	  This option enables power state S0ix for Intel x86 chipset. As
	  required, AP_PWRSEQ_HOST_SLEEP for host sleep event handling is
	  enabled.

endif
```

## zephyr/subsys/ascp/Kconfig
```kconfig
# Copyright 2026 The ChromiumOS Authors
# Use of this source code is governed by a BSD-style license that can be
# found in the LICENSE file.

if PLATFORM_EC_FINGERPRINT_ASCP_PLATFORM

config PLATFORM_EC_FINGERPRINT_ASCP_ADDR_PK_M
	hex "Address of pk_m"
	default 0x80000138 if PLATFORM_EC_FINGERPRINT_ASCP_EN171
	default 0x10001499 if PLATFORM_EC_FINGERPRINT_ASCP_FT9001
	help
	  Address of the public key of the manufacturer.

config PLATFORM_EC_FINGERPRINT_ASCP_ADDR_S_GOOG
	hex "Address of s_goog"
	default 0x80000179 if PLATFORM_EC_FINGERPRINT_ASCP_EN171
	default 0x10001000 if PLATFORM_EC_FINGERPRINT_ASCP_FT9001
	help
	  Address of the signature of the google public key.

config PLATFORM_EC_FINGERPRINT_ASCP_ADDR_PK_D
	hex "Address of pk_d"
	default 0x80000035 if PLATFORM_EC_FINGERPRINT_ASCP_EN171
	default 0x10001408 if PLATFORM_EC_FINGERPRINT_ASCP_FT9001
	help
	  Address of the public key of the device.

config PLATFORM_EC_FINGERPRINT_ASCP_ADDR_S_M
	hex "Address of s_m"
	default 0x80000076 if PLATFORM_EC_FINGERPRINT_ASCP_EN171
	default 0x10001451 if PLATFORM_EC_FINGERPRINT_ASCP_FT9001
	help
	  Address of the signature of the manufacturer public key.

config PLATFORM_EC_FINGERPRINT_ASCP_ADDR_PK_F
	hex "Address of pk_f"
	default 0x90000060 if PLATFORM_EC_FINGERPRINT_ASCP_EN171
	default 0x1FFF8048 if PLATFORM_EC_FINGERPRINT_ASCP_FT9001
	help
	  Address of the public key of the factory.

config PLATFORM_EC_FINGERPRINT_ASCP_ADDR_H_F
	hex "Address of h_f"
	default 0x90000000 if PLATFORM_EC_FINGERPRINT_ASCP_EN171
	default 0x1FFF8089 if PLATFORM_EC_FINGERPRINT_ASCP_FT9001
	help
	  Address of the hash of the factory public key.

config PLATFORM_EC_FINGERPRINT_ASCP_ADDR_S_D
	hex "Address of s_d"
	default 0x90000020 if PLATFORM_EC_FINGERPRINT_ASCP_EN171
	default 0x1FFF8000 if PLATFORM_EC_FINGERPRINT_ASCP_FT9001
	help
	  Address of the signature of the device public key.

config PLATFORM_EC_FINGERPRINT_ASCP_ADDR_SK_F
	hex "Address of sk_f"
	default 0x900000A0 if PLATFORM_EC_FINGERPRINT_ASCP_EN171
	default 0x1FFF8091 if PLATFORM_EC_FINGERPRINT_ASCP_FT9001
	help
	  Address of the private key of the factory.

endif # PLATFORM_EC_FINGERPRINT_ASCP_PLATFORM
```

## zephyr/subsys/board_id/Kconfig
```kconfig
menuconfig INTEL_BOARD_ID
	bool "Intel board ID support"
	default y
	depends on DT_HAS_INTEL_BOARD_ID_ENABLED

if INTEL_BOARD_ID
config INTEL_VARIANT_GPIO
	bool "Intel board ID support"
	default y
	depends on DT_HAS_INTEL_VARIANT_GPIO_ENABLED
endif
```

## zephyr/subsys/bt_passthru/Kconfig
```kconfig
# Copyright 2025 The ChromiumOS Authors
# Use of this source code is governed by a BSD-style license that can be
# found in the LICENSE file.

menuconfig BT_PASSTHRU
	bool "Enable Bluetooth passthrough"
	help
	  Enable bluetooth passthrough host commands to pass data to ISH

if BT_PASSTHRU

module = BT_PASSTHRU
module-str = BT Passthru
source "subsys/logging/Kconfig.template.log_config"

config BT_PASSTHRU_INIT_PRIORITY
	int "BT passthru stack init priority"
	default 91
	help
	  Initialization priority of BT passthru in POST_KERNEL.

config BT_PASSTHRU_THREAD_PRIORTY
	int "BT passthru thread priority"
	default 0
	help
	  Set thread priority of the BT passthrough

config BT_PASSTHRU_STACK_SIZE
	int "BT passthru thread stack size"
	default 1024
	help
	  Stack size of thread.

endif # BT_PASSTHRU
```

## zephyr/subsys/chre/Kconfig
```kconfig
# Copyright 2021 The Chromium OS Authors. All rights reserved.
# Use of this source code is governed by a BSD-style license that can be
# found in the LICENSE file.

menuconfig CHRE
	bool "Context Hub Runtime Environment"
	select CPLUSPLUS

if CHRE

config CHRE_MESSAGE_TO_HOST_MAX_SIZE
	int "Maximum message size to send to the host (bytes)"
	default 4000 if SOC_POSIX
	default 128
	help
	  Defines the maximum message size that can be sent to the host.

choice CHRE_MINIMUM_LOG_LEVEL
	prompt "Select the default minimum log level"
	default CHRE_MINIMUM_LOG_LEVEL_WARN
	help
	  The lowers log level that should print. Any logs with higher levels
	  than this one will be removed at compile time.

config CHRE_MINIMUM_LOG_LEVEL_MUTE
	bool "Mute all CHRE logging"
	help
	  When selected, all CHRE logs (ERROR, WARNING, INFO, DEBUG, and
	  VERBOSE) will be ignored.

config CHRE_MINIMUM_LOG_LEVEL_ERROR
	bool "Log CHRE errors"
	help
	  When selected, CHRE logs at the ERROR level will be seen in the
	  console.

config CHRE_MINIMUM_LOG_LEVEL_WARN
	bool "Log CHRE warnings and errors"
	help
	  When selected, CHRE logs at the ERROR and WARNING levels will be seen
	  in the console.

config CHRE_MINIMUM_LOG_LEVEL_INFO
	bool "Log CHRE info, warnings, and errors"
	help
	  When selected, CHRE logs at the ERROR, WARNING, and INFO levels will
	  be seen in the console.

config CHRE_MINIMUM_LOG_LEVEL_DEBUG
	bool "Log CHRE debug, info, warnings, and errors"
	help
	  When selected, CHRE logs at the ERROR, WARNING, INFO, and DEBUG levels
	  will be seen in the console.

config CHRE_MINIMUM_LOG_LEVEL_VERBOSE
	bool "Enable all CHRE logging"
	help
	  When selected, CHRE logs at the ERROR, WARNING, INFO, DEBUG, and
	  VERBOSE levels will be seen in the console.

endchoice # CHRE_MINIMUM_LOG_LEVEL

config CHRE_ASSERTIONS
	bool "Enable CHRE assertions"
	default false
	help
	  When enabled, CHRE will include various assertions which will trigger
	  calls to chreAbort if resolve to false.

endif # CHRE
```

## zephyr/subsys/debug/Kconfig
```kconfig
# Copyright 2024 The ChromiumOS Authors
# Use of this source code is governed by a BSD-style license that can be
# found in the LICENSE file.

config PLATFORM_EC_GDBSTUB
	bool "Enable GDB debugging support"
	select GDBSTUB
	select GDBSTUB_BACKEND_NONE
	select GDBSTUB_FEATURE_MULTIPROCESS
	select GDBSTUB_FEATURE_HWBREAK

if PLATFORM_EC_GDBSTUB

choice PLATFORM_EC_GDBSTUB_BACKEND
	prompt "GDB stub backend"
	default PLATFORM_EC_GDBSTUB_BACKEND_CONSOLE

	config PLATFORM_EC_GDBSTUB_BACKEND_CONSOLE
    	bool "Console GDB stub backend"
		help
		  Communicate to GDB stub through console commands

endchoice # PLATFORM_EC_GDBSTUB_BACKEND

config PLATFORM_EC_GDBSTUB_BACKEND_PRIORITY
	int "Priority for GDB stub backend thread"
	default 0

if PLATFORM_EC_GDBSTUB_BACKEND_CONSOLE

config PLATFORM_EC_GDBSTUB_BACKEND_CONSOLE_BUFFER_LEN
	int "Console GDB stub backend buffer size"
	default 256
	help
	  Size of buffer used to store GDB packets sent through the console

endif # PLATFORM_EC_GDBSTUB_BACKEND_CONSOLE

endif # PLATFORM_EC_GDBSTUB
```

## zephyr/subsys/emul/ap_pwrseq/Kconfig
```kconfig
# Copyright 2022 The ChromiumOS Authors
# Use of this source code is governed by a BSD-style license that can be
# found in the LICENSE file.

if ZTEST

config EMUL_POWER_SIGNALS
	bool "Enable Power Signals emulator"
	help
	  Power signals emulator supports executing AP Power Sequence test by
	  enabling configuring power signals behavior using devicetree.

if EMUL_POWER_SIGNALS

module = EMUL_POWER_SIGNALS
module-str = Power Signals Emulator
source "subsys/logging/Kconfig.template.log_config"

endif
endif
```

## zephyr/subsys/fingerprint/alg/Kconfig
```kconfig
# Copyright 2023 The ChromiumOS Authors
# Use of this source code is governed by a BSD-style license that can be
# found in the LICENSE file.

choice FP_ALGORITHM
	prompt "Fingerprint matching algorithm"
	default FP_FPC_BEP_ALGORITHM if FINGERPRINT_SENSOR_FPC1025
	help
	 Select Fingerprint matching algotithm that will be used to create new
	 templates and compare finger scan.

config FP_FPC_BEP_ALGORITHM
	bool "FPC BEP matching algorithm"
	help
	  Enable FPC BEP matching algorithm. To work properly, FPC private
	  library is required.
endchoice

config FP_ALGORITHM_TEMPLATE_SIZE
	int "Size of template size"
	default 5092 if FINGERPRINT_SENSOR_FPC1025 && FP_FPC_BEP_ALGORITHM
	default 0
	help
	  Constant value corresponding to the maximum template size.
	  Client template memory allocation must have this size.
	  This includes extra memory for template update.

	  For example, for FPC1025 sensor template size is 5092 bytes which
	  consists of template size + alignment padding + size of template
	  size variable.

config HAVE_BEP_PRIVATE_DRIVER
	bool
	default n
	help
	  If enabled, it indicates that BEP private driver is present.
```

## zephyr/subsys/modular_aic/Kconfig
```kconfig
# Copyright 2024 The ChromiumOS Authors
# Use of this source code is governed by a BSD-style license that can be
# found in the LICENSE file.

config INTEL_MODULAR_AIC
	bool
	default y
	depends on EEPROM && DT_HAS_INTEL_MODULAR_AIC_PORT_ENABLED && DT_HAS_INTEL_MODULAR_AIC_SLOT_ENABLED
	help
	  Add support for intel Modular Add-In Card (AIC) detection.

if INTEL_MODULAR_AIC

config INTEL_MODULAR_AIC_CHECK_TAG
	bool "Check memory tag"
	help
	  Add support for Modular Add-In Card (AIC) detection.

endif
```

## zephyr/subsys/pd_controller/Kconfig
```kconfig
# Copyright 2023 The ChromiumOS Authors
# Use of this source code is governed by a BSD-style license that can be
# found in the LICENSE file.

if PLATFORM_EC_USBC

rsource "Kconfig.usbc_altmode"

menuconfig USB_PDC_POWER_MGMT
	bool "Configure USB-C PD Controller"
	depends on PLATFORM_EC_USB_PD_CONTROLLER
	depends on PLATFORM_EC_CHARGER
	default y
	select SMF
	select SMF_ANCESTOR_SUPPORT
	select EVENTS
	help
	  Enable this to support configuring the USB-C power management
	  when using Power Delivery Controllers.

config PDC_POWER_MGMT_INIT_PRIORITY
	int "USB-C stack init priority"
	default 90
	help
	  Initialization priority of the USB-C in POST_KERNEL.

config CHARGE_MANAGER_SYS_INIT_PRIORITY
	int "USB-C stack init priority"
	default 89
	help
	  Initialization priority of the charge manager weh using the PDC
	  power management subsystem.  This must be higher priority than the
	  PDC power management initialization priority.

config PDC_POWER_MGMT_THREAD_PRIORTY
	int "USB-C thread priority"
	default 0
	help
	  Set thread priority of the USB-C

config PDC_POWER_MGMT_STACK_SIZE
	int "USB-C thread stack size"
	default 1024
	help
	  Stack size of thread created for each instance.

config PLATFORM_USB_PDC_PMC_ALTMODE_DEBUG
	bool "PDC-PMC USB-C Alternate modes Debug Interface"
	default n
	help
	  Enable this to debug USB-C alternate modes when using PD chips
	  in PD mode and PD chip directly interfaced with Intel PMC.

module = USB_PDC
module-str = USB PDC
source "subsys/logging/Kconfig.template.log_config"

endif # PLATFORM_EC_USBC
```
