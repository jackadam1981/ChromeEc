## zephyr/Kconfig.poe
```kconfig
# Copyright 2025 The ChromiumOS Authors
# Use of this source code is governed by a BSD-style license that can be
# found in the LICENSE file.

config PLATFORM_EC_POE
	bool "Support for Power over Ethernet (POE)"
	help
	  This option enables support for Power over Ethernet.
```

## zephyr/app/ec/chip/arm/nuvoton_npcx/Kconfig.npcx9
```kconfig
# Copyright 2021 The ChromiumOS Authors
# Use of this source code is governed by a BSD-style license that can be
# found in the LICENSE file.

#
# This file defines the correct defaults when using the NPCX9 series chipset
#

if SOC_SERIES_NPCX9

#
# NPCX993F: 512 KiB Flash, 256 KiB code RAM, 64 KiB data RAM
# NPCX996F: 512 KiB Flash, 192 KiB code RAM, 64 KiB data RAM
# NPCX997F: 1024 KiB Flash, 320 KiB code RAM, 64 KiB data RAM
# NPCX997FB: 512 KiB Flash, 256 KiB code RAM, 128 KiB data RAM
# NPCX99FP: 1024 KiB Flash, 416 KiB code RAM, 92 KiB data RAM
#

# Code RAM base for NPCX9 series
config CROS_EC_PROGRAM_MEMORY_BASE
	default 0x10080000 if SOC_NPCX9M3F
	default 0x10090000 if SOC_NPCX9M6F
	default 0x10070000 if SOC_NPCX9M7F || SOC_NPCX9M7FB
	default 0x10058000 if SOC_NPCX9MFP

config CROS_EC_RAM_BASE
	default $(dt_nodelabel_reg_addr_hex,sram0)

config CROS_EC_DATA_RAM_SIZE
	hex "The total available RAM size for data."
	default $(add,$(dt_nodelabel_reg_size_int,sram0), \
			$(dt_nodelabel_reg_size_int,bootloader_ram))

config CROS_EC_RAM_SIZE
	hex "The total available RAM size."
	default $(dt_nodelabel_reg_size_hex,sram0)

config CROS_EC_RO_MEM_OFF
	default 0x0

# NPCX993F: Image size limited by 1/2 Flash size (256 KiB) and
#           code RAM size (256 KiB)
# NPCX996F: Image size limited by code RAM size (192 KiB)
# NPCX997F: Image size limited by code RAM size (320 KiB)
# NPCX997FB: Image size limited by 1/2 Flash size (256 KiB)
# NPCX99FP: Image size limited by code RAM size (416 KiB)

config CROS_EC_RW_MEM_OFF
	default 0x0

endif # SOC_SERIES_NPCX9
```

## zephyr/app/ec/chip/arm/realtek_rtk/Kconfig.rtk
```kconfig
# Copyright 2025 The ChromiumOS Authors.
# Use of this source code is governed by a BSD-style license that can be
# found in the LICENSE file.

if SOC_SERIES_RTS5912

# Power management options
config PM
	default y

config PM_DEVICE
	default y

choice PM_POLICY
	default PM_POLICY_CUSTOM
endchoice

#
# RTS5915:
#	384 kb total SRAM:
#		0x2000_0000 - 0x2000_6fff: chrome-loader (28 kb)
#		0x2000_7000 - 0x2000_b3df: customer use (16 kb)
#		0x2000_b3e0 - 0x2004_b3ff: code (256 kb + 20 byte header)
#		0x2004_b400 - 0x2004_ffff: customer use (19 kb)
#		0x2005_0000 - 0x2005_ffff: data use (64 kb)
#	1MB internal SPI flash (reg mapped)
#		0x6000_0000 - 0x6007_FFFF: RO
#		0x6008_0000 - 0x600F_FFFF: RW

# TODO: b/416020794, make the EC image size as big as the available code RAM.
config CROS_EC_PROGRAM_MEMORY_BASE
	default 0x2000b400

config CROS_EC_RAM_BASE
	default 0x20050000

# 64KB data buffer
config CROS_EC_DATA_RAM_SIZE
	default 0x10000

config CROS_EC_RAM_SIZE
	default 0x10000

config CROS_EC_RO_MEM_OFF
	default 0

# Image size should be limited by sram code size
# TODO: b/416020794, make the EC image size as big as the available code RAM.
config CROS_EC_RO_SIZE
	default 0x40000

config CROS_EC_RW_SIZE
	default 0x40000

config CROS_EC_RW_MEM_OFF
	default 0

endif # SOC_SERIES_RTS5912
```

## zephyr/boards/google/realtek/Kconfig.defconfig
```kconfig
# Copyright 2025 The ChromiumOS Authors
# Use of this source code is governed by a BSD-style license that can be
# found in the LICENSE file.

if REALTEK_RTS5912_RTMR

config PM
	default y

config SYS_CLOCK_HW_CYCLES_PER_SEC
	default 32768

config SYS_CLOCK_TICKS_PER_SEC
	default 32768

endif # REALTEK_RTS5912_RTMR
```

## zephyr/boards/google/realtek/Kconfig.realtek
```kconfig
# Copyright 2025 The ChromiumOS Authors
# Use of this source code is governed by a BSD-style license that can be
# found in the LICENSE file.

config BOARD_REALTEK
	# Allow generating initial 0 line coverage.
	select HAS_COVERAGE_SUPPORT
	select SOC_RTS5912
```

## zephyr/boards/google/realtek/realtek_rts5912_defconfig
```kconfig
# Copyright 2025 The ChromiumOS Authors
# Use of this source code is governed by a BSD-style license that can be
# found in the LICENSE file.

# Enable RTS5912 image tool
CONFIG_REALTEK_RTS5912_BOOTROM_HEADER=y

# Power Management
CONFIG_PM=y
CONFIG_PM_DEVICE=y
CONFIG_PM_POLICY_CUSTOM=y

# Console
CONFIG_CONSOLE=y
CONFIG_UART_CONSOLE=y

# Shell features
CONFIG_SHELL_HISTORY_BUFFER=256
CONFIG_SHELL_BACKEND_SERIAL_RX_POLL_PERIOD=1
CONFIG_SHELL_BACKEND_SERIAL_INTERRUPT_DRIVEN=n

# GPIO Controller
CONFIG_GPIO=y
CONFIG_GPIO_GET_CONFIG=y

# Clock Controller
CONFIG_CLOCK_CONTROL=y

# Serial Drivers
CONFIG_SERIAL=y

# WATCHDOG configuration
CONFIG_WATCHDOG=n

# BBRAM
CONFIG_BBRAM=y

CONFIG_PM_POLICY_DEFAULT=y
```

## zephyr/debug/Kconfig
```kconfig
# Copyright 2025 The ChromiumOS Authors
# Use of this source code is governed by a BSD-style license that can be
# found in the LICENSE file.

config PLATFORM_EC_MUTEX_HISTORY
	bool "Enable mutex history buffer"
	help
	  Capture mutex locking/locked/unlock events into a ring buffer.
```

## zephyr/dts/bindings/battery/celxpert,p360644.yaml
```yaml
# Copyright 2025 The ChromiumOS Authors
# Use of this source code is governed by a BSD-style license that can be
# found in the LICENSE file.

description: "Celxpert p360644"
compatible: "celxpert,p360644"

include: battery-smart.yaml

properties:
  enum-name:
    type: string
    default: "celxpert,p360644"

  # Fuel gauge
  manuf_name:
    default: "AS3GXXD3KC"
  device_name:
    default: "p360644"
  ship_mode_reg_addr:
    default: 0x00
  ship_mode_reg_data:
    default: [0x0010, 0x0010]
  # Charging/Discharging FETs Status
  # Register SBS_PackStatus_ACCESS (0x99)
  # Bit-3: XDSG
  # Bit-2: XCHG
  fet_reg_addr:
    default: 0x99
  fet_reg_mask:
    default: 0x08
  fet_disconnect_val:
    default: 0x08
  fet_cfet_mask:
    default: 0x04
  fet_cfet_off_val:
    default: 0x04

  # Battery info
  voltage_max:
    default: 17600
  voltage_normal:
    default: 15860
  voltage_min:
    default: 12000
  precharge_current:
    default: 256
  start_charging_min_c:
    default: 0
  start_charging_max_c:
    default: 45
  charging_min_c:
    default: 0
  charging_max_c:
    default: 60
  discharging_min_c:
    default: -20
  discharging_max_c:
    default: 60
```

## zephyr/dts/bindings/battery/named-batteries.yaml
```yaml
description: Named Batteries parent node

compatible: "named-batteries"

child-binding:
    description: Named batteries child node
    properties:
       enum-name:
          type: string
          required: true
          enum:
            - "lgc011"
```

## zephyr/dts/bindings/battery/scud,g71c000pk110.yaml
```yaml
# Copyright 2025 The ChromiumOS Authors
# Use of this source code is governed by a BSD-style license that can be
# found in the LICENSE file.

description: "SCUD,g71c000pk110"
compatible: "scud,g71c000pk110"

include: battery-smart.yaml

properties:
  enum-name:
    type: string
    default: "scud,g71c000pk110"

  # Fuel gauge
  manuf_name:
    default: "SCUD"
  device_name:
    default: "g71c000pk110"
  ship_mode_reg_addr:
    default: 0x00
  ship_mode_reg_data:
    default: [0x0010, 0x0010]
  # Charging/Discharging FETs Status
  # Register SBS_PackStatus_ACCESS (0x0054)
  # Bit-13: XDSG
  # Bit-14: XCHG
  flags:
    default: 0x04
  fet_reg_addr:
    default: 0x0054
  fet_reg_mask:
    default: 0x2000
  fet_disconnect_val:
    default: 0x2000
  fet_cfet_mask:
    default: 0x4000
  fet_cfet_off_val:
    default: 0x4000

  # Battery info
  voltage_max:
    default: 8800
  voltage_normal:
    default: 7700
  voltage_min:
    default: 6000
  precharge_current:
    default: 256
  start_charging_min_c:
    default: 0
  start_charging_max_c:
    default: 45
  charging_min_c:
    default: 0
  charging_max_c:
    default: 56
  discharging_min_c:
    default: -20
  discharging_max_c:
    default: 70
```

## zephyr/dts/bindings/battery/smp,ap25c7k.yaml
```yaml
# Copyright 2025 The ChromiumOS Authors
# Use of this source code is governed by a BSD-style license that can be
# found in the LICENSE file.

description: "SMP KT00307016 AP25C7K"
compatible: "smp,ap25c7k"

include: battery-smart.yaml

properties:
  enum-name:
    type: string
    default: "smp,ap25c7k"

  # Fuel gauge
  manuf_name:
    default: "SMP KT00307016"
  device_name:
    default: "AP25C7K"
  ship_mode_reg_addr:
    default: 0x00
  ship_mode_reg_data:
    default: [0x00F0, 0x00F0]
  # Documentation: b/432647794
  flags:
    default: 0
  fet_reg_addr:
    default: 0x0
  fet_reg_mask:
    default: 0x8000
  fet_disconnect_val:
    default: 0x0000
  fet_cfet_mask:
    default: 0x4000
  fet_cfet_off_val:
    default: 0x0000

  # Battery info
  voltage_max:
    default: 13200
  voltage_normal:
    default: 11250
  voltage_min:
    default: 9000
  precharge_current:
    default: 256
  start_charging_min_c:
    default: 0
  start_charging_max_c:
    default: 50
  charging_min_c:
    default: 0
  charging_max_c:
    default: 60
  discharging_min_c:
    default: -20
  discharging_max_c:
    default: 60
```

## zephyr/dts/bindings/cec/ite,it8xxx2-cec-raw.yaml
```yaml
# Copyright 2022 Google LLC
# SPDX-License-Identifier: Apache-2.0

description: ITE, it8xxx2-cec-raw node

compatible: "ite,it8xxx2-cec-raw"

include: [base.yaml, pinctrl-device.yaml]

properties:

  pinctrl-0:
    required: true

  pinctrl-names:
    required: true
```

## zephyr/dts/bindings/cros_flash/realtek,rtk-cros-flash.yaml
```yaml
# Copyright 2025 Google LLC
# SPDX-License-Identifier: Apache-2.0

description: REALTEK, RTK-cros-flash node

compatible: "realtek,rtk-cros-flash"

include: cros-flash-controller.yaml
```

## zephyr/dts/bindings/dsp_comms/cros,dsp_service.yaml
```yaml
# Copyright 2024 Google LLC
# SPDX-License-Identifier: Apache-2.0

description: Service binding for EC/DSP cores

compatible: "cros,dsp-service"

include:
  - dsp_comms_common.yaml

properties:
  allow-runtime-disable:
    type: boolean
    description: |
      If set, allows the DSP service to turn itself off based on a FW_CONFIG bit
      ISH with value ISH_DISABLED. This requires the CBI devicetree node to
      define a FW_CONFIG ISH field as well as a value enum ISH_DISABLED.
```

## zephyr/dts/bindings/power/ap-pwrseq-sub-states.yaml
```yaml
# Copyright 2022 Intel Corporation
# SPDX-License-Identifier: Apache-2.0

description: |
  Define additional substates to be included in state machine. Use corresponding
  macros to provide action handlers.
  Note: Substate string will be appended to prefix `AP_POWER_STATE_` to create
  new enumeration id.

compatible: "ap-pwrseq-sub-states"

properties:
  chipset:
    type: string-array
    description: |
      User defined power subtstates, use AP_POWER_CHIPSET_SUB_STATE_DEFINE, to
      define substate action handler functions.
  application:
    type: string-array
    description: |
      User defined power subtstates, use AP_POWER_APP_SUB_STATE_DEFINE, to
      define substate action handler functions.

#  example:
#    foo.dts:
#
#      ap-power {
#          compatible = "ap-pwrseq-sub-states";
#          chipset = "S0ix";
#      };
#
#    foo.c
#
#      ap_pwrseq_sm_set_state(data, AP_POWER_STATE_S0ix);
#
```

## zephyr/dts/bindings/pwm/named-pwms.yaml
```yaml
# Copyright (c) 2020 The Chromium OS Authors
# SPDX-License-Identifier: Apache-2.0

description: PWM KEYS parent node

compatible: "named-pwms"

child-binding:
  description: Named PWMs child node
  properties:
    pwms:
      type: phandle-array
      required: true
    label:
      required: true
      type: string
      description:
        Human readable string describing the device (used as
        device_get_binding() argument)
    frequency:
      required: true
      type: int
      description: PWM frequency, in Hz
```

## zephyr/dts/bindings/temp/cros-ec,temp-sensors.yaml
```yaml
# Copyright 2021 The ChromiumOS Authors
# Use of this source code is governed by a BSD-style license that can be
# found in the LICENSE file.

description: >
  Common properties for temperature sensors that are not handled by drivers.
  Zero values in degrees K(-273 in degrees C)in thermal thresholds will
  be ignored

compatible: "cros-ec,temp-sensors"

child-binding:
  description: Named temperature sensor node
  properties:
    sensor:
      type: phandle
      required: true
      description:
        A pointer to a coresponding temperature sensor node.

    power-good-pin:
      type: phandle
      description:
        If this sensor will be unpowered some of the time, provide an input GPIO
        which can be referenced to detect whether the sensor is powered before
        reading.

    temp-fan-off:
      type: int
      description:
        Temperature threshold in degrees C when no active cooling
        is needed

    temp-fan-max:
      type: int
      description:
        Temperature threshold in degrees C when max active cooling
        is needed

    temp-host-warn:
      type: int
      description:
        Temperature threshold in degrees C of thermal warn.
        Temperatures above the thermal warn threshold generate a
        request to the AP to throttle itself.

    temp-host-high:
      type: int
      description:
        Temperature threshold in degrees C of thermal high.
        Temperatures above the thermal high threshold cause the EC to
        assert a signal (usually PROCHOT) to the AP and force the AP to
        throttle.

    temp-host-halt:
      type: int
      description:
        Temperature threshold in degrees C that forces AP to shutdown
        due to thermal reason

    temp-host-release-warn:
      type: int
      description:
        Temperature release threshold in degrees C of thermal warn

    temp-host-release-high:
      type: int
      description:
        Temperature release threshold in degrees C of thermal high

    temp-host-release-halt:
      type: int
      description:
        Temperature release threshold in degrees C of thermal shutdown
```

## zephyr/dts/bindings/touchpad/cros-ec,usb-hid-touchpad.yaml
```yaml
# Copyright 2023 The ChromiumOS Authors
# Use of this source code is governed by a BSD-style license that can be
# found in the LICENSE file.

description: USB HID Touchpad

compatible: "cros-ec,usb-hid-touchpad"

on-bus: usb

properties:
  logical-max-x:
    type: int
    description: The logical maximum x_axis setting

  logical-max-y:
    type: int
    description: The logical maximum y_axis setting

  physical-max-x:
    type: int
    description: The physical maximum x_axis setting

  physical-max-y:
    type: int
    description: The physical maximum y_axis setting

  max-pressure:
    type: int
    description: The maximum pressure for touchpad
```
