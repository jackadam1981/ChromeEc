## zephyr/program/fatcat/Kconfig
```kconfig
# Copyright 2024 The ChromiumOS Authors
# Use of this source code is governed by a BSD-style license that can be
# found in the LICENSE file.

config BOARD_FATCATRVP_NPCX
	bool "Google Fatcat Nuvoton (npcx9m7f) add-in card for the RVP"
	help
	  Build Google Nuvoton npcx9m7f based Fatcat add-in card.
	  This board is for use with the Intel RVP using the
	  MECC 2.1 connector.

config BOARD_FATCAT_IT82002AW
	bool "Google Fatcat it82002aw add-in card"
	help
	  Build Google ITE it82002aw based Fatcat add-in card.
	  This board is for use with the Intel RVP using the
	  MECC 2.1 connector.

config BOARD_FRANCKA
	bool "Google francka"
	help
	  Build Google Francka board. Francka has Intel PTL SoC
	  with NPCX993FA0BX EC.

config BOARD_FELINO
	bool "Google felino"
	help
	  Build Google Felino board. Felino has Intel PTL SoC
	  with it82002aw EC.

config BOARD_FELINO4ES
	bool "Google felino for ES1"
	help
	  Build Google Felino board for ES1. Felino4es has Intel PTL SoC
	  with it82002aw EC.

config BOARD_KINMEN
	bool "Google kinmen"
	help
	  Build Google Kinmen board. Kinmen has Intel PTL SoC
	  with it82002aw EC.

module = Fatcat
module-str = Fatcat board-specific code
source "subsys/logging/Kconfig.template.log_config"

source "Kconfig.zephyr"
```

## zephyr/test/debug_assert/testcase.yaml
```yaml
common:
  platform_allow:
    - native_sim
tests:
  debug_assert.default:
    extra_configs:
      - CONFIG_ASSERT_NO_FILE_INFO=n
  debug_assert.no_file_info:
    extra_configs:
      - CONFIG_ASSERT_NO_FILE_INFO=y
```

## zephyr/test/geralt/testcase.yaml
```yaml
common:
  platform_allow:
  - native_sim
tests:
  geralt.default:
    extra_configs:
    - CONFIG_TEST_GERALT=y
    - CONFIG_SHIMMED_TASKS=y
    extra_dtc_overlay_files:
    - geralt.default.overlay
  geralt.ciri:
    extra_configs:
    - CONFIG_TEST_CIRI=y
    - CONFIG_PLATFORM_EC_ACCELGYRO_LSM6DSM=y
    - CONFIG_PLATFORM_EC_ACCELGYRO_BMI3XX=y
    - CONFIG_PLATFORM_EC_ACCELGYRO_BMI_COMM_I2C=y
    extra_dtc_overlay_files:
    - geralt.ciri.overlay
```

## zephyr/test/hibernate_z5/testcase.yaml
```yaml
common:
  platform_allow:
    - native_sim
tests:
  hibernate_z5.default:
    extra_configs:
      - CONFIG_TEST_HIBERNATE_Z5_DEFAULT=y
    extra_dtc_overlay_files:
      - boards/native_sim.overlay
  hibernate_z5.gpio_not_ready:
    extra_configs:
      - CONFIG_TEST_HIBERNATE_Z5_GPIO_NOT_READY=y
    extra_dtc_overlay_files:
      - boards/native_sim.overlay
      - boards/native_sim_gpio_not_ready.overlay
  hibernate_z5.gpio_bad_config:
    extra_configs:
      - CONFIG_TEST_HIBERNATE_Z5_GPIO_BAD_CONFIG=y
      # Allow GPIO emulator to handle bad pin error
      - CONFIG_ASSERT=n
      - CONFIG_PLATFORM_EC_DEBUG_ASSERT=n
    extra_dtc_overlay_files:
      - boards/native_sim.overlay
      - boards/native_sim_gpio_bad_config.overlay
```

## zephyr/test/lib_math/testcase.yaml
```yaml
# Copyright 2025 The ChromiumOS Authors
# Use of this source code is governed by a BSD-style license that can be
# found in the LICENSE file.

tests:
  cros.math.smoothing:
    harness: gtest
    extra_args:
      - TEST_LIB=math.smoothing_test
    platform_allow:
      - native_sim
  cros.math.iir_filter:
    harness: gtest
    extra_args:
      - TEST_LIB=math.iir_filter_test
    platform_allow:
      - native_sim
```
