/* Copyright 2025 The ChromiumOS Authors
 * Use of this source code is governed by a BSD-style license that can be
 * found in the LICENSE file.
 */

/* ocelot program common DTS includes */

#include <cros/integrated_fwid.dtsi>

/* ocelot_mchp project DTS includes */

#include "gpio.dtsi"
#include "i2c.dtsi"
#include "power_signals.dtsi"

#include "../rvp_battery.dtsi"
#include "../rvp_interrupts.dtsi"

/* ocelot_mchp overrides follow... */
