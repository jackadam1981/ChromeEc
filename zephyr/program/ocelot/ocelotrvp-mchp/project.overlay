/* Copyright 2025 The ChromiumOS Authors
 * Use of this source code is governed by a BSD-style license that can be
 * found in the LICENSE file.
 */

/* ocelot program common DTS includes */

#include <cros/integrated_fwid.dtsi>

/* ocelot_mchp project DTS includes */

#include "gpio.dtsi"
#include "i2c.dtsi"
#include "power_signals.dtsi"

#include "../rvp_battery.dtsi"
#include "../rvp_interrupts.dtsi"
#include "../rvp_usbc.dtsi"

/* ocelot_mchp overrides follow... */

&pdc_c0 {
	/* TYPEC_EC_SMBUS_ALERT_0_R */
	irq-gpios = <MCHP_GPIO_DECODE_143 GPIO_ACTIVE_LOW>;
};

/* Use only port C0 */
/delete-node/ &pdc_c1;
/delete-node/ &usbc_port1;

/* Disable nodes for features not yet enabled. */
/delete-node/ &int_dc_jack_present;
