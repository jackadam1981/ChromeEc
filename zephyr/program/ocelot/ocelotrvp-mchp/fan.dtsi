/* Copyright 2025 The ChromiumOS Authors
 * Use of this source code is governed by a BSD-style license that can be
 * found in the LICENSE file.
 */

/*
 * Define nodelabel aliases needed for fan devicetree.
 */
tach_fan0: &tach0 {};

gpio_all_sys_pwr_good: &all_sys_pwrgd {};

#include "../rvp_fans.dtsi"

/* Tachometer for fan speed measurement */
&tach0 {
       status = "okay";
       pinctrl-0 = <&tach0_gpio050>; /* TACH0 input on GPI050 */
       pinctrl-names = "default";
};

&pwm8 {
       status = "okay";
       pinctrl-0 = <&pwm8_gpio035>;
       pinctrl-names = "default";
};

&fan0 {
	pwms = <&pwm8 0 PWM_KHZ(25) PWM_POLARITY_NORMAL>;
};

