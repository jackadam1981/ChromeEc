/* Copyright 2025 The ChromiumOS Authors
 * Use of this source code is governed by a BSD-style license that can be
 * found in the LICENSE file.
 */

/* ocelot program common DTS includes */

//#include <cros/integrated_fwid.dtsi>

/* ocelot_nuvoton project DTS includes */

#include <cros/cbi_flash.dtsi>

#include "adc.dtsi"
#include "battery.dtsi"
#include "fan.dtsi"
#include "gpio.dtsi"
#include "i2c.dtsi"
#include "keyboard.dtsi"
#include "led_pins.dtsi"
#include "led_policy.dtsi"
#include "overlay.dtsi"
#include "power_signals.dtsi"
#include "pwm.dtsi"
#include "usbc.dtsi"

&cbi_flash {
	/*
	 * CBI section size is 0x1000 bytes, the CBI portion lies at the end of
	 * EC_RO section. EC_RO section ends at 0x50000 byte which is the offset
	 */
	offset = <0x50000>;
	size = <0x1000>;
};