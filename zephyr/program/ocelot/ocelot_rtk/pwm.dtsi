/* Copyright 2025 The ChromiumOS Authors
 * Use of this source code is governed by a BSD-style license that can be
 * found in the LICENSE file.
 */

/* Keyboard backlight - use a prescaler for operation about 324 Hz */
&pwm1 {
	status = "okay";
	pinctrl-0 = <&pwm1_gpio023>;
	pinctrl-names = "default";
};

/* Fan - use a separate prescaler for Fan, b:358312912 */
&pwm2 {
	status = "okay";
	pinctrl-0 = <&pwm2_gpio025>;
	pinctrl-names = "default";
};