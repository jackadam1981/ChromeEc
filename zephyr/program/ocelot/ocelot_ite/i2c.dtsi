/* Copyright 2025 The ChromiumOS Authors
 * Use of this source code is governed by a BSD-style license that can be
 * found in the LICENSE file.
 */

&i2c1 {
	label = "I2C_PORT_PD";
	clock-frequency = <I2C_BITRATE_STANDARD>;
};

&i2c3 {
	/* Port not used. All PDCs on bus i2c1 */
	label = "I2C_PORT_PD_SPARE";
	clock-frequency = <I2C_BITRATE_STANDARD>;
};

&i2c4 {
	label = "I2C_PORT_CHARGER";
	clock-frequency = <I2C_BITRATE_STANDARD>;
};

&i2c5 {
	label = "I2C_PORT_ISH";
	clock-frequency = <I2C_BITRATE_STANDARD>;
};
