/* Copyright 2025 The ChromiumOS Authors
 * Use of this source code is governed by a BSD-style license that can be
 * found in the LICENSE file.
 */

/ {
	batteries {
		default_battery:smp_333-1d-2d-a {
			compatible = "smp,333-1d-2d-a", "battery-smart";
		};
	};
};
