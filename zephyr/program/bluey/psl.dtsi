/* Copyright 2025 The ChromiumOS Authors
 * Use of this source code is governed by a BSD-style license that can be
 * found in the LICENSE file.
 */

/*
 * Bluey Program with NPCX supports following wake-up sources.
 * PSL_IN1: Lid open
 * PSL_IN2: Power button
 * PSL_IN3: AC present
 */

/* Power switch logic input pads */
&psl_in1_gpd2 {
	/* EC_LID_OPEN */
	psl-in-mode = "edge";
	psl-in-pol = "high-rising";
};

&psl_in2_gp00 {
	/* EC_PWR_BTN_ODL */
	psl-in-mode = "edge";
	psl-in-pol = "low-falling";
};

&psl_in3_gp01 {
	/* EC_ACOK_OD */
	psl-in-mode = "edge";
	psl-in-pol = "high-rising";
};

/* Power domain device controlled by PSL (Power Switch Logic) IO pads */
&power_ctrl_psl {
	status = "okay";
	pinctrl-names = "sleep";
	pinctrl-0 = <&psl_in1_gpd2 &psl_in2_gp00 &psl_in3_gp01 >;
};
