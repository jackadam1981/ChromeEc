/* Copyright 2025 The ChromiumOS Authors
 * Use of this source code is governed by a BSD-style license that can be
 * found in the LICENSE file.
 */

#include <cros/cbi_flash.dtsi>
#include "../npcx_generated.dtsi"
#include "../interrupts.dtsi"
#include "../npcx_common.dtsi"
#include "../npcx_default_gpio_pinctrl.dtsi"
#include "../npcx_keyboard.dtsi"
#include "../npcx_overlay.dtsi"
#include "../power_signal.dtsi"
#include "../usba.dtsi"
#include "battery.dtsi"
#include "cbi.dtsi"
#include "gpio.dtsi"
#include "led_pins.dtsi"
#include "led_policy.dtsi"
#include "motionsense.dtsi"
#include "usbc.dtsi"

/ {
	aliases {
		gpio-kbd-kso2 = &gpio_ec_kso_02_inv;
	};

	cros-keyscan {
		compatible = "cros-ec,keyscan";

		debounce-down = <15000>;
		debounce-up = <15000>;

		actual-key-mask = <
			0x08	/* C0 */
			0xff	/* C1 */
			0xff	/* C2 */
			0xff	/* C3 */
			0xff	/* C4 */
			0xff	/* C5 */
			0xff	/* C6 */
			0xa0	/* C7 */
			0xff	/* C8 */
			0xff	/* C9 */
			0x01	/* C10 */
			0xff	/* C11 */
			0xcf	/* C12 */
			0x40	/* C13 */
			0x0a	/* C14 */
			0x40	/* C15 */
			0x01	/* C16 */
			0xc4	/* C17 */
		>;
	};
};

&cros_kb_raw {
	pinctrl-0 = <
		&ksi0_gp31
		&ksi1_gp30
		&ksi2_gp27
		&ksi3_gp26
		&ksi4_gp25
		&ksi5_gp24
		&ksi6_gp23
		&ksi7_gp22
		&kso00_gp21
		&kso01_gp20
		&kso03_gp16
		&kso04_gp15
		&kso05_gp14
		&kso06_gp13
		&kso07_gp12
		&kso08_gp11
		&kso09_gp10
		&kso10_gp07
		&kso11_gp06
		&kso12_gp05
		&kso13_gp04
		&kso14_gp82
		&kso15_gp83
		&kso16_gp03
		&kso17_gpb1
	>;
};
