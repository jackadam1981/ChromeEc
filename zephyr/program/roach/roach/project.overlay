/* Copyright 2023 The ChromiumOS Authors
 * Use of this source code is governed by a BSD-style license that can be
 * found in the LICENSE file.
 */

/* Roach program common DTS includes */

#include <cros/touchpad_hashes.dtsi>

#include "../gpio.dtsi"
#include "../uart.dtsi"
#include "../i2c.dtsi"
#include "../interrupts.dtsi"
#include "../keyboard.dtsi"
#include "../pwm.dtsi"
#include "../rwsig.dtsi"

&i2c0 {
	touchpad@15 {
		/* not tested, don't care on reference board */
		logical-max-x = <2644>;
		logical-max-y = <1440>;
		physical-max-x = <839>;
		physical-max-y = <457>;
	};
};

&touchpad_fw_hashes {
	size = <((65536 / 1024) * 32)>;
};

&sha0 {
	status = "okay";
};
