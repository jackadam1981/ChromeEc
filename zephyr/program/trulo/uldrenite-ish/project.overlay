/* Copyright 2025 The ChromiumOS Authors
 * Use of this source code is governed by a BSD-style license that can be
 * found in the LICENSE file.
 */

/ {
	uart1: uart@8102000 {
		compatible = "intel,sedi-uart";
		reg = <0x08102000 0x1000>;
		interrupt-parent = <&intc>;
		interrupts = <24 IRQ_TYPE_LOWEST_EDGE_RISING 6>;
		peripheral-id = <1>;
		current-speed = <115200>;
		status = "okay";
	 };
 };

#include "../cbi.dtsi"
#include "../uldrenite/cbi.dtsi"
#include "gpio.dtsi"
#include "i2c.dtsi"
#include "../uldrenite/motionsense.dtsi"

/ {
	chosen {
		zephyr,sram = &sram;
		zephyr,console = &uart1;
		zephyr,shell-uart = &uart1;
		zephyr,flash = &sram;
	};
};