/* Copyright 2025 The ChromiumOS Authors
 * Use of this source code is governed by a BSD-style license that can be
 * found in the LICENSE file.
 */

/ {
	pwmleds {
		compatible = "pwm-leds";
		pwm_power_led: pwm_power_led {
			pwms = <&pwm4 0 PWM_HZ(324) PWM_POLARITY_INVERTED>;
		};
	};
};
