/* Copyright 2025 The ChromiumOS Authors
 * Use of this source code is governed by a BSD-style license that can be
 * found in the LICENSE file.
 */

&i2c0 {
	pinctrl-0 = <&i2c0_clk_gpb3_default
		     &i2c0_data_gpb4_default>;
	pinctrl-names = "default";

	label = "I2C_SENSOR";
	clock-frequency = <I2C_BITRATE_FAST>;
};

&i2c1 {
	pinctrl-0 = <&i2c1_clk_gpc1_default
		     &i2c1_data_gpc2_default>;
	pinctrl-names = "default";

	label = "I2C_PORT_PD";
	clock-frequency = <I2C_BITRATE_FAST>;
};

&i2c2 {
	pinctrl-0 = <&i2c2_clk_gpf6_default
		     &i2c2_data_gpf7_default>;
	pinctrl-names = "default";

	label = "I2C_PORT_CHARGER";
	label = "I2C_PORT_BATTERY";
	clock-frequency = <I2C_BITRATE_STANDARD>;
};

&i2c3 {
	pinctrl-0 = <&i2c3_clk_gpb2_default
		     &i2c3_data_gpb5_default>;
	pinctrl-names = "default";

	label = "I2C_PORT_PMC_PD";
	clock-frequency = <I2C_BITRATE_FAST>;
};

&i2c3 {
	status = "disabled";
};
/delete-node/ &i2c_i2c_ec_pmc_pd;
