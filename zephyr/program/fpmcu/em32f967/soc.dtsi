/* Copyright 2025 The ChromiumOS Authors.
 * Use of this source code is governed by a BSD-style license that can be
 * found in the LICENSE file.
 */

#include <cros/elan/em32f967.dtsi>

/*
 * Use 271kB of RAM. Some of it is reserved for hw accelarator which is not used.
 * Make also some space for SDCP.
 */
&sram0 {
	reg = <0x20000000 0x43e00>;
};
