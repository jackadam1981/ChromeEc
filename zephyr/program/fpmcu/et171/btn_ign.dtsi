/* Copyright 2025 The ChromiumOS Authors
 * Use of this source code is governed by a BSD-style license that can be
 * found in the LICENSE file.
 */

/{
	btn_ign: btn-ign {
		compatible = "cros-ec,btn-ign";
		btn-ign-gpios = <&gpio0 1 GPIO_ACTIVE_HIGH>;
	};
};
