/* Copyright 2024 The ChromiumOS Authors
 * Use of this source code is governed by a BSD-style license that can be
 * found in the LICENSE file.
 */

/* fatcat program common DTS includes */

#include <cros/integrated_fwid.dtsi>

/* felino project DTS includes */
#include "gpios.dtsi"

#include "adc.dtsi"
#include "battery.dtsi"
#include "binman.dtsi"
#include "console.dtsi"
#include "fan.dtsi"
#include "i2c.dtsi"
#include "interrupts.dtsi"
#include "../ite_hibernate.dtsi"
#include "keyboard.dtsi"
#include "led_pins.dtsi"
#include "led_policy.dtsi"
#include "power_signals.dtsi"
#include "temp_sensors.dtsi"
#include "usb_typec.dtsi"
