/* Copyright 2025 The ChromiumOS Authors
 * Use of this source code is governed by a BSD-style license that can be
 * found in the LICENSE file.
 */

/* fatcat program common DTS includes */

#include <cros/integrated_fwid.dtsi>

/* felino4es project DTS includes */
#include "../felino/gpios.dtsi"

#include "../felino/adc.dtsi"
#include "../felino/battery.dtsi"
#include "../felino/binman.dtsi"
#include "../felino/console.dtsi"
#include "../felino/fan.dtsi"
#include "../felino/i2c.dtsi"
#include "../felino/interrupts.dtsi"
#include "keyboard.dtsi"
#include "../felino/led_pins.dtsi"
#include "../felino/led_policy.dtsi"
#include "../felino/power_signals.dtsi"
#include "../felino/temp_sensors.dtsi"
#include "../felino/usb_typec.dtsi"
