/* Copyright 2025 The ChromiumOS Authors
 * Use of this source code is governed by a BSD-style license that can be
 * found in the LICENSE file.
 */

/* ruby program common DTS includes */

#include <cros/cbi_flash.dtsi>

#include <cros/integrated_fwid.dtsi>

#include "adc.dtsi"
#include "battery.dtsi"
#include "cbi.dtsi"
#include "gpios.dtsi"
#include "i2c.dtsi"
#include "keyboard.dtsi"
#include "led_pins.dtsi"
#include "led_policy.dtsi"
#include "overlay.dtsi"
#include "power_signals.dtsi"
#include "thermal.dtsi"
#include "usba.dtsi"
#include "usbc.dtsi"
#include "ledstrip_policy.dtsi"

/* ruby overrides follow... */

&cbi_flash {
	/*
	 * CBI section size is 0x1000 bytes, the CBI portion lies at the end of
	 * EC_RO section. EC_RO section ends at 0x40000 byte which is the offset
	 */
	offset = <0x3e000>;
	size = <0x1000>;
};


/* AP interface */
&espi0 {
	status = "okay";
	pinctrl-0 = <&espi_lpc_gp46_47_51_52_53_54_55_57>;
	pinctrl-names = "default";
};

/* DT Overlay (e.g. project.overlay) for current-speed = <2500000> */
&pcc {
    clock-frequency = <DT_FREQ_M(80)>; /* OFMCLK runs at 80 MHz */
    core-prescaler = <2>; /* CORE_CLK runs at 40 MHz */
    apb1-prescaler = <4>; /* APB1_CLK runs at 20 MHz */
    apb2-prescaler = <4>; /* APB2_CLK runs at 20 MHz */
    apb3-prescaler = <4>; /* APB3_CLK runs at 20 MHz */
    apb4-prescaler = <2>; /* APB4_CLK runs at 40 MHz */
};

