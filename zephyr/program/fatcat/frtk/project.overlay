/* Copyright 2025 The ChromiumOS Authors
 * Use of this source code is governed by a BSD-style license that can be
 * found in the LICENSE file.
 */

/* fatcat program common DTS includes */

#include <cros/integrated_fwid.dtsi>

#include "../fatcat_stub.dts"

/* francka project DTS includes */

#include "adc.dtsi"
#include "battery.dtsi"
#include "cbi.dtsi"
#include "gpios.dtsi"
#include "i2c.dtsi"
#include "keyboard.dtsi"
#include "led_pins.dtsi"
#include "led_policy.dtsi"
#include "motionsense.dtsi"
#include "overlay.dtsi"
#include "power_signals.dtsi"
#include "thermal.dtsi"
#include "usba.dtsi"
#include "usbc.dtsi"
#include "rtk_ulpm.dtsi"

&espi0 {
	status = "okay";
	pinctrl-0 = < &espi_alert_gpio003 &espi_cs_gpio004 
				&espi_io3_gpio005 &espi_io2_gpio006
				&espi_io1_gpio007 &espi_io0_gpio008
				&espi_clk_gpio009 &espi_reset_gpio020>;
	pinctrl-names = "default";
};

&sha0 {
	status = "okay";
};

