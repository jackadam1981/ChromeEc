/* Copyright 2024 The ChromiumOS Authors
 * Use of this source code is governed by a BSD-style license that can be
 * found in the LICENSE file.
 */

/ {
    batteries {
		default_battery: smp-ap23b7q {
			compatible = "smp,ap23b7q", "battery-smart";
		};
	};
};
