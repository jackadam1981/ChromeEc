/* Copyright 2025 The ChromiumOS Authors
 * Use of this source code is governed by a BSD-style license that can be
 * found in the LICENSE file.
 */

/* KB_LED_PWM */
&pwm6 {
	status = "okay";
	pinctrl-0 = <&pwm6_gpio029>;
	pinctrl-names = "default";
};

/* FAN1_PWM */
&pwm5 {
	status = "okay";
	pinctrl-0 = <&pwm5_gpio028>;
	pinctrl-names = "default";
};
