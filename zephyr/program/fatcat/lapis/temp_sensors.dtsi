/* Copyright 2025 The ChromiumOS Authors
 * Use of this source code is governed by a BSD-style license that can be
 * found in the LICENSE file.
 */

/ {
	named-temp-sensors {
		compatible = "cros-ec,temp-sensors";
		status = "disabled";
		/* … */
	};
};
