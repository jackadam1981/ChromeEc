/* Copyright 2025 The ChromiumOS Authors
 * Use of this source code is governed by a BSD-style license that can be
 * found in the LICENSE file.
 */

#include "common.h"
#include "cros_cbi.h"
#include "ec_commands.h"
#include "gpio.h"
#include "hooks.h"
#include "keyboard_8042_sharedlib.h"
#include "keyboard_config.h"
#include "keyboard_protocol.h"
#include "keyboard_raw.h"

#include <zephyr/drivers/gpio.h>
#include <zephyr/logging/log.h>

#include <drivers/vivaldi_kbd.h>

LOG_MODULE_REGISTER(brox_keyboard, LOG_LEVEL_INF);

static uint16_t default_scancode_set2[KEYBOARD_COLS_MAX][KEYBOARD_ROWS] = {
	{ 0x0000, 0x0000, 0x0000, 0xe01f, 0x0000, 0x0000, 0x0000, 0x0000 },
	{ 0x0078, 0x0076, 0x000d, 0x000e, 0x001c, 0x0016, 0x001a, 0x003c },
	{ 0x0005, 0x000c, 0x0004, 0x0006, 0x0023, 0x0041, 0x0026, 0x0043 },
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	{ 0x0000, 0x0000, 0x006a, 0x0000, 0x0037, 0x0000, 0x005d, 0x0061 },
};

static uint16_t us2_scancode_set2[KEYBOARD_COLS_MAX][KEYBOARD_ROWS] = {
	{ 0x0000, 0x0000, 0x0000, 0xe01f, 0x0000, 0x0000, 0x0000, 0x0000 },
	{ 0x0078, 0x0076, 0x000d, 0x000e, 0x001c, 0x0016, 0x001a, 0x003c },
	{ 0x0005, 0x000c, 0x0004, 0x0006, 0x0023, 0x0041, 0x0026, 0x0043 },
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	{ 0x0000, 0x0000, 0x006a, 0x0000, 0x0037, 0x0000, 0x005d, 0x0061 },
};

/* Set default k */
static uint16_t (*scancode_set2)[KEYBOARD_ROWS] = default_scancode_set2;

uint16_t get_scancode_set2(uint8_t row, uint8_t col)
{
	if (col < KEYBOARD_COLS_MAX && row < KEYBOARD_ROWS)
		return scancode_set2[col][row];
	return 0;
}

void set_scancode_set2(uint8_t row, uint8_t col, uint16_t val)
{
	if (col < KEYBOARD_COLS_MAX && row < KEYBOARD_ROWS)
		scancode_set2[col][row] = val;
}

/*
 * Keyboard matrix decided by FW config
 */
test_export_static void keyboard_matrix_init(void)
{
	int ret;
	uint32_t val;

	ret = cros_cbi_get_fw_config(FW_KB_LAYOUT, &val);
	if (ret != 0) {
		LOG_ERR("Error retrieving CBI FW_CONFIG field FW_KB_LAYOUT, "
			"assuming FW_KB_LAYOUT_DEFAULT");
		val = FW_KB_LAYOUT_DEFAULT;
	}

	switch (val) {
	case FW_KB_LAYOUT_US2:
		scancode_set2 = us2_scancode_set2;
		LOG_INF("KB layout: US2!!!");
		break;
	case FW_KB_LAYOUT_DEFAULT:
	default:
		/* Default keyboard layout */
		LOG_INF("KB layout: default!!!");
		return;
	}
}
DECLARE_HOOK(HOOK_INIT, keyboard_matrix_init, HOOK_PRIO_POST_FIRST);

/*
 * Vivaldi keyboard decided by FW config
 */
int8_t board_vivaldi_keybd_idx(void)
{
	int ret;
	uint32_t val;

	ret = cros_cbi_get_fw_config(FW_KB_BL, &val);
	if (ret != 0) {
		LOG_ERR("Error retrieving CBI FW_CONFIG field FW_KB_BL, "
			"assuming FW_KB_BL_ABSENT");
		val = FW_KB_BL_ABSENT;
	}

	switch (val) {
	case FW_KB_BL_PRESENT:
		LOG_INF("KB_BL present!!!");
		return DT_NODE_CHILD_IDX(DT_NODELABEL(kbd_config_1));
	case FW_KB_BL_ABSENT:
	default:
		LOG_INF("KB_BL absent!!!");
		return DT_NODE_CHILD_IDX(DT_NODELABEL(kbd_config_0));
	}
}
