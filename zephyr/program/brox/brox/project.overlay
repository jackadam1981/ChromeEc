/* Copyright 2023 The ChromiumOS Authors
 * Use of this source code is governed by a BSD-style license that can be
 * found in the LICENSE file.
 */

/* Brox program common DTS includes */
#include "../generated.dtsi"
#include "../adc.dtsi"
#include "../brox.dtsi"
#include "../gpio.dtsi"
#include "../i2c.dtsi"

/* Brox project DTS includes*/

/* Brox overrides follow... */
