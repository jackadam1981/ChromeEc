/* Copyright 2022 The ChromiumOS Authors
 * Use of this source code is governed by a BSD-style license that can be
 * found in the LICENSE file.
 */

/* Geralt program common DTS includes */

#include "../adc.dtsi"
#include "../gpio.dtsi"
#include "../i2c.dtsi"
#include "../interrupts.dtsi"
#include "../mkbp.dtsi"
#include "../motionsense.dtsi"
#include "../power_signal.dtsi"
#include "../usbc.dtsi"
#include "../shi.dtsi"
#include "battery.dtsi"
#include "led.dtsi"

/ {
	batteries {
		default_battery: dynapack_c140254 {
			compatible = "smp,l21m4pg0", "battery-smart";
		};
	};
};
