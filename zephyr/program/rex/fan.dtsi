/* Copyright 2022 The ChromiumOS Authors
 * Use of this source code is governed by a BSD-style license that can be
 * found in the LICENSE file.
 */

/ {
	fans {
		compatible = "cros-ec,fans";

		fan0: fan_0 {
			pwms = <&pwm5 0 PWM_KHZ(1) PWM_POLARITY_NORMAL>;
			rpm-min = <2200>;
			rpm-start = <2200>;
			rpm-max = <4200>;
			tach = <&tach1>;
			enable-gpio = <&gpio_en_pp5000_fan>;
		};
	};
};

&pwm5_gpb7 {
	drive-open-drain;
};
