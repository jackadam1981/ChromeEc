/* Copyright 2023 The ChromiumOS Authors
 * Use of this source code is governed by a BSD-style license that can be
 * found in the LICENSE file.
 */

/ {
	batteries {
		default_battery: lgc_ap19b8m {
			compatible = "lgc,ap19b8m", "battery-smart";
		};
	};
};
