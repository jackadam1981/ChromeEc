/* Copyright 2022 The Chromium OS Authors. All rights reserved.
 * Use of this source code is governed by a BSD-style license that can be
 * found in the LICENSE file.
 */

/* host interface */
/ {
	chosen {
		zephyr,ec-host-interface = &shi0;
	};
};

&shi0 {
	status = "okay";
	cs-gpios = <&gpiom 5 IT8XXX2_GPIO_VOLTAGE_1P8>;
	pinctrl-0 = <&shi_mosi_gpm0_default
		&shi_miso_gpm1_default
		&shi_clk_gpm4_default
		&shi_cs_gpm5_default>;
	pinctrl-names = "default";
};
