/* Copyright 2025 The ChromiumOS Authors
 * Use of this source code is governed by a BSD-style license that can be
 * found in the LICENSE file.
 */

 /* Main devictree overlay for the it8xxx2_evb project */

#include "gpio.dtsi"
#include "i2c.dtsi"
