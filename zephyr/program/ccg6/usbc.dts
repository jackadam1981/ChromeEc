/* Copyright 2022 The ChromiumOS Authors
 * Use of this source code is governed by a BSD-style license that can be
 * found in the LICENSE file.
 */
 #include <dt-bindings/usb_pd_tcpm.h>

/ {
	usbc {
		#address-cells = <1>;
		#size-cells = <0>;

		usbc_port0: port0@0 {
			compatible = "named-usbc-port";
			reg = <0>;
			tcpc = <&tcpc_port2>;
			chg = <&charger>;
		};

		usbc_port1: port1@1 {
			compatible = "named-usbc-port";
			reg = <1>;
			tcpc = <&tcpc_port3>;
		};
	};
};
