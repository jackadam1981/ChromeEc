/* Copyright 2023 The ChromiumOS Authors
 * Use of this source code is governed by a BSD-style license that can be
 * found in the LICENSE file.
 */

/ {
	named-gpios {
		pd_intr: i3c-1-sda-r {
			gpios = <&gpio5 0 GPIO_INPUT>;
		};
	};
};

