/* Copyright 2024 The ChromiumOS Authors
 * Use of this source code is governed by a BSD-style license that can be
 * found in the LICENSE file.
 */

/ {
	usbc {
		#address-cells = <1>;
		#size-cells = <0>;

		port0@0 {
			compatible = "named-usbc-port";
			reg = <0>;
			chg = <&charger>;
			pdc = <&pd_pow_port0>;
		};
		port1@1 {
			compatible = "named-usbc-port";
			reg = <1>;
			pdc = <&pd_pow_port1>;
		};
	};
};
