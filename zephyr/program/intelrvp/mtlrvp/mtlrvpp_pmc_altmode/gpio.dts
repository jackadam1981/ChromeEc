/* Copyright 2024 The ChromiumOS Authors
 * Use of this source code is governed by a BSD-style license that can be
 * found in the LICENSE file.
 */

/ {
	named-gpios {
		pdpow_p0p1_intr: usbc-tcpc-alrt-p0 {
			gpios = <&gpio4 0 (GPIO_INPUT | GPIO_ACTIVE_LOW)>;
		};
	};
};
