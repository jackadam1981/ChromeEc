/* Copyright 2023 The Chromium OS Authors. All rights reserved.
 * Use of this source code is governed by a BSD-style license that can be
 * found in the LICENSE file.
 */

/ {
	shared-spi {
		compatible = "cros-ec,shared-spi-flash";
		spi-oe-gpios = <&gpio_040_076 11 0>;
	}; /* GPIO053 */
};
