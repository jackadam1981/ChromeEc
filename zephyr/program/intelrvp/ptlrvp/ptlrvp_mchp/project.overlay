/* Copyright 2024 The ChromiumOS Authors
 * Use of this source code is governed by a BSD-style license that can be
 * found in the LICENSE file.
 */

#include "include/power_signals.h"

#include "gpio.dtsi"
#include "i2c.dtsi"
#include "../ioexp.dtsi"
#include "../ioexp_gpio.dtsi"
#include "../interrupts.dtsi"
#include "../keyboard.dtsi"
#include "../power_signals.dtsi"
