/* Copyright 2024 The ChromiumOS Authors
 * Use of this source code is governed by a BSD-style license that can be
 * found in the LICENSE file.
 */

#include "include/board.h"

#include <cros/integrated_fwid.dtsi>

#include "adc.dtsi"
#include "fan.dtsi"

/* TODO(b/358612639)
 * Arbitrage generates an incorrect node label when using alternate pins.
 * Create a 2nd node label on I2C3 as a workaround.
 */
i2c3ALT: &i2c3 {
};

#include "gpio.dtsi"

/*
 * Aliases to common names
 */

#include "i2c.dts"
#include "../battery.dtsi"
#include "../i2c.dtsi"
#include "../ioex.dtsi"
#include "../ioex_gpio.dtsi"
#include "../interrupts.dtsi"
#include "../keyboard.dtsi"
#include "../pd.dtsi"
#include "../power_signals.dtsi"
#include "../temp_sensor.dts"
#include "../usbc.dtsi"
/*#include "../led_pins.dtsi"*/
/*#include "../led_policy.dtsi"*/

