## CMakeLists.txt
```
# Copyright 2022 The ChromiumOS Authors
# Use of this source code is governed by a BSD-style license that can be
# found in the LICENSE file.

cmake_minimum_required(VERSION 3.13.1)

find_package(Zephyr REQUIRED HINTS "${ZEPHYR_BASE}")
project(intelrvp)

cros_ec_library_include_directories(include)
cros_ec_library_include_directories("${PLATFORM_EC}/driver/charger")
cros_ec_library_include_directories("${PLATFORM_EC}/driver/ppc")
cros_ec_library_include_directories("${PLATFORM_EC}/driver/tcpm")
cros_ec_library_include_directories("${PLATFORM_EC}/driver/usb_mux")
zephyr_library_sources("src/intelrvp.c")
zephyr_library_sources("src/intel_rvp_board_id.c")
zephyr_library_sources_ifdef(CONFIG_PLATFORM_EC_KEYBOARD_STRAUSS "src/kbd_strauss.c")

if((DEFINED CONFIG_BOARD_ADLRVP_MCHP) OR (DEFINED CONFIG_BOARD_ADLRVP_NPCX))
  add_subdirectory(adlrvp)
  zephyr_library_sources_ifdef(CONFIG_PLATFORM_EC_USBC "${PLATFORM_EC}/baseboard/intelrvp/usb_pd_policy_mecc_1_0.c")
  zephyr_library_sources_ifdef(CONFIG_PLATFORM_EC_USBC "${PLATFORM_EC}/baseboard/intelrvp/chg_usb_pd_mecc_1_0.c")
  zephyr_library_sources_ifdef(CONFIG_PLATFORM_EC_USBC "${PLATFORM_EC}/baseboard/intelrvp/chg_usb_pd.c")
  zephyr_library_sources_ifdef(CONFIG_PLATFORM_EC_LED_PWM "src/intel_rvp_led.c")
endif()

if((DEFINED CONFIG_BOARD_MTLRVP_M1723) OR (DEFINED CONFIG_BOARD_MTLRVP_MCHP) OR
    (DEFINED CONFIG_BOARD_MTLRVP_NPCX) OR (DEFINED CONFIG_BOARD_MTLRVP_PD))
  add_subdirectory(mtlrvp)
  zephyr_library_sources_ifdef(CONFIG_PLATFORM_EC_USB_PD_TCPMV2 "src/usb_pd_policy_mecc_1_1.c")
  zephyr_library_sources_ifdef(CONFIG_PLATFORM_EC_USB_PD_TCPMV2 "src/chg_usb_pd_mecc_1_1.c")
  zephyr_library_sources_ifdef(CONFIG_PLATFORM_EC_USB_PD_TCPMV2 "src/chg_usb_tcpc.c")
  zephyr_library_sources_ifdef(CONFIG_PLATFORM_EC_DEDICATED_CHARGE_PORT "src/dc_jack.c")
endif()

if(DEFINED CONFIG_BOARD_PTLRVP_COMMON)
  add_subdirectory(ptlrvp)
  zephyr_library_sources_ifdef(CONFIG_PLATFORM_EC_DEDICATED_CHARGE_PORT "src/dc_jack.c")
endif()

if(DEFINED CONFIG_BOARD_PTLGCS)
  zephyr_library_sources("src/kbd_gcs.c")
endif()
```

## Kconfig
```
# Copyright 2022 The ChromiumOS Authors
# Use of this source code is governed by a BSD-style license that can be
# found in the LICENSE file.

config BOARD_ADLRVP_MCHP
	bool "Intel ADLRVP_MCHP board"
	depends on SOC_MEC172X_NSZ
	help
	  Build Intel ADLRVP_MCHP reference board. This board has Intel ADL RVP
	  SoC with MEC1727 EC.

config BOARD_ADLRVP_NPCX
	bool "Intel ADLRVP_NPCX board"
	depends on SOC_NPCX9M7F
	help
	  Build Intel ADLRVP_NPCX reference board. This board has Intel ADL RVP
	  SoC with NPCX9M37F EC.

config BOARD_MTLRVP_M1723
	bool "Intel MTLRVP_MCHP board"
	depends on SOC_MEC172X_NSZ
	help
	  Build Intel MTLRVP_MCHP reference board. This board has Intel MTL RVP
	  SoC with MEC1723 EC

config BOARD_MTLRVP_MCHP
	bool "Intel MTLRVP_MCHP board"
	depends on SOC_MEC172X_NSZ
	help
	  Build Intel MTLRVP_MCHP reference board. This board has Intel MTL RVP
	  SoC with MEC1727 EC

config BOARD_MTLRVP_NPCX
	bool "Intel MTLRVP_NPCX board"
	depends on SOC_NPCX9M3F
	help
	  Build Intel MTLRVP_NPCX reference board. This board is Intel MTL RVP
	  SOC with NPCX_NPCX9M3F

config BOARD_PTLRVP_COMMON
	bool "Intel PTLRVP common"
	help
	  Build Intel PTLRVP common files. This config can be used by different
	  MECC vendors using PTLRVP for the EC enablement.

config BOARD_PTLRVP_NPCX
	bool "Intel PTLRVP_NPCX board"
	depends on SOC_NPCX9M7F
	select BOARD_PTLRVP_COMMON
	help
	  Build Intel PTLRVP_NPCX reference board. This board is Intel PTL RVP
	  SOC with SOC_NPCX9M7F.

config BOARD_PTLRVP_MCHP
	bool "Intel PTLRVP_MCHP board"
	depends on SOC_MEC172X_NSZ
	select BOARD_PTLRVP_COMMON
	help
	  Build Intel PTLRVP_MCHP reference board. This board is Intel PTL RVP
	  SOC with SOC_MEC172X_NSZ.

config BOARD_PTL_MCHP
	bool "Intel PTL_MCHP board"
	depends on SOC_MEC172X_NSZ && INTEL_BOARD_ID
	select BOARD_PTLRVP_COMMON
	help
	  Build Intel PTL boards with Microchip EC. This board is Intel PTL
	  SOC with SOC_MEC172X_NSZ.

config BOARD_PTLGCS
	bool "Intel PTLRVP_MCHP board"
	depends on SOC_MEC172X_NSZ
	select BOARD_PTLRVP_COMMON
	help
	  Build Intel PTL Generic Chassis System (GCS). This board is Intel PTL
	  GCS SOC with SOC_MEC172X_NSZ.

# Override the default USB-C stack choice baseed on the board type.
# This must be done before including Kconfig.zephyr below.
choice PLATFORM_EC_USBC_STACK
	default PLATFORM_EC_USB_PD_CONTROLLER \
		if BOARD_MTLRVP_PD || BOARD_PTLRVP_COMMON
endchoice

source "Kconfig.zephyr"
```

## prj.conf
```kconfig
# Copyright 2022 The ChromiumOS Authors
# Use of this source code is governed by a BSD-style license that can be
# found in the LICENSE file.


CONFIG_CROS_EC=y
CONFIG_PLATFORM_EC=y
CONFIG_PLATFORM_EC_POWER_BUTTON=y
CONFIG_PLATFORM_EC_LID_SWITCH=y
CONFIG_PLATFORM_EC_EXTPOWER_GPIO=y

# Battery
CONFIG_PLATFORM_EC_BATTERY_CUT_OFF=y
CONFIG_PLATFORM_EC_BATTERY_FUEL_GAUGE=y
CONFIG_PLATFORM_EC_BATTERY_PRESENT_GPIO=y
CONFIG_PLATFORM_EC_BATTERY_REVIVE_DISCONNECT=y
CONFIG_PLATFORM_EC_CHARGER_MIN_POWER_MW_FOR_POWER_ON_WITH_BATT=15000
CONFIG_PLATFORM_EC_CHARGER_MIN_POWER_MW_FOR_POWER_ON=15001
CONFIG_PLATFORM_EC_CHARGER_MIN_INPUT_CURRENT_LIMIT=512

#Power Sequencing
CONFIG_PLATFORM_EC_BOARD_RESET_AFTER_POWER_ON=y

# Host command
CONFIG_PLATFORM_EC_HOSTCMD_AP_RESET=y
CONFIG_PLATFORM_EC_PORT80=y

# USB-C and PD
CONFIG_PLATFORM_EC_USB_VID=0x18d1
CONFIG_PLATFORM_EC_USB_PID=0x8086
CONFIG_PLATFORM_EC_USB_PD_REQUIRE_AP_MODE_ENTRY=y
CONFIG_PLATFORM_EC_TCPC_INTERRUPT=n

# eSPI
CONFIG_ESPI=y
CONFIG_PLATFORM_EC_HOST_INTERFACE_ESPI_VW_SLP_S3=y
CONFIG_PLATFORM_EC_HOST_INTERFACE_ESPI_VW_SLP_S4=y
CONFIG_PLATFORM_EC_HOST_INTERFACE_ESPI_VW_SLP_S5=y

# Keyboard
CONFIG_PLATFORM_EC_KEYBOARD_PROTOCOL_8042=y
CONFIG_PLATFORM_EC_KEYBOARD_COL2_INVERTED=y
CONFIG_PLATFORM_EC_VOLUME_BUTTONS=y
CONFIG_PLATFORM_EC_CMD_BUTTON=n

# Shell Commands
CONFIG_SHELL_HELP=y
CONFIG_SHELL_HISTORY=y
CONFIG_SHELL_TAB=y
CONFIG_SHELL_TAB_AUTOCOMPLETION=y
CONFIG_KERNEL_SHELL=y

CONFIG_SYSTEM_BOOT_TIME_LOGGING=y

# TODO
# Below conf are disabled to compile successfully
# These will be enabled in upcoming CLs
CONFIG_PLATFORM_EC_BACKLIGHT_LID=n
```

## dsp_comms.conf
```kconfig
# Copyright 2025 The ChromiumOS Authors
# Use of this source code is governed by a BSD-style license that can be
# found in the LICENSE file.

CONFIG_CPP=y
CONFIG_STD_CPP20=y # coreboot g++ __cplusplus 201703L
CONFIG_REQUIRES_FULL_LIBCPP=y

CONFIG_NANOPB=y

# Pigweed
CONFIG_PIGWEED_ASSERT_ZEPHYR=y
CONFIG_PIGWEED_CHRONO_SYSTEM_CLOCK=y
CONFIG_PIGWEED_SYNC_MUTEX=y

# Common features for service and client
CONFIG_PLATFORM_EC_DSP_REMOTE_CBI=y
CONFIG_PLATFORM_EC_DSP_REMOTE_LID_ANGLE=y
CONFIG_PLATFORM_EC_DSP_REMOTE_LID_SWITCH=y
CONFIG_PLATFORM_EC_DSP_REMOTE_TABLET_SWITCH=y

# Feature not supported
CONFIG_COMMON_LIBC_MALLOC=n

# Log
CONFIG_DSP_COMMS_LOG_LEVEL_ERR=y
```

## program.conf
```kconfig
# Copyright 2022 The ChromiumOS Authors
# Use of this source code is governed by a BSD-style license that can be
# found in the LICENSE file.


CONFIG_CROS_EC=y
CONFIG_PLATFORM_EC=y
CONFIG_PLATFORM_EC_POWER_BUTTON=y
CONFIG_PLATFORM_EC_LID_SWITCH=y
CONFIG_PLATFORM_EC_EXTPOWER_GPIO=y

# Postcode
CONFIG_PLATFORM_EC_PORT80=y
CONFIG_PLATFORM_EC_PORT80_4_BYTE=y

# Battery
CONFIG_PLATFORM_EC_BATTERY_CUT_OFF=y
CONFIG_PLATFORM_EC_BATTERY_FUEL_GAUGE=y
CONFIG_PLATFORM_EC_BATTERY_PRESENT_GPIO=y
CONFIG_PLATFORM_EC_BATTERY_REVIVE_DISCONNECT=y
CONFIG_PLATFORM_EC_CHARGER_MIN_POWER_MW_FOR_POWER_ON_WITH_BATT=15000
CONFIG_PLATFORM_EC_CHARGER_MIN_POWER_MW_FOR_POWER_ON=15001

#Power Sequencing
CONFIG_PLATFORM_EC_BOARD_RESET_AFTER_POWER_ON=y

# Host command
CONFIG_PLATFORM_EC_HOSTCMD_AP_RESET=y
CONFIG_PLATFORM_EC_PORT80=y

# USB-C and PD
CONFIG_PLATFORM_EC_USB_VID=0x18d1
CONFIG_PLATFORM_EC_USB_PID=0x8086
CONFIG_PLATFORM_EC_USB_PD_REQUIRE_AP_MODE_ENTRY=y
CONFIG_PLATFORM_EC_TCPC_INTERRUPT=n

# eSPI
CONFIG_ESPI=y
CONFIG_PLATFORM_EC_HOST_INTERFACE_ESPI_VW_SLP_S3=y
CONFIG_PLATFORM_EC_HOST_INTERFACE_ESPI_VW_SLP_S4=y
CONFIG_PLATFORM_EC_HOST_INTERFACE_ESPI_VW_SLP_S5=y

# Keyboard
CONFIG_PLATFORM_EC_KEYBOARD_PROTOCOL_8042=y
CONFIG_PLATFORM_EC_VOLUME_BUTTONS=y
CONFIG_PLATFORM_EC_CMD_BUTTON=n

# Shell Commands
CONFIG_SHELL_HELP=y
CONFIG_SHELL_HISTORY=y
CONFIG_SHELL_TAB=y
CONFIG_SHELL_TAB_AUTOCOMPLETION=y
CONFIG_KERNEL_SHELL=y

CONFIG_SYSTEM_BOOT_TIME_LOGGING=y

# TODO
# Below conf are disabled to compile successfully
# These will be enabled in upcoming CLs
CONFIG_PLATFORM_EC_BACKLIGHT_LID=n

# Upstream Zephyr Host Command
CONFIG_EC_HOST_CMD=y
```

## zephyr_ap_pwrseq.conf
```kconfig
# Copyright 2022 The ChromiumOS Authors
# Use of this source code is governed by a BSD-style license that can be
# found in the LICENSE file.

# Zephyr Inbuilt AP Power Sequencing Config
CONFIG_X86_NON_DSX_PWRSEQ_CONSOLE=y
CONFIG_X86_NON_DSX_PWRSEQ_HOST_CMD=y
#CONFIG_AP_PWRSEQ_S0IX=y
#CONFIG_AP_PWRSEQ_S0IX_ERROR_RECOVERY=y
```

## include/gcs_kbd.h
```c
/* Copyright 2024 The ChromiumOS Authors
 * Use of this source code is governed by a BSD-style license that can be
 * found in the LICENSE file.
 */

/* Keyboard configuration */

#ifndef __GCS_KBD_H
#define __GCS_KBD_H


/*
 * KEYBOARD_COLS_MAX has the build time column size. It's used to allocate
 * exact spaces for arrays. Actual keyboard scanning is done using
 * keyboard_cols, which holds a runtime column size.
 */
#undef KEYBOARD_COLS_MAX
#undef KEYBOARD_ROWS

#define KEYBOARD_COLS_MAX 16
#define KEYBOARD_ROWS 8

#define KEYBOARD_ROW_TO_MASK(r) (1 << (r))

/* Columns and masks for keys we particularly care about */
#define KEYBOARD_COL_DOWN 11
#define KEYBOARD_ROW_DOWN 5
#define KEYBOARD_MASK_DOWN KEYBOARD_ROW_TO_MASK(KEYBOARD_ROW_DOWN)

#define KEYBOARD_COL_ESC 1
#define KEYBOARD_ROW_ESC 3
#define KEYBOARD_MASK_ESC KEYBOARD_ROW_TO_MASK(KEYBOARD_ROW_ESC)

#define KEYBOARD_COL_KEY_H 5
#define KEYBOARD_ROW_KEY_H 3
#define KEYBOARD_MASK_KEY_H KEYBOARD_ROW_TO_MASK(KEYBOARD_ROW_KEY_H)

#define KEYBOARD_COL_KEY_R 4
#define KEYBOARD_ROW_KEY_R 0
#define KEYBOARD_MASK_KEY_R KEYBOARD_ROW_TO_MASK(KEYBOARD_ROW_KEY_R)

#define KEYBOARD_COL_LEFT_ALT 9
#define KEYBOARD_ROW_LEFT_ALT 3
#define KEYBOARD_MASK_LEFT_ALT KEYBOARD_ROW_TO_MASK(KEYBOARD_ROW_LEFT_ALT)

/* TODO */
#define KEYBOARD_COL_REFRESH 2
#define KEYBOARD_ROW_REFRESH 3
#define KEYBOARD_MASK_REFRESH KEYBOARD_ROW_TO_MASK(KEYBOARD_ROW_REFRESH)

#define KEYBOARD_COL_RIGHT_ALT 9
#define KEYBOARD_ROW_RIGHT_ALT 5
#define KEYBOARD_MASK_RIGHT_ALT KEYBOARD_ROW_TO_MASK(KEYBOARD_ROW_RIGHT_ALT)

#define KEYBOARD_DEFAULT_COL_VOL_UP 11
#define KEYBOARD_DEFAULT_ROW_VOL_UP 3

#define KEYBOARD_COL_LEFT_SHIFT 15
#define KEYBOARD_ROW_LEFT_SHIFT 1
#define KEYBOARD_MASK_LEFT_SHIFT KEYBOARD_ROW_TO_MASK(KEYBOARD_ROW_LEFT_SHIFT)

#endif /* __GCS_KBD_H */
```

## include/intel_rvp_board_id.h
```c
/* Copyright 2022 The ChromiumOS Authors
 * Use of this source code is governed by a BSD-style license that can be
 * found in the LICENSE file.
 */

#ifndef __INTEL_RVP_BOARD_ID_H
#define __INTEL_RVP_BOARD_ID_H

#include <zephyr/drivers/gpio.h>

#define RVP_ID_HAS_BOM_GPIOS DT_NODE_HAS_PROP(DT_DRV_INST(0), bom_gpios)

#define RVP_ID_HAS_FAB_GPIOS DT_NODE_HAS_PROP(DT_DRV_INST(0), fab_gpios)

#if RVP_ID_HAS_BOM_GPIOS
extern const struct gpio_dt_spec bom_id_config[];
#endif

#if RVP_ID_HAS_FAB_GPIOS
extern const struct gpio_dt_spec fab_id_config[];
#endif

extern const struct gpio_dt_spec board_id_config[];

#endif /* __INTEL_RVP_BOARD_ID_H */
```

## include/intelrvp.h
```c
/* Copyright 2022 The ChromiumOS Authors
 * Use of this source code is governed by a BSD-style license that can be
 * found in the LICENSE file.
 */
#ifndef __INTELRVP_BOARD_H
#define __INTELRVP_BOARD_H

#include "compiler.h"
#include "gpio_signal.h"
#include "stdbool.h"

/* RVP ID read retry count */
#define RVP_VERSION_READ_RETRY_CNT 2

#define DC_JACK_MAX_VOLTAGE_MV 19000

FORWARD_DECLARE_ENUM(tcpc_rp_value);

/* TCPC AIC Config for MECC1.0 */
struct mecc_1_0_tcpc_aic_gpio_config_t {
	/* TCPC interrupt */
	enum gpio_signal tcpc_alert;
	/* PPC interrupt */
	enum gpio_signal ppc_alert;
	/* PPC interrupt handler */
	void (*ppc_intr_handler)(int port);
};
extern const struct mecc_1_0_tcpc_aic_gpio_config_t mecc_1_0_tcpc_aic_gpios[];

/* TCPC AIC Config for MECC1.1 */
struct mecc_1_1_tcpc_aic_gpio_config_t {
	/* TCPC interrupt */
	enum gpio_signal tcpc_alert;
};
extern const struct mecc_1_1_tcpc_aic_gpio_config_t mecc_1_1_tcpc_aic_gpios[];

void board_charging_enable(int port, int enable);
void board_vbus_enable(int port, int enable);
void board_set_vbus_source_current_limit(int port, enum tcpc_rp_value rp);
int board_dc_jack_present(void);
void board_dc_jack_interrupt(enum gpio_signal signal);
bool is_typec_port(int port);
#endif /* __INTELRVP_BOARD_H */
```

## include/kbd_gcs.h
```c
/* Copyright 2024 The ChromiumOS Authors
 * Use of this source code is governed by a BSD-style license that can be
 * found in the LICENSE file.
 */

/* Keyboard configuration */

#ifndef __KBD_GCS_H
#define __KBD_GCS_H

/*
 * KEYBOARD_COLS_MAX has the build time column size. It's used to allocate
 * exact spaces for arrays. Actual keyboard scanning is done using
 * keyboard_cols, which holds a runtime column size.
 */
#undef KEYBOARD_COLS_MAX
#undef KEYBOARD_ROWS

#define KEYBOARD_COLS_MAX 16
#define KEYBOARD_ROWS 8

#endif /* __KBD_GCS_H */
```

## include/kbd_strauss.h
```c
/* Copyright 2024 The ChromiumOS Authors
 * Use of this source code is governed by a BSD-style license that can be
 * found in the LICENSE file.
 */

/* Keyboard configuration */

#ifndef __KBD_STRAUSS_H
#define __KBD_STRAUSS_H

/*
 * KEYBOARD_COLS_MAX has the build time column size. It's used to allocate
 * exact spaces for arrays. Actual keyboard scanning is done using
 * keyboard_cols, which holds a runtime column size.
 */
#undef KEYBOARD_COLS_MAX
#undef KEYBOARD_ROWS

#define KEYBOARD_COLS_MAX 17
#define KEYBOARD_ROWS 8

#endif /* __KBD_STRAUSS_H */
```

## include/keyboard_customization.h
```c
/* Copyright 2025 The ChromiumOS Authors
 * Use of this source code is governed by a BSD-style license that can be
 * found in the LICENSE file.
 */
/* Keyboard configuration */

#ifndef __KEYBOARD_CUSTOMIZATION_H
#define __KEYBOARD_CUSTOMIZATION_H

#ifdef CONFIG_PLATFORM_EC_KEYBOARD_STRAUSS
#include "kbd_strauss.h"
#elif defined(CONFIG_KEYBOARD_INTEL_GCS)
#include "kbd_gcs.h"
#endif

#endif /* __KEYBOARD_CUSTOMIZATION_H */
```

## src/chg_dc_jack.c
```c
/* Copyright 2023 The ChromiumOS Authors
 * Use of this source code is governed by a BSD-style license that can be
 * found in the LICENSE file.
 */

#include "charge_manager.h"
#include "charge_state.h"
#include "gpio.h"
#include "hooks.h"
#include "intelrvp.h"
#include "tcpm/tcpci.h"
int board_dc_jack_present(void)
{
#if CONFIG_DEDICATED_CHARGE_PORT_COUNT > 0
	return gpio_get_level(GPIO_DC_JACK_PRESENT);
#else
	return 0;
#endif /* CONFIG_DEDICATED_CHARGE_PORT_COUNT > 0 */
}

static void board_dc_jack_handle(void)
{
#if CONFIG_DEDICATED_CHARGE_PORT_COUNT > 0
	struct charge_port_info charge_dc_jack;

	/* System is booted from DC Jack */
	if (board_dc_jack_present()) {
		charge_dc_jack.current =
			(PD_MAX_POWER_MW * 1000) / DC_JACK_MAX_VOLTAGE_MV;
		charge_dc_jack.voltage = DC_JACK_MAX_VOLTAGE_MV;
	} else {
		charge_dc_jack.current = 0;
		charge_dc_jack.voltage = USB_CHARGER_VOLTAGE_MV;
	}

	charge_manager_update_charge(CHARGE_SUPPLIER_DEDICATED,
				     DEDICATED_CHARGE_PORT, &charge_dc_jack);
#endif /* CONFIG_DEDICATED_CHARGE_PORT_COUNT > 0 */
}

void board_dc_jack_interrupt(enum gpio_signal signal)
{
	board_dc_jack_handle();
}

static void board_charge_init(void)
{
	int port, supplier;
	struct charge_port_info charge_init = {
		.current = 0,
		.voltage = USB_CHARGER_VOLTAGE_MV,
	};

	/* Initialize all charge suppliers to seed the charge manager */
	for (port = 0; port < CHARGE_PORT_COUNT; port++) {
		for (supplier = 0; supplier < CHARGE_SUPPLIER_COUNT;
		     supplier++) {
			charge_manager_update_charge(supplier, port,
						     &charge_init);
		}
	}

	board_dc_jack_handle();
}
DECLARE_HOOK(HOOK_INIT, board_charge_init, HOOK_PRIO_DEFAULT);
```

## src/chg_usb_pd.c
```c
/* Copyright 2022 The ChromiumOS Authors
 * Use of this source code is governed by a BSD-style license that can be
 * found in the LICENSE file.
 */

#include "charge_manager.h"
#include "charge_state.h"
#include "gpio.h"
#include "hooks.h"
#include "intelrvp.h"
#include "tcpm/tcpci.h"

#if 0
#define CPRINTF(format, args...) cprintf(CC_USBPD, format, ##args)
#define CPRINTS(format, args...) cprints(CC_USBPD, format, ##args)
#else
#define CPRINTF(format, args...)
#define CPRINTS(format, args...)
#endif

int board_set_active_charge_port(int port)
{
	int i;
	/* charge port is a realy physical port */
	int is_real_port = (port >= 0 && port < CHARGE_PORT_COUNT);
	/* check if we are source vbus on that port */
	int source = board_vbus_source_enabled(port);

	if (is_real_port && source) {
		CPRINTS("Skip enable p%d", port);
		return EC_ERROR_INVAL;
	}

#if CONFIG_DEDICATED_CHARGE_PORT_COUNT > 0
	/*
	 * Do not enable Type-C port if the DC Jack is present.
	 * When the Type-C is active port, hardware circuit will
	 * block DC jack from enabling +VADP_OUT.
	 */
	if (port != DEDICATED_CHARGE_PORT && board_dc_jack_present()) {
		CPRINTS("DC Jack present, Skip enable p%d", port);
		return EC_ERROR_INVAL;
	}
#endif /* CONFIG_DEDICATED_CHARGE_PORT_COUNT */

	/* Make sure non-charging ports are disabled */
	for (i = 0; i < CONFIG_USB_PD_PORT_MAX_COUNT; i++) {
		if (i != port) {
			board_charging_enable(i, 0);
		}
	}

	/* Enable charging port */
	if (is_typec_port(port)) {
		board_charging_enable(port, 1);
	}

	CPRINTS("New chg p%d", port);

	return EC_SUCCESS;
}
```

## src/chg_usb_pd_mecc_1_0.c
```c
/* Copyright 2022 The ChromiumOS Authors
 * Use of this source code is governed by a BSD-style license that can be
 * found in the LICENSE file.
 */

/* Intel-RVP family-specific configuration */

#include "charge_manager.h"
#include "charge_state_v2.h"
#include "console.h"
#include "driver/ppc/sn5s330.h"
#include "gpio.h"
#include "hooks.h"
#include "tcpm/tcpci.h"
#include "system.h"
#include "usbc_ppc.h"

#ifdef CONFIG_ZEPHYR
#include "intelrvp.h"
#endif /* CONFIG_ZEPHYR */

#define CPRINTF(format, args...) cprintf(CC_USBPD, format, ##args)
#define CPRINTS(format, args...) cprints(CC_USBPD, format, ##args)

/* Reset PD MCU */
void board_reset_pd_mcu(void)
{
	/* Add code if TCPC chips need a reset */
}

static void baseboard_tcpc_init(void)
{
	int i;

	/* Only reset TCPC if not sysjump */
	if (!system_jumped_late())
		board_reset_pd_mcu();

	for (i = 0; i < CONFIG_USB_PD_PORT_MAX_COUNT; i++) {
		/* Enable PPC interrupts. */
		if (tcpc_aic_gpios[i].ppc_intr_handler)
			gpio_enable_interrupt(tcpc_aic_gpios[i].ppc_alert);

		/* Enable TCPC interrupts. */
		if (tcpc_config[i].bus_type != EC_BUS_TYPE_EMBEDDED)
			gpio_enable_interrupt(tcpc_aic_gpios[i].tcpc_alert);
	}
}
DECLARE_HOOK(HOOK_INIT, baseboard_tcpc_init, HOOK_PRIO_INIT_CHIPSET);

uint16_t tcpc_get_alert_status(void)
{
	uint16_t status = 0;
	int i;

	/* Check which port has the ALERT line set */
	for (i = 0; i < CONFIG_USB_PD_PORT_MAX_COUNT; i++) {
		/* No alerts for embdeded TCPC */
		if (tcpc_config[i].bus_type == EC_BUS_TYPE_EMBEDDED)
			continue;

		if (!gpio_get_level(tcpc_aic_gpios[i].tcpc_alert))
			status |= PD_STATUS_TCPC_ALERT_0 << i;
	}

	return status;
}

int ppc_get_alert_status(int port)
{
	if (!tcpc_aic_gpios[port].ppc_intr_handler)
		return 0;

	return !gpio_get_level(tcpc_aic_gpios[port].ppc_alert);
}

/* PPC support routines */
void ppc_interrupt(enum gpio_signal signal)
{
	int i;

	for (i = 0; i < CONFIG_USB_PD_PORT_MAX_COUNT; i++) {
		if (tcpc_aic_gpios[i].ppc_intr_handler &&
		    signal == tcpc_aic_gpios[i].ppc_alert) {
			tcpc_aic_gpios[i].ppc_intr_handler(i);
			break;
		}
	}
}

void board_charging_enable(int port, int enable)
{
	if (ppc_vbus_sink_enable(port, enable))
		CPRINTS("C%d: sink path %s failed", port,
			enable ? "en" : "dis");
}
```

## src/chg_usb_pd_mecc_1_1.c
```c
/* Copyright 2022 The ChromiumOS Authors
 * Use of this source code is governed by a BSD-style license that can be
 * found in the LICENSE file.
 */

/* Intel-RVP family-specific configuration */

#include "console.h"
#include "gpio/gpio_int.h"
#include "hooks.h"
#include "include/gpio.h"
#include "intelrvp.h"
#include "ioexpander.h"
#include "system.h"
#include "tcpm/tcpci.h"
#include "usbc_ppc.h"

#define CPRINTF(format, args...) cprintf(CC_USBPD, format, ##args)
#define CPRINTS(format, args...) cprints(CC_USBPD, format, ##args)

uint16_t tcpc_get_alert_status(void)
{
	uint16_t status = 0;
	int i;

	/* Check which port has the ALERT line set */
	for (i = 0; i < CONFIG_USB_PD_PORT_MAX_COUNT; i++) {
		/* No alerts for embdeded TCPC */
		if (tcpc_config[i].bus_type == EC_BUS_TYPE_EMBEDDED) {
			continue;
		}

		if (!gpio_get_level(tcpc_aic_config[i].tcpc_alert)) {
			status |= PD_STATUS_TCPC_ALERT_0 << i;
		}
	}

	return status;
}

void board_charging_enable(int port, int enable)
{
	int rv;

	if (board_port_has_ppc(port)) {
		rv = ppc_vbus_sink_enable(port, enable);
	} else {
		rv = tcpc_config[port].drv->set_snk_ctrl(port, enable);
	}

	if (rv) {
		CPRINTS("C%d: sink path %s failed", port,
			enable ? "en" : "dis");
	}
}
```

## src/chg_usb_tcpc.c
```c
/* Copyright 2024 The ChromiumOS Authors
 * Use of this source code is governed by a BSD-style license that can be
 * found in the LICENSE file.
 */

#include "hooks.h"
#include "intelrvp.h"
#include "tcpm/tcpci.h"

#include <zephyr/logging/log.h>

LOG_MODULE_REGISTER(chg_usb_tcpc, LOG_LEVEL_INF);

int board_set_active_charge_port(int port)
{
	int i;
	/* charge port is a realy physical port */
	int is_real_port = (port >= 0 && port < CHARGE_PORT_COUNT);
	/* check if we are source vbus on that port */
	int source = board_vbus_source_enabled(port);

	if (is_real_port && source) {
		LOG_ERR("Skip enable p%d", port);
		return EC_ERROR_INVAL;
	}

#if CONFIG_DEDICATED_CHARGE_PORT_COUNT > 0
	/*
	 * Do not enable Type-C port if the DC Jack is present.
	 * When the Type-C is active port, hardware circuit will
	 * block DC jack from enabling +VADP_OUT.
	 */
	if (port != DEDICATED_CHARGE_PORT && board_dc_jack_present()) {
		LOG_ERR("DC Jack present, Skip enable p%d", port);
		return EC_ERROR_INVAL;
	}
#endif /* CONFIG_DEDICATED_CHARGE_PORT_COUNT */

	/* Make sure non-charging ports are disabled */
	for (i = 0; i < CONFIG_USB_PD_PORT_MAX_COUNT; i++) {
		if (i != port) {
			board_charging_enable(i, 0);
		}
	}

	/* Enable charging port */
	if (is_typec_port(port)) {
		board_charging_enable(port, 1);
	}

	LOG_INF("New chg p%d", port);

	return EC_SUCCESS;
}
```

## src/chg_usbc.c
```c
/* Copyright 2024 The ChromiumOS Authors
 * Use of this source code is governed by a BSD-style license that can be
 * found in the LICENSE file.
 */

/* Common USB PD/TCPC charge configuration */

#include "charge_manager.h"
#include "charge_state.h"
#include "gpio.h"
#include "hooks.h"
#include "intelrvp.h"
#include "tcpm/tcpci.h"

bool is_typec_port(int port)
{
#if CONFIG_DEDICATED_CHARGE_PORT_COUNT > 0
	return !(port == DEDICATED_CHARGE_PORT || port == CHARGE_PORT_NONE);
#else
	return !(port == CHARGE_PORT_NONE);
#endif /* CONFIG_DEDICATED_CHARGE_PORT_COUNT > 0 */
}

int board_dc_jack_present(void)
{
#if CONFIG_DEDICATED_CHARGE_PORT_COUNT > 0
	return gpio_get_level(GPIO_DC_JACK_PRESENT);
#else
	return 0;
#endif /* CONFIG_DEDICATED_CHARGE_PORT_COUNT > 0 */
}

static void board_dc_jack_handle(void)
{
#if CONFIG_DEDICATED_CHARGE_PORT_COUNT > 0
	struct charge_port_info charge_dc_jack;

	/* System is booted from DC Jack */
	if (board_dc_jack_present()) {
		charge_dc_jack.current =
			(PD_MAX_POWER_MW * 1000) / DC_JACK_MAX_VOLTAGE_MV;
		charge_dc_jack.voltage = DC_JACK_MAX_VOLTAGE_MV;
	} else {
		charge_dc_jack.current = 0;
		charge_dc_jack.voltage = USB_CHARGER_VOLTAGE_MV;
	}

	charge_manager_update_charge(CHARGE_SUPPLIER_DEDICATED,
				     DEDICATED_CHARGE_PORT, &charge_dc_jack);
#endif /* CONFIG_DEDICATED_CHARGE_PORT_COUNT > 0 */
}

void board_dc_jack_interrupt(enum gpio_signal signal)
{
	board_dc_jack_handle();
}

static void board_charge_init(void)
{
	int port, supplier;
	struct charge_port_info charge_init = {
		.current = 0,
		.voltage = USB_CHARGER_VOLTAGE_MV,
	};

	/* Initialize all charge suppliers to seed the charge manager */
	for (port = 0; port < CHARGE_PORT_COUNT; port++) {
		for (supplier = 0; supplier < CHARGE_SUPPLIER_COUNT;
		     supplier++) {
			charge_manager_update_charge(supplier, port,
						     &charge_init);
		}
	}

	board_dc_jack_handle();
}
DECLARE_HOOK(HOOK_INIT, board_charge_init, HOOK_PRIO_DEFAULT);
```
