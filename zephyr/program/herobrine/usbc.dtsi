/* Copyright 2022 The ChromiumOS Authors
 * Use of this source code is governed by a BSD-style license that can be
 * found in the LICENSE file.
 */

#include <dt-bindings/usb-c/pd.h>

/ {
	usbc {
		#address-cells = <1>;
		#size-cells = <0>;

		// port0: port0@0 {
		// 	compatible = "named-usbc-port";
		// 	reg = <0>;
		// 	bc12 = <&bc12_port0>;
		// 	ppc = <&ppc_port0>;
		// 	tcpc = <&tcpc_port0>;
		// 	chg = <&charger>;
		// 	usb-mux-chain-0 {
		// 		compatible = "cros-ec,usb-mux-chain";
		// 		usb-muxes = <&usb_mux_0>;
		// 	};
		// };
		// usb_mux_0: usb-mux-0 {
		// 	compatible = "parade,usbc-mux-ps8xxx";
		// };

		// port1: port1@1 {
		// 	compatible = "named-usbc-port";
		// 	reg = <1>;
		// 	bc12 = <&bc12_port1>;
		// 	ppc = <&ppc_port1>;
		// 	tcpc = <&tcpc_port1>;
		// 	usb-mux-chain-1 {
		// 		compatible = "cros-ec,usb-mux-chain";
		// 		usb-muxes = <&usb_mux_1>;
		// 	};
		// };
		// usb_mux_1: usb-mux-1 {
		// 	compatible = "parade,usbc-mux-ps8xxx";
		// };

		tcpc_parade: port1@1 {
			compatible = "usb-c-connector";
			reg = <1>;
			/*bc12 = <&bc12_port1>;*/
			tcpc = <&tcpc_port1>;
			vbus = <&tcpc_port1_vbus>;
			power-role = "sink";
			sink-pdos = <PDO_FIXED(5000, 100, 0)>;
		};
	};
};
