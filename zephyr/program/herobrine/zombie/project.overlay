/* Copyright 2022 The ChromiumOS Authors
 * Use of this source code is governed by a BSD-style license that can be
 * found in the LICENSE file.
 */

/* Herobrine program common DTS includes */
#include "../adc.dtsi"
#include "../common.dtsi"
#include "../i2c.dtsi"
#include "../keyboard.dtsi"
#include "../default_gpio_pinctrl.dtsi"
#include "../switchcap.dtsi"
#include "../usbc.dtsi"
#include "../interrupts.dtsi"

/* Zombie project DTS includes*/
#include "gpio.dtsi"
#include "led_pins.dtsi"
#include "led_policy.dtsi"

/* zombie overrides follow... */
/* battery overrides */
/ {
	batteries {
		default_battery: sg20 {
			compatible = "ganfeng,sg20", "battery-smart";
		};
	};
};

/* interrupts overrides */
/ {
	gpio-interrupts {
		/delete-node/ accel_gyro;
		/delete-node/ tablet_mode;
	};
};
