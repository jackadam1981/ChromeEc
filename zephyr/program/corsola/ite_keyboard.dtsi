/* Copyright 2022 The ChromiumOS Authors
 * Use of this source code is governed by a BSD-style license that can be
 * found in the LICENSE file.
 */

/ {
	cros-keyscan {
		compatible = "cros-ec,keyscan";

		scan-period = <10000>;

		actual-key-mask = <
			0x1c	/* C0 */
			0xff	/* C1 */
			0xff	/* C2 */
			0xff	/* C3 */
			0xff	/* C4 */
			0xf5	/* C5 */
			0xff	/* C6 */
			0xa4	/* C7 */
			0xff	/* C8 */
			0xfe	/* C9 */
			0x55	/* C10 */
			0xfa	/* C11 */
			0xca	/* C12 */
			>;
	};
};

&cros_kb_raw {
	status = "okay";
	/* No KSO2 (it's inverted and implemented by GPIO) */
	pinctrl-kscan = <&kscan_ksi_0_kbs
			 &kscan_ksi_1_kbs
			 &kscan_ksi_2_kbs
			 &kscan_ksi_3_kbs
			 &kscan_ksi_4_kbs
			 &kscan_ksi_5_kbs
			 &kscan_ksi_6_kbs
			 &kscan_ksi_7_kbs
			 &kscan_kso_0_kbs
			 &kscan_kso_1_kbs
			 &kscan_kso_3_kbs
			 &kscan_kso_4_kbs
			 &kscan_kso_5_kbs
			 &kscan_kso_6_kbs
			 &kscan_kso_7_kbs
			 &kscan_kso_8_kbs
			 &kscan_kso_9_kbs
			 &kscan_kso_10_kbs
			 &kscan_kso_11_kbs
			 &kscan_kso_12_kbs>;
};
