## zephyr/emul/Kconfig.tcpc
```kconfig
# Copyright 2021 The Chromium OS Authors. All rights reserved.
# Use of this source code is governed by a BSD-style license that can be
# found in the LICENSE file.

DT_COMPAT_TCPC_EMUL := cros,tcpc-emul

menuconfig EMUL_TCPC
	bool "TCPC emulator"
	default $(dt_compat_enabled,$(DT_COMPAT_TCPC_EMUL))
	depends on I2C_EMUL
	help
	  Enable the TCPC emulator. This driver uses the emulated I2C bus. It is
	  used to test tcpci code. It supports reads and writes to all emulator
	  registers. Generic TCPC emulator can be used as the base for specific
	  TCPC device emulator. TCPC emulator API is available in
	  zephyr/include/emul/emul_tcpc.h

if EMUL_TCPC

module = TCPC_EMUL
module-str = tcpc_emul
source "subsys/logging/Kconfig.template.log_config"

endif # EMUL_TCPC
```

## zephyr/emul/Kconfig.usb_mux_mock
```kconfig
# Copyright 2021 The Chromium OS Authors. All rights reserved.
# Use of this source code is governed by a BSD-style license that can be
# found in the LICENSE file.

menuconfig EMUL_USB_MUX_MOCK
	bool "Usb mux mock used for unit tests"
	help
	  Usb mux mock allows to set arbittrary return codes of usb mux
	  functions. This allows to use this mux in unit tests of usb mux
	  framework. Mock API is available in
	  zephyr/include/emul/emul_usb_mux_mock.h

if EMUL_USB_MUX_MOCK

config USB_MUX_MOCK_NUM
	int "Number of usb mux mock instances"
	help
	  Allows to select how many usb mux should be instantioned.

module = USB_MUX_MOCK
module-str = usb_mux_mock
source "subsys/logging/Kconfig.template.log_config"

endif # EMUL_USB_MUX_MOCK
```

## zephyr/emul/usb_mux/Kconfig
```kconfig
# Copyright 2023 The ChromiumOS Authors
# Use of this source code is governed by a BSD-style license that can be
# found in the LICENSE file.

config EMUL_USB_MUX_AMD_FP6
	bool "AMD FP6 USB mux emulator"
	depends on DT_HAS_CROS_AMD_FP6_USB_MUX_EMUL_ENABLED
	help
	  Enable emulator for the AMD FP6 USB mux target.  This is a mux
	  which, while it resides on the SoC, presents itself to the EC as a
	  I2C target device

if EMUL_USB_MUX_AMD_FP6

module = AMD_FP6_EMUL
module-str = amd_fp6_emul
source "subsys/logging/Kconfig.template.log_config"

endif # EMUL_USB_MUX_AMD_FP6
```

## zephyr/program/dirks/Kconfig
```kconfig
# Copyright 2025 The ChromiumOS Authors
# Use of this source code is governed by a BSD-style license that can be
# found in the LICENSE file.

config DIRKS_SUB_BOARD
	bool "Dirks sub-board support"
	default y
	help
	  Enable the sub-board support for Dirks boards.
	  This uses a common fw_config bitfield to select
	  one of a number of option sub-boards with different
	  hardware configurations.

config DIRKS_BOARD_HAS_HDMI_SUPPORT
	bool "Board supports HDMI sub-boards"
	default $(dt_nodelabel_enabled,gpio_hdmi_sel)
	help
	  Enable board code for managing the state of HDMI connections
	  on a sub-board.

config BOARD_DIRKS
	bool "Google Dirks Board"
	help
	  Build Google Dirks reference board. Dirks has Intel TWL SoC
	  with IT81302 EC.

module = DIRKS
module-str = Dirks board-specific code
source "subsys/logging/Kconfig.template.log_config"

source "Kconfig.zephyr"
```

## zephyr/program/hdctools/Kconfig
```kconfig
# Copyright 2023 The ChromiumOS Authors
# Use of this source code is governed by a BSD-style license that can be
# found in the LICENSE file.

config BOARD_STARFISH_V1
	bool "Google Starfish v1 board"
	help
	  Build The Starfish v1 SIM tester.
	  Starfish v1 is a SIM Mux which can be controlled over a USB console.

config DFU_BOOTLOADER
	bool "Enable the DFU bootloader"
	help
	  Enable the DFU bootloader.
	  Enables the DFU runtime interface and a jump to DFU mode.

source "Kconfig.zephyr"
```

## zephyr/program/trulo/uldrenite/Kconfig
```kconfig
# Copyright 2025 The ChromiumOS Authors
# Use of this source code is governed by a BSD-style license that can be
# found in the LICENSE file.

config LED_STRIP_DEMO
	bool "LED strip demo"
	help
	  Demo some effects of LED strip

if LED_STRIP_DEMO
menu "WS2812 Sample Configuration"

config SAMPLE_LED_UPDATE_DELAY
	int "Delay between LED updates in ms"
	default 50
	help
	  Delay between LED updates in ms.

config SAMPLE_LED_BRIGHTNESS
	int "LED brightness"
	default 16
	range 1 255
	help
	  Brightness level of each LED. Defaults to a low value to make
	  it easier to distinguish colors.

endmenu
endif
```

## zephyr/projects/it8xxx2_evb/boards/riscv/it8xxx2_evb/it8xxx2_evb_defconfig
```kconfig
# Copyright (c) 2020 ITE Corporation. All Rights Reserved.
# SPDX-License-Identifier: Apache-2.0

# Zephyr Kernel Configuration
CONFIG_SOC_SERIES_RISCV32_IT8XXX2=y

# Platform Configuration
CONFIG_SOC_IT8XXX2=y
CONFIG_BOARD_IT8XXX2_EVB=y

# Serial Drivers
CONFIG_SERIAL=y
CONFIG_UART_INTERRUPT_DRIVEN=n

# Enable console
CONFIG_CONSOLE=y
CONFIG_UART_CONSOLE=y

# Pinmux Driver
CONFIG_PINMUX=y

# GPIO Controller
CONFIG_GPIO=n

# Clock configuration
CONFIG_CLOCK_CONTROL=y

# WATCHDOG configuration
CONFIG_WATCHDOG=n

CONFIG_SYS_CLOCK_HW_CYCLES_PER_SEC=15000000

# Code RAM base for IT8XXX2
CONFIG_CROS_EC_PROGRAM_MEMORY_BASE=0x80000000
CONFIG_CROS_EC_RAM_BASE=0x80080000
CONFIG_CROS_EC_DATA_RAM_SIZE=0x80000
CONFIG_CROS_EC_RAM_SIZE=0x0000f000


CONFIG_CROS_EC_RO_MEM_OFF=0x0
CONFIG_CROS_EC_RO_SIZE=0x40000
CONFIG_CROS_EC_RW_MEM_OFF=0x0
CONFIG_CROS_EC_RW_SIZE=0x40000

#CONFIG_FLASH_SIZE=512
```

## zephyr/projects/npcx7_evb/boards/arm/npcx7_evb/Kconfig.board
```kconfig
# Google Npcx7_evb EC

# Copyright 2020 The Chromium OS Authors
# SPDX-License-Identifier: Apache-2.0

config BOARD_NPCX7_EVB
	bool "Google NPCX7_EVB EC"
	depends on SOC_NPCX7M6FB # Actually NPCX7M6FC; C has 512K Flash
```

## zephyr/projects/npcx7_evb/boards/arm/npcx7_evb/Kconfig.defconfig
```kconfig
# Google Npcx_evb EC

# Copyright 2020 The Chromium OS Authors
# SPDX-License-Identifier: Apache-2.0

if BOARD_NPCX7_EVB

config BOARD
	default "npcx7_evb"

endif # BOARD_NPCX7_EVB
```
