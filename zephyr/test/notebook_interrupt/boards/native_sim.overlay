/* Copyright 2024 The ChromiumOS Authors
 * Use of this source code is governed by a BSD-style license that can be
 * found in the LICENSE file.
 */

#include <board-overlays/native_posix.dts>

/{
	notebook_interrupt: notebook-interrupt {
		compatible = "cros,notebook-interrupt";
		gpios = <&gpio0 0 GPIO_ACTIVE_HIGH>;
	};
};

&gpio0 {
	ngpios = <1>;
};
