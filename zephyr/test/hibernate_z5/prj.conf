## CMakeLists.txt
```
# Copyright 2025 The ChromiumOS Authors
# Use of this source code is governed by a BSD-style license that can be
# found in the LICENSE file.

cmake_minimum_required(VERSION 3.13.1)
find_package(Zephyr REQUIRED HINTS "${ZEPHYR_BASE}")
project(hibernate_z5)

zephyr_compile_definitions("CONFIG_ZEPHYR")

target_sources(app PRIVATE src/main.c)
```

## Kconfig
```
# Copyright 2025 The ChromiumOS Authors
# Use of this source code is governed by a BSD-style license that can be
# found in the LICENSE file.

config HIBERNATE_Z5_INIT_SHOULD_FAIL
	bool
	help
	  Helper symbol that indicates that the hibernate z5 driver
	  initialization is expected to fail.

config TEST_HIBERNATE_Z5_DEFAULT
	bool "Hibernate Z5 default test"
	help
	  Default test case for the hibernate z5 driver. This verifies the
	  happy paths.

config TEST_HIBERNATE_Z5_GPIO_NOT_READY
	bool "Hibernate Z5 GPIO not ready test"
	select HIBERNATE_Z5_INIT_SHOULD_FAIL
	help
	  Verifies the hibernate z5 driver handles a GPIO port not ready.

config TEST_HIBERNATE_Z5_GPIO_BAD_CONFIG
	bool "Hibernate Z5 GPIO config fail test"
	select HIBERNATE_Z5_INIT_SHOULD_FAIL
	help
	  Verifies the hibernate z5 driver handles errors during GPIO
	  configuration.

source "Kconfig.zephyr"
```

## prj.conf
```kconfig
# Copyright 2025 The ChromiumOS Authors
# Use of this source code is governed by a BSD-style license that can be
# found in the LICENSE file.

CONFIG_ZTEST=y
CONFIG_GPIO=y

CONFIG_CROS_EC=y
CONFIG_PLATFORM_EC=y
CONFIG_SHIMMED_TASKS=y

# Stub values to get system.c to compile
CONFIG_CROS_EC_RO_MEM_OFF=0x0
CONFIG_CROS_EC_RO_SIZE=0x40000
CONFIG_CROS_EC_RW_MEM_OFF=0x40000
CONFIG_CROS_EC_RW_SIZE=0x40000
```

## boards/native_sim.overlay
```dts
/* Copyright 2025 The ChromiumOS Authors
 * Use of this source code is governed by a BSD-style license that can be
 * found in the LICENSE file.
 */

#include <board-overlays/native_sim.dts>

/ {
	hibernate_z5: hibernate-z5 {
		compatible = "cros-ec,hibernate-z5";
		en-slp-z-gpios = <&gpio0 0 GPIO_ACTIVE_HIGH>;
	};
};
```

## boards/native_sim_gpio_bad_config.overlay
```dts
/* Copyright 2025 The ChromiumOS Authors
 * Use of this source code is governed by a BSD-style license that can be
 * found in the LICENSE file.
 */

&gpio0 {
	ngpios = <2>;
};

&hibernate_z5 {
	/* Pick an out of bounds GPIO to force an error during pin configure. */
	en-slp-z-gpios = <&gpio0 4 GPIO_ACTIVE_HIGH>;
};
```

## boards/native_sim_gpio_not_ready.overlay
```dts
/* Copyright 2025 The ChromiumOS Authors
 * Use of this source code is governed by a BSD-style license that can be
 * found in the LICENSE file.
 */

/* Defer initialization to force hibernate driver failure. */
&gpio0 {
	zephyr,deferred-init;
};
```

## src/main.c
```c
/* Copyright 2025 The ChromiumOS Authors
 * Use of this source code is governed by a BSD-style license that can be
 * found in the LICENSE file.
 */

#include "system.h"
#include "zephyr/device.h"

#include <zephyr/drivers/gpio.h>
#include <zephyr/drivers/gpio/gpio_emul.h>
#include <zephyr/ztest.h>

ZTEST_SUITE(hibernate_z5, NULL, NULL, NULL, NULL, NULL);

#ifndef CONFIG_HIBERNATE_Z5_INIT_SHOULD_FAIL
ZTEST(hibernate_z5, test_hibernate_z5__assert_normal)
{
	const struct device *hibernate_dev =
		DEVICE_DT_GET(DT_NODELABEL(hibernate_z5));
	const struct gpio_dt_spec gpio_en_slp_z =
		GPIO_DT_SPEC_GET(DT_NODELABEL(hibernate_z5), en_slp_z_gpios);

	zassert_true(device_is_ready(hibernate_dev));

	gpio_pin_set_dt(&gpio_en_slp_z, 0);
	board_hibernate_late();
	zassert_true(
		gpio_emul_output_get(gpio_en_slp_z.port, gpio_en_slp_z.pin));
}
#else
ZTEST(hibernate_z5, test_hibernate_z5__assert_init_fail)
{
	const struct device *hibernate_dev =
		DEVICE_DT_GET(DT_NODELABEL(hibernate_z5));

	zassert_false(device_is_ready(hibernate_dev));
}
#endif
```
