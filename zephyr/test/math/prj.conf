## CMakeLists.txt
```
# Copyright 2022 The Chromium OS Authors. All rights reserved.
# Use of this source code is governed by a BSD-style license that can be
# found in the LICENSE file.

cmake_minimum_required(VERSION 3.13.1)
project(math)

find_package(Cros REQUIRED PATHS ${CMAKE_CURRENT_SOURCE_DIR}/../../)

# Copy math_util.h so we don't add the full include directory to the include
# path
configure_file(
		${PLATFORM_EC}/include/math_util.h ${CMAKE_BINARY_DIR}/include/math_util.h
)

# Add the common test files and the math_util.c
list(APPEND SOURCES
		${PLATFORM_EC}/common/math_util.c
		src/suite.c
		src/math_util.c
		src/vector.c
		src/mask.c
)

# Fixed point specific tests
if(NOT CONFIG_FPU)
	list(APPEND SOURCES src/fixed_point_int_sqrtf.c)
endif()

# Add the Zephyr unittest component
find_package(Zephyr COMPONENTS unittest REQUIRED HINTS $ENV{ZEPHYR_BASE})

# Link the stub/common headers to testbinary (generated by unittest)
cros_ec_stub_common(testbinary)
```

## prj.conf
```kconfig
# Copyright 2022 The ChromiumOS Authors
# Use of this source code is governed by a BSD-style license that can be
# found in the LICENSE file.

CONFIG_ZTEST=y
CONFIG_ZTEST_ASSERT_VERBOSE=1
CONFIG_ZTEST_NEW_API=y
CONFIG_ASSERT=y

CONFIG_PLATFORM_EC=y
CONFIG_CROS_EC=y
CONFIG_PLATFORM_EC_MATH_UTIL=y
CONFIG_PLATFORM_EC_CBI=n
```

## fixed_point.conf
```kconfig
# Copyright 2022 The ChromiumOS Authors. All rights reserved.
# Use of this source code is governed by a BSD-style license that can be
# found in the LICENSE file.

CONFIG_FPU=n
```

## floating_point.conf
```kconfig
# Copyright 2022 The ChromiumOS Authors. All rights reserved.
# Use of this source code is governed by a BSD-style license that can be
# found in the LICENSE file.

CONFIG_FPU=y
```

## src/fixed_point_int_sqrtf.c
```c
/* Copyright 2022 The ChromiumOS Authors
 * Use of this source code is governed by a BSD-style license that can be
 * found in the LICENSE file.
 */

#include "math.h"
#include "math_util.h"

#include <zephyr/ztest.h>

ZTEST_USER(math, int_sqrtf_negative)
{
	zassert_equal(int_sqrtf(-100), 0, NULL);
}

ZTEST_USER(math, int_sqrtf_overflow)
{
	zassert_equal(int_sqrtf(INT64_MAX), INT32_MAX, NULL);
}
```

## src/mask.c
```c
/* Copyright 2022 The ChromiumOS Authors
 * Use of this source code is governed by a BSD-style license that can be
 * found in the LICENSE file.
 */

#include "math.h"
#include "math_util.h"

#include <inttypes.h>

#include <zephyr/ztest.h>

ZTEST_USER(math, bitmask_uint64)
{
	zassert_equal(bitmask_uint64(-1), 0, NULL);
	zassert_equal(bitmask_uint64(64), 0, NULL);
	zassert_equal(bitmask_uint64(1), UINT64_C(1) << 1, NULL);
	zassert_equal(bitmask_uint64(15), UINT64_C(1) << 15, NULL);
	zassert_equal(bitmask_uint64(35), UINT64_C(1) << 35, NULL);
	zassert_equal(bitmask_uint64(60), UINT64_C(1) << 60, NULL);
}
```

## src/math_util.c
```c
/* Copyright 2022 The ChromiumOS Authors
 * Use of this source code is governed by a BSD-style license that can be
 * found in the LICENSE file.
 */

#include "builtin/stdio.h"
#include "common.h"
#include "math.h"
#include "math_util.h"

#include <zephyr/ztest.h>

ZTEST_USER(math, test_arc_cos_x_below_range)
{
	fp_t result = arc_cos(FLOAT_TO_FP(-1.1));

	zassert_within(result, FLOAT_TO_FP(180.0), FLOAT_TO_FP(1.0),
		       "arc_cos(-1.1) was %d", FP_TO_INT(result));
}

ZTEST_USER(math, test_arc_cos_x_above_range)
{
	fp_t result = arc_cos(FLOAT_TO_FP(1.1));

	zassert_within(result, FLOAT_TO_FP(0), FLOAT_TO_FP(1.0),
		       "arc_cos(1.1) was %d", FP_TO_INT(result));
}

ZTEST_USER(math, test_int_sqrtf)
{
	zassert_equal(int_sqrtf(0), 0);
	zassert_equal(int_sqrtf(15), 3);
	zassert_equal(int_sqrtf(25), 5);
	zassert_equal(int_sqrtf(1111088889), 33333);
	zassert_equal(int_sqrtf(123456789), 11111);
	zassert_equal(int_sqrtf(1000000000000000005), 1000000000);
}

ZTEST_USER(math, test_fp_sqrtf)
{
	zassert_within(fp_sqrtf(FLOAT_TO_FP(15)), FLOAT_TO_FP(3.872983),
		       FLOAT_TO_FP(0.001), NULL);
}

ZTEST_USER(math, test_print_ints)
{
	char buffer[10];

	/* Fixed point. */
	zassert_true(crec_snprintf(buffer, sizeof(buffer), "%.5d", 123) > 0,
		     NULL);
	zassert_equal(0, strcmp(buffer, "0.00123"), "got '%s'", buffer);
	zassert_true(crec_snprintf(buffer, sizeof(buffer), "%2.1d", 123) > 0,
		     NULL);
	zassert_equal(0, strcmp(buffer, "12.3"), "got '%s'", buffer);

	/* Precision or width larger than buffer should fail. */
	zassert_equal(-EC_ERROR_OVERFLOW, crec_snprintf(buffer, 4, "%5d", 123),
		      NULL);
	zassert_equal(0, strcmp(buffer, "  1"), "got '%s'", buffer);
	zassert_equal(-EC_ERROR_OVERFLOW, crec_snprintf(buffer, 4, "%10d", 123),
		      NULL);
	zassert_equal(0, strcmp(buffer, "   "), "got '%s'", buffer);
	zassert_equal(-EC_ERROR_OVERFLOW,
		      crec_snprintf(buffer, 4, "%-10d", 123), NULL);
	zassert_equal(0, strcmp(buffer, "123"), "got '%s'", buffer);
	zassert_equal(-EC_ERROR_OVERFLOW,
		      crec_snprintf(buffer, 4, "%.10d", 123), NULL);
	zassert_equal(0, strcmp(buffer, "0.0"), "got '%s'", buffer);
}
```

## src/suite.c
```c
/* Copyright 2022 The ChromiumOS Authors. All rights reserved.
 * Use of this source code is governed by a BSD-style license that can be
 * found in the LICENSE file.
 */

#include <ztest.h>

ZTEST_SUITE(math, NULL, NULL, NULL, NULL, NULL);
```

## src/vector.c
```c
/* Copyright 2022 The ChromiumOS Authors
 * Use of this source code is governed by a BSD-style license that can be
 * found in the LICENSE file.
 */

#include "math.h"
#include "math_util.h"

#include <zephyr/ztest.h>

ZTEST_USER(math, test_cosine_of_angle_diff_zero_magnitude_vector)
{
	intv3_t v0 = { 0, 0, 0 };
	intv3_t v1 = { 1, 1, 1 };

	zassert_equal(cosine_of_angle_diff(v0, v1), 0);
	zassert_equal(cosine_of_angle_diff(v1, v0), 0);
}

ZTEST_USER(math, test_rotate_inv_null_matrix)
{
	intv3_t v = { 1, 2, 3 };
	intv3_t r = { 4, 5, 6 };

	rotate_inv(v, NULL, r);
	zassert_equal(v[0], r[0]);
	zassert_equal(v[1], r[1]);
	zassert_equal(v[2], r[2]);
}
```
