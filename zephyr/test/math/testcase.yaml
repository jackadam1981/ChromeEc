## zephyr/test/math/testcase.yaml
```yaml
tests:
  util.math.fixed_point:
    type: unit
  util.math.floating_point:
    type: unit
    extra_args: -DCONFIG_FPU=1
```

## zephyr/test/motion_sense/testcase.yaml
```yaml
# Copyright 2024 The ChromiumOS Authors
# Use of this source code is governed by a BSD-style license that can be
# found in the LICENSE file.

tests:
  motion_sense.brox:
    harness: gtest
    timeout: 10
    platform_allow:
      - native_sim
    extra_dtc_overlay_files:
      - boards/native_sim.overlay
      - boards/brox.overlay
    extra_configs:
      - CONFIG_PLATFORM_EC_ACCEL_FORCE_MODE_THRESHOLD_RATE_MS=50
      - CONFIG_PLATFORM_EC_LID_SWITCH=y
  motion_sense.rex:
    harness: gtest
    timeout: 10
    platform_allow:
      - native_sim
    extra_dtc_overlay_files:
      - boards/native_sim.overlay
      - boards/rex.overlay
    extra_configs:
      - CONFIG_PLATFORM_EC_ACCEL_FORCE_MODE_THRESHOLD_RATE_MS=50
      - CONFIG_EMUL_COMMON_I2C=y
```

## zephyr/test/myst/Kconfig
```kconfig
# Copyright 2023 The ChromiumOS Authors
# Use of this source code is governed by a BSD-style license that can be
# found in the LICENSE file.

choice TEST_BOARD_VARIANT
	prompt "Select board variant for tests"
	help
	  Board variant to use for tests

	config TEST_BOARD_BASEBOARD
		bool "Enable baseboard-specific tests"
		help
		Enable baseboard tests.

	config TEST_BOARD_MYST
		bool "Enable myst-specific tests"
		help
		Enable tests for myst variant.

endchoice # TEST_BOARD_VARIANT

config TEST_BOARD_NAME
	string "Board name"
	default "baseboard" if TEST_BOARD_BASEBOARD
	default "myst" if TEST_BOARD_MYST

config TEST_BOARD_ALT_CHARGER
	bool "Enable alt charger specific tests"

config TEST_BOARD_ALT_CHARGER_CUSTOM
	bool "ENable alt charger tests with a variant-specific test file"
	select TEST_BOARD_ALT_CHARGER

config TEST_BOARD_FAN
	bool "Enable fan tests"

config TEST_BOARD_FAN_CUSTOM
	bool "Enable fan tests with a variant-specific test file"
	select TEST_BOARD_FAN

config TEST_BOARD_FORM_FACTOR
	select PLATFORM_EC_DYNAMIC_MOTION_SENSOR_COUNT
	select PLATFORM_EC_GMR_TABLET_MODE
	select PLATFORM_EC_TABLET_MODE
	bool "Run the tests intended for form factor testing"
	help
	  Include tests which checks accelerometer
	  interrupt and tablet mode.

config TEST_BOARD_USB_PD_POLICY
	bool "Enable USB PD policy specific tests"
	select TEST_ENABLE_USB_PD_HOST_CMD

config TEST_BOARD_POWER_SIGNALS
	bool "Enable power signals tests"
	select AP_POWER_CONTROL
	select BOARD_USB_HUB_RESET

config TEST_BOARD_PPC_CONFIG
	bool "Enable PPC config tests"

config TEST_BOARD_PPC_CONFIG_CUSTOM
	bool "ENable PPC config tests with a variant-specific test file"
	select TEST_BOARD_PPC_CONFIG

config TEST_BOARD_USB_MUX_CONFIG
	bool "Enable USB mux config tests"
	select AP_POWER_CONTROL
	select PLATFORM_EC_USB_MUX_MOCK
	select PLATFORM_EC_USBC_RETIMER_PS8811
	select PLATFORM_EC_USB_MUX_RUNTIME_CONFIG

config TEST_BOARD_USB_MUX_CONFIG_CUSTOM
	bool "Enable USB mux config tests with a variant-specific test file"
	select TEST_BOARD_USB_MUX_CONFIG

config MYST_LOG_LEVEL
	int "Fake config to allow building"
	default 4 # Log level debug by default

config AP_POWER_CONTROL
	bool "Fake config to enable this feature"

config TEST_ENABLE_USB_PD_HOST_CMD
	bool "Fake config to enable this feature"

config USB_PD_DISCHARGE
	bool "Fake config to enable this feature"

config PLATFORM_EC_USB_MUX_RUNTIME_CONFIG
	bool "Fake config to enable this feature"

config BOARD_USB_HUB_RESET
	bool "Fake config to enable this feature"

source "Kconfig.zephyr"
```

## zephyr/test/myst/testcase.yaml
```yaml
# Copyright 2023 The ChromiumOS Authors
# Use of this source code is governed by a BSD-style license that can be
# found in the LICENSE file.

common:
  platform_allow: native_posix
tests:
  # Baseboard tests TEST_BOARD_POWER_SIGNALS
  myst.baseboard:
    extra_configs:
    - CONFIG_TEST_BOARD_BASEBOARD=y

  myst.baseboard.power_signals:
    extra_configs:
    - CONFIG_TEST_BOARD_BASEBOARD=y
    - CONFIG_TEST_BOARD_POWER_SIGNALS=y
    - CONFIG_PLATFORM_EC_AMD_STB_DUMP=y
    - CONFIG_PLATFORM_EC_THROTTLE_AP=y
    - CONFIG_PLATFORM_EC_THROTTLE_AP_NO_FAN=y
    - CONFIG_PLATFORM_EC_THROTTLE_AP_SINGLE_PIN=y

  myst.baseboard.usb_pd_policy:
    extra_configs:
    - CONFIG_TEST_BOARD_BASEBOARD=y
    - CONFIG_TEST_BOARD_USB_PD_POLICY=y

  myst.baseboard.usb_pd_policy.discharge:
    extra_configs:
    - CONFIG_TEST_BOARD_BASEBOARD=y
    - CONFIG_TEST_BOARD_USB_PD_POLICY=y
    - CONFIG_USB_PD_DISCHARGE=y

  # myst tests
  myst.myst:
    extra_configs:
    - CONFIG_TEST_BOARD_MYST=y

  myst.myst.alt_charger:
    extra_configs:
    - CONFIG_TEST_BOARD_MYST=y
    - CONFIG_TEST_BOARD_ALT_CHARGER=y

  myst.myst.fan:
    extra_configs:
    - CONFIG_TEST_BOARD_MYST=y
    - CONFIG_TEST_BOARD_FAN=y

  myst.myst.form_factor:
    extra_configs:
    - CONFIG_TEST_BOARD_MYST=y
    - CONFIG_TEST_BOARD_FORM_FACTOR=y
    extra_dtc_overlay_files:
    - ./boards/myst/myst.dtsi

  myst.myst.ppc_config:
    extra_configs:
    - CONFIG_TEST_BOARD_MYST=y
    - CONFIG_TEST_BOARD_PPC_CONFIG=y

  myst.myst.usb_mux_config:
    extra_configs:
    - CONFIG_TEST_BOARD_MYST=y
    - CONFIG_TEST_BOARD_USB_MUX_CONFIG_CUSTOM=y
```

## zephyr/test/qcom_power/testcase.yaml
```yaml
common:
  platform_allow: native_posix
tests:
  qcom_power.default: {}
  qcom_power.power_button_v2:
    extra_configs:
      - CONFIG_PLATFORM_EC_POWER_BUTTON_V2=y
```

## zephyr/test/roach/testcase.yaml
```yaml
common:
  platform_allow: native_posix
tests:
  roach.axii:
    extra_configs:
    - CONFIG_TEST_AXII=y
    - CONFIG_PLATFORM_EC_ONE_WIRE_UART_KEYBOARD=n
    extra_dtc_overlay_files:
    - axii.default.overlay
```

## zephyr/test/skyrim/Kconfig
```kconfig
# Copyright 2023 The ChromiumOS Authors
# Use of this source code is governed by a BSD-style license that can be
# found in the LICENSE file.

# Baseboard tests
config TEST_BOARD_BASEBOARD
	bool "Enable baseboard-specific tests"
	default n
	help
	  Enable baseboard tests.

config TEST_BOARD_CRYSTALDRIFT
	bool "Enable crystaldrift-specific tests"
	help
	  Enable tests for crystaldrift variant.

config TEST_BOARD_FROSTFLOW
	bool "Enable frostflow-specific tests"
	help
	  Enable tests for frostflow variant.

config TEST_BOARD_MARKARTH
	bool "Enable markarth-specific tests"
	help
	  Enable tests for markarth variant.

config TEST_BOARD_MORTHAL
	bool "Enable morthal-specific tests"
	help
	  Enable tests for morthal variant.

config TEST_BOARD_SKYRIM
	bool "Enable skyrim-specific tests"
	help
	  Enable tests for skyrim variant.

config TEST_BOARD_WINTERHOLD
	bool "Enable winterhold-specific tests"
	help
	  Enable tests for winterhold variant.

config TEST_BOARD_NAME
	string "Board name"
	default "baseboard" if TEST_BOARD_BASEBOARD
	default "crystaldrift" if TEST_BOARD_CRYSTALDRIFT
	default "frostflow" if TEST_BOARD_FROSTFLOW
	default "markarth" if TEST_BOARD_MARKARTH
	default "morthal" if TEST_BOARD_MORTHAL
	default "skyrim" if TEST_BOARD_SKYRIM
	default "frostflow" if TEST_BOARD_WINTERHOLD

if TEST_BOARD_BASEBOARD

config TEST_BOARD_USB_PD_POLICY
	bool "Enable USB PD policy specific tests"
	select TEST_ENABLE_USB_PD_HOST_CMD
	default n

endif # TEST_BOARD_BASEBOARD

config TEST_ENABLE_USB_PD_HOST_CMD
	bool "Fake config to enable this feature"
	default n

config USB_PD_DISCHARGE
	bool "Fake config to enable this feature"
	default n

source "Kconfig.zephyr"
```

## zephyr/test/skyrim/testcase.yaml
```yaml
# Copyright 2023 The ChromiumOS Authors
# Use of this source code is governed by a BSD-style license that can be
# found in the LICENSE file.

common:
  platform_allow: native_posix
tests:
  # Baseboard tests
  skyrim.baseboard:
    extra_configs:
    - CONFIG_TEST_BOARD_BASEBOARD=y

  skyrim.baseboard.usb_pd_policy:
    extra_configs:
    - CONFIG_TEST_BOARD_BASEBOARD=y
    - CONFIG_TEST_BOARD_USB_PD_POLICY=y

  skyrim.baseboard.usb_pd_policy.discharge:
    extra_configs:
    - CONFIG_TEST_BOARD_BASEBOARD=y
    - CONFIG_TEST_BOARD_USB_PD_POLICY=y
    - CONFIG_USB_PD_DISCHARGE=y

  # Crystaldrift tests
  skyrim.crystaldrift:
    extra_configs:
    - CONFIG_TEST_BOARD_CRYSTALDRIFT=y

  skyrim.crystaldrift.alt_charger:
    extra_configs:
    - CONFIG_TEST_BOARD_CRYSTALDRIFT=y
    - CONFIG_TEST_BOARD_ALT_CHARGER=y

  skyrim.crystaldrift.fan:
    extra_configs:
    - CONFIG_TEST_BOARD_CRYSTALDRIFT=y
    - CONFIG_TEST_BOARD_FAN=y

  skyrim.crystaldrift.ppc_config:
    extra_configs:
    - CONFIG_TEST_BOARD_CRYSTALDRIFT=y
    - CONFIG_TEST_BOARD_PPC_CONFIG=y

  # Frostflow tests
  skyrim.frostflow:
    extra_configs:
    - CONFIG_TEST_BOARD_FROSTFLOW=y

  skyrim.frostflow.ppc_config:
    extra_configs:
    - CONFIG_TEST_BOARD_FROSTFLOW=y
    - CONFIG_TEST_BOARD_PPC_CONFIG=y

  # skyrim.frostflow.usb_mux_config:
  #   extra_configs:
  #   - CONFIG_TEST_BOARD_FROSTFLOW=y
  #   - CONFIG_TEST_BOARD_USB_MUX_CONFIG=y
  #   - CONFIG_TEST_BOARD_USB_MUX_CONFIG_SRC="frostflow/usb_mux_config.c"

  # Markarth tests
  skyrim.markarth:
    extra_configs:
    - CONFIG_TEST_BOARD_MARKARTH=y

  skyrim.markarth.fan:
    extra_configs:
    - CONFIG_TEST_BOARD_MARKARTH=y
    - CONFIG_TEST_BOARD_FAN=y

  skyrim.markarth.ppc_config:
    extra_configs:
    - CONFIG_TEST_BOARD_MARKARTH=y
    - CONFIG_TEST_BOARD_PPC_CONFIG=y

  # Skyrim tests
  skyrim.skyrim:
    extra_configs:
    - CONFIG_TEST_BOARD_SKYRIM=y

  skyrim.skyrim.alt_charger:
    extra_configs:
    - CONFIG_TEST_BOARD_SKYRIM=y
    - CONFIG_TEST_BOARD_ALT_CHARGER=y

  skyrim.skyrim.fan:
    extra_configs:
    - CONFIG_TEST_BOARD_SKYRIM=y
    - CONFIG_TEST_BOARD_FAN=y

  skyrim.skyrim.ppc_config:
    extra_configs:
    - CONFIG_TEST_BOARD_SKYRIM=y
    - CONFIG_TEST_BOARD_PPC_CONFIG=y

  skyrim.skyrim.clamshell:
    extra_args:
      DTC_OVERLAY_FILE="./boards/skyrim/skyrim.dtsi;"
    extra_configs:
    - CONFIG_PLATFORM_EC_BOARD_VERSION_CBI=y
    - CONFIG_PLATFORM_EC_DYNAMIC_MOTION_SENSOR_COUNT=y
    - CONFIG_PLATFORM_EC_GMR_TABLET_MODE=y
    - CONFIG_PLATFORM_EC_TABLET_MODE=y
    - CONFIG_TEST_BOARD_SKYRIM=y
    - CONFIG_TEST_BOARD_FF_CLAMSHELL=y
    - CONFIG_TEST_BOARD_FF_CLAMSHELL_SRC="skyrim/clamshell.c"

  skyrim.skyrim.convertible:
    extra_args:
      DTC_OVERLAY_FILE="./boards/skyrim/skyrim.dtsi;"
    extra_configs:
    - CONFIG_PLATFORM_EC_BOARD_VERSION_CBI=y
    - CONFIG_PLATFORM_EC_DYNAMIC_MOTION_SENSOR_COUNT=y
    - CONFIG_PLATFORM_EC_GMR_TABLET_MODE=y
    - CONFIG_PLATFORM_EC_TABLET_MODE=y
    - CONFIG_TEST_BOARD_SKYRIM=y
    - CONFIG_TEST_BOARD_FF_CONVERTIBLE=y
    - CONFIG_TEST_BOARD_FF_CONVERTIBLE_SRC="skyrim/convertible.c"

  # Winterhold tests
  skyrim.winterhold:
    extra_configs:
    - CONFIG_TEST_BOARD_WINTERHOLD=y

  skyrim.winterhold.ppc_config:
    extra_configs:
    - CONFIG_TEST_BOARD_WINTERHOLD=y
    - CONFIG_TEST_BOARD_PPC_CONFIG=y
    - CONFIG_TEST_BOARD_PPC_CONFIG_SRC="winterhold/ppc_config.c"
```

## zephyr/test/starmie/testcase.yaml
```yaml
common:
  platform_allow: native_posix
tests:
  starmie.default:
    extra_dtc_overlay_files:
    - starmie.overlay
```

## zephyr/test/state_cache/testcase.yaml
```yaml
common:
  platform_allow: native_posix
tests:
  state_cache.default:
    tags:
      common
      system
```

## zephyr/test/system_shim/testcase.yaml
```yaml
common:
  platform_allow: native_sim
  tags:
    system
tests:
  system_shim.default:
    extra_dtc_overlay_files:
    - ./default.overlay
  system_shim.ish:
    extra_configs:
    - CONFIG_SYSTEM_SHIM_TEST_ISH=y
  system_shim.powerbtn:
    extra_configs:
    - CONFIG_POWER_BUTTON_INIT_IDLE=y
```

## zephyr/test/usb_pd_flags/testcase.yaml
```yaml
common:
  platform_allow: native_posix
tests:
  usb_pd_flags.default: {}
  usb_pd_flags.runtime_flags:
    extra_configs:
      - CONFIG_PLATFORM_EC_USB_PD_RUNTIME_FLAGS=y
```

## zephyr/test_lib/Kconfig
```kconfig
# Copyright 2024 The ChromiumOS Authors
# Use of this source code is governed by a BSD-style license that can be
# found in the LICENSE file.

config PLATFORM_EC_GTEST_LIB
  bool
  default y
  depends on TEST
  depends on CPP
  depends on REQUIRES_FULL_LIBCPP
  depends on STD_CPP20
  depends on PIGWEED_ASSERT
  depends on LOG
  depends on LOG_MODE_MINIMAL
  depends on PIGWEED_LOG_ZEPHYR
  depends on PIGWEED_SYS_IO

config PLATFORM_EC_GTEST_MAIN
  bool "Include a default test_main which runs gTest"
  default y
  depends on !ZTEST
  depends on TEST
  depends on PLATFORM_EC_GTEST_LIB

config MOTION_SENSE_TESTS
  bool "Include tests which verify behavior of motion_sense"
  default y
  depends on PLATFORM_EC_MOTIONSENSE
  depends on TEST
  depends on PLATFORM_EC_GTEST_LIB
  depends on PLATFORM_EC_ACCEL_FIFO
```
