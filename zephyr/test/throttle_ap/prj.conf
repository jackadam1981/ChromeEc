## prj.conf
```kconfig
# Copyright 2022 The ChromiumOS Authors
# Use of this source code is governed by a BSD-style license that can be
# found in the LICENSE file.

CONFIG_ZTEST=y
CONFIG_ZTEST_ASSERT_VERBOSE=1
CONFIG_ZTEST_MOCKING=y
CONFIG_ZTEST_PARAMETER_COUNT=24
CONFIG_TEST=y
CONFIG_ASSERT=y

# Print logs from Zephyr LOG_MODULE to stdout
CONFIG_NATIVE_UART_0_ON_STDINOUT=y

# Simulate 10 ticks per ms
CONFIG_SYS_CLOCK_TICKS_PER_SEC=10000
CONFIG_TASKS_SET_TEST_RUNNER_TID_RULE=y

# Enable exception stack traces for better errors
CONFIG_EXCEPTION_STACK_TRACE=y

# Enable debugging features
CONFIG_DEBUG=y
CONFIG_X86_DEBUG_INFO=y
CONFIG_DEBUG_OPTIMIZATIONS=y
CONFIG_PLATFORM_EC_CONSOLE_DEBUG=y
CONFIG_SHELL_BACKEND_DUMMY=y
CONFIG_SHELL_BACKEND_SERIAL=n
# We aren't using the serial console, but there is still a lot of code that
# assumes that a serial port exists.
CONFIG_SERIAL=y

CONFIG_PLATFORM_EC=y
CONFIG_CROS_EC=y
CONFIG_SHIMMED_TASKS=y
CONFIG_EMUL=y
CONFIG_GPIO=y
CONFIG_HEAP_MEM_POOL_SIZE=1024

CONFIG_PLATFORM_EC_THROTTLE_AP=y
CONFIG_PLATFORM_EC_THROTTLE_AP_SINGLE_PIN=y
CONFIG_PLATFORM_EC_CONSOLE_CMD_APTHROTTLE=n
```

## include/common.h
```c
/* Copyright 2022 The ChromiumOS Authors
 * Use of this source code is governed by a BSD-style license that can be
 * found in the LICENSE file.
 */
bool test_chipset_is_throttled(void);
```

## src/common.c
```c
/* Copyright 2022 The ChromiumOS Authors
 * Use of this source code is governed by a BSD-style license that can be
 * found in the LICENSE file.
 */
#include <chipset.h>
#include <console.h>
#include <throttle_ap.h>

#include <zephyr/ztest.h>

ZTEST_SUITE(throttle_ap, NULL, NULL, NULL, NULL, NULL);

/*
 * The prochot interrupt handler will return early if the chipset is
 * off or suspended.
 */
int chipset_in_state(int state_mask)
{
	return state_mask & CHIPSET_STATE_ON;
}

void chipset_force_shutdown(enum chipset_shutdown_reason reason)
{
}

int extpower_is_present(void)
{
	return 1;
}
```

## src/interrupt.c
```c
/* Copyright 2022 The ChromiumOS Authors
 * Use of this source code is governed by a BSD-style license that can be
 * found in the LICENSE file.
 */
#include <gpio.h>
#include <throttle_ap.h>
#include <timer.h>

#include <stdint.h>

#include <zephyr/drivers/gpio.h>
#include <zephyr/drivers/gpio/gpio_emul.h>
#include <zephyr/kernel.h>
#include <zephyr/ztest.h>

#define PROCHOT_ASSERTED \
	!IS_ENABLED(PLATFORM_EC_POWERSEQ_CPU_PROCHOT_ACTIVE_LOW)

/* Waits for the debouncing logic to finish. */
static void debounce_wait(void)
{
	k_usleep(PROCHOT_IN_DEBOUNCE_US);
	k_msleep(1);
}

static bool was_asserted;
static void callback(bool asserted, void *data)
{
	was_asserted = asserted;
}

const struct prochot_cfg cfg = {
	.gpio_prochot_in = GPIO_CPU_PROCHOT,
	.callback = &callback,

};

ZTEST_USER(throttle_ap, test_interrupts)
{
	const struct device *dev =
		DEVICE_DT_GET(DT_GPIO_CTLR(DT_ALIAS(gpio_prochot_l), gpios));
	const gpio_port_pins_t pin =
		DT_GPIO_PIN(DT_ALIAS(gpio_prochot_l), gpios);

	/* Start the test with the interrupt deasserted. */
	zassert_ok(gpio_emul_input_set(dev, pin, !PROCHOT_ASSERTED));

	throttle_ap_config_prochot(&cfg);
	gpio_enable_interrupt(cfg.gpio_prochot_in);

	zassert_ok(gpio_emul_input_set(dev, pin, PROCHOT_ASSERTED));
	debounce_wait();
	zassert_true(was_asserted);

	zassert_ok(gpio_emul_input_set(dev, pin, !PROCHOT_ASSERTED));
	debounce_wait();
	zassert_false(was_asserted);
}
```

## src/throttle_ap.c
```c
/* Copyright 2022 The ChromiumOS Authors
 * Use of this source code is governed by a BSD-style license that can be
 * found in the LICENSE file.
 */
#include <chipset.h>
#include <gpio.h>
#include <throttle_ap.h>

#include "common.h"
#include <console.h>

#include <zephyr/ztest.h>

static bool is_throttled;
void chipset_throttle_cpu(int throttle)
{
	is_throttled = throttle;
}

ZTEST_USER(throttle_ap, test_throttle_ap)
{
	throttle_ap(THROTTLE_ON, THROTTLE_HARD, THROTTLE_SRC_AC);
	zassert_true(is_throttled);

	throttle_ap(THROTTLE_OFF, THROTTLE_HARD, THROTTLE_SRC_AC);
	zassert_false(is_throttled);
}
```
