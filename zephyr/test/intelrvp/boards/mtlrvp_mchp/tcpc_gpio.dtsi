/* Copyright 2024 The Chromium OS Authors. All rights reserved.
 * Use of this source code is governed by a BSD-style license that can be
 * found in the LICENSE file.
 */

#include <dt-bindings/gpio_defines.h>
#include <mchp_emul.dts>
#include "board.h"
#include "../mtlrvp/tcpc_gpio.dtsi"