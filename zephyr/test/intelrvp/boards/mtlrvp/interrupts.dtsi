/* Copyright 2024 The ChromiumOS Authors
 * Use of this source code is governed by a BSD-style license that can be
 * found in the LICENSE file.
 */
/ {
	gpio-interrupts {
		compatible = "cros-ec,gpio-interrupts";

		int_dc_jack_present: dc_jack_present {
			irq-pin = <&std_adp_prsnt>;
			flags = <GPIO_INT_EDGE_BOTH>;
			handler = "board_dc_jack_interrupt";
		};
	};
};
