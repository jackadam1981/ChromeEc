/* Copyright 2024 The ChromiumOS Authors
 * Use of this source code is governed by a BSD-style license that can be
 * found in the LICENSE file.
 */

#include <npcx_emul.dts>
#include "board.h"
#include "../mtlrvp/i2c_charger.dtsi"
