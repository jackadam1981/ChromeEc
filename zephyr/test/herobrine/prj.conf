## CMakeLists.txt
```
# Copyright 2022 The ChromiumOS Authors
# Use of this source code is governed by a BSD-style license that can be
# found in the LICENSE file.

cmake_minimum_required(VERSION 3.13.1)
find_package(Zephyr REQUIRED HINTS "${ZEPHYR_BASE}")
project(herobrine)

zephyr_include_directories("${PLATFORM_EC_PROGRAM_DIR}/herobrine/include")
zephyr_include_directories("${PLATFORM_EC}/zephyr/program/herobrine/evoker/src")

target_sources_ifdef(CONFIG_TEST_BOARD_CHIPSET
	app PRIVATE src/board_chipset.c)
target_sources_ifdef(CONFIG_TEST_BOARD_CHIPSET
	app PRIVATE ${PLATFORM_EC_PROGRAM_DIR}/herobrine/src/board_chipset.c)
target_sources_ifdef(CONFIG_TEST_EVOKER_CHARGER_OVERRIDE
	app PRIVATE src/board_charger_override.c)
target_sources_ifdef(CONFIG_TEST_EVOKER_CHARGER_OVERRIDE
	app PRIVATE ${PLATFORM_EC}/zephyr/program/herobrine/evoker/src/charger_override.c)
```

## Kconfig
```
# Copyright 2022 The ChromiumOS Authors
# Use of this source code is governed by a BSD-style license that can be
# found in the LICENSE file.

config TEST_BOARD_CHIPSET
	bool "Run the tests intended for board_chipset"
	help
	  Include board_chipset.c into the binary. Test their functions in
	  different combinations: good battery vs low battery, normal boot
	  vs delayed boot, etc.

config TEST_EVOKER_CHARGER_OVERRIDE
	bool "Run the tests intended for board_charger_override of evoker"
	help
	  Check the evoker board_charger_profile_override function can
	  override battery requested_current.

source "Kconfig.zephyr"
```

## prj.conf
```kconfig
# Copyright 2022 The ChromiumOS Authors
# Use of this source code is governed by a BSD-style license that can be
# found in the LICENSE file.

CONFIG_ZTEST=y
CONFIG_ZTEST_ASSERT_VERBOSE=1
CONFIG_ZTEST_NEW_API=y
CONFIG_ASSERT=y

CONFIG_CROS_EC=y
CONFIG_PLATFORM_EC=y
CONFIG_PLATFORM_EC_CBI=n
```

## boards/native_posix.overlay
```dts
/* Copyright 2022 The ChromiumOS Authors.
 * Use of this source code is governed by a BSD-style license that can be
 * found in the LICENSE file.
 */

#include <board-overlays/native_posix.dts>

/ {
        /*
         * Keep these GPIOs in pin order.
         * If you need to add one, make sure you increase
         * ngpios in the gpio0 node further down.
         */
        named-gpios {
                compatible = "named-gpios";

                gpio_en_pp5000_s5: en_pp5000_s5 {
                        gpios = <&gpio0 2 GPIO_OUTPUT_LOW>;
                        enum-name = "GPIO_EN_PP5000";
                };
	};
};

&gpio0 {
        ngpios = <3>;
};
```

## src/board_charger_override.c
```c
/* Copyright 2022 The ChromiumOS Authors
 * Use of this source code is governed by a BSD-style license that can be
 * found in the LICENSE file.
 */

#include "charge_state.h"
#include "charger_override.h"

#include <zephyr/drivers/adc.h>
#include <zephyr/drivers/adc/adc_emul.h>
#include <zephyr/kernel.h>
#include <zephyr/ztest.h>

#define ADC_DEVICE_NODE DT_NODELABEL(adc0)
#define CHARGER_TEMP TEMP_SENSOR_ID(DT_NODELABEL(temp_charger))

#define CURRENT_ORIGINAL 5000
#define CURRENT_LIMIT 2000

struct charge_state_data curr;

int setup_faketemp(int voltage)
{
	const struct device *adc_dev = DEVICE_DT_GET(ADC_DEVICE_NODE);
	const uint8_t channel_id =
		DT_IO_CHANNELS_INPUT(DT_NODELABEL(adc_temp_sensor_1));
	int emul_temp;

	emul_temp = adc_emul_const_value_set(adc_dev, channel_id, voltage);
	return emul_temp;
}

/**
 * fake_voltage:
 * 1580 mV = 298K (= 25 C) -> normal charge
 *  690 mV = 328K (= 55 C) -> normal charge
 *  667 mV = 329K (= 56 C) -> current limit
 *  760 mV = 324K (= 51 C) -> current limit
 *  789 mV = 323K (= 50 C) -> normal charge
 */
const int fake_voltage[] = { 1580, 690, 667, 760, 789 };
const int aim_curr[] = { CURRENT_ORIGINAL, CURRENT_ORIGINAL, CURRENT_LIMIT,
			 CURRENT_LIMIT, CURRENT_ORIGINAL };

ZTEST_USER(board_charger_override, test_board_charger_profile_override)
{
	int i, rv;

	curr.batt.flags |= BATT_FLAG_RESPONSIVE;
	curr.state = ST_CHARGE;

	for (i = 0; i < ARRAY_SIZE(fake_voltage); i++) {
		curr.requested_current = CURRENT_ORIGINAL;
		setup_faketemp(fake_voltage[i]);
		rv = board_charger_profile_override(&curr);
		zassert_equal(EC_SUCCESS, rv,
			      "function did not return success");
		printk(" aim: %d, curr.requested_current: %d\n", aim_curr[i],
		       curr.requested_current);
		zassert_equal(aim_curr[i], curr.requested_current,
			      "requested_current not expected");
	}
}

ZTEST_SUITE(board_charger_override, NULL, NULL, NULL, NULL, NULL);
```

## src/board_chipset.c
```c
/* Copyright 2022 The ChromiumOS Authors
 * Use of this source code is governed by a BSD-style license that can be
 * found in the LICENSE file.
 */
#include "battery.h"
#include "battery_fuel_gauge.h"
#include "board_chipset.h"
#include "hooks.h"
#include "usb_pd.h"
#include "usbc_ppc.h"

#include <zephyr/kernel.h>
#include <zephyr/ztest.h>

extern int test_disconnect_state;
static int battery_soc_abs_value = 50;

int battery_state_of_charge_abs(int *percent)
{
	*percent = battery_soc_abs_value;
	return EC_SUCCESS;
}

int charger_get_min_bat_pct_for_power_on(void)
{
	return 2;
}

int test_disconnect_state = -1;

enum battery_disconnect_state battery_get_disconnect_state(void)
{
	return test_disconnect_state;
}

ZTEST_USER(board_chipset, test_good_battery_normal_boot)
{
	timestamp_t start_time;
	uint64_t time_diff_us;

	battery_soc_abs_value = 50;

	start_time = get_time();
	hook_notify(HOOK_CHIPSET_PRE_INIT);
	time_diff_us = get_time().val - start_time.val;

	printk("%s: time_diff_us: %d\n", __func__, time_diff_us);

	zassert_true(time_diff_us <= 20000, "CHIPSET_PRE_INIT hook delayed",
		     NULL);
}

ZTEST_USER(board_chipset, test_low_battery_normal_boot)
{
	timestamp_t start_time;
	uint64_t time_diff_us;

	battery_soc_abs_value = 1;

	start_time = get_time();
	hook_notify(HOOK_CHIPSET_PRE_INIT);
	time_diff_us = get_time().val - start_time.val;

	printk("%s: time_diff_us: %d\n", __func__, time_diff_us);

	zassert_true(time_diff_us <= 20000, "CHIPSET_PRE_INIT hook delayed",
		     NULL);
}

ZTEST_USER(board_chipset, test_low_battery_delayed_boot)
{
	timestamp_t start_time;
	uint64_t time_diff_us;

	battery_soc_abs_value = 1;
	/* The PD connect event delays the power on sequence */
	hook_notify(HOOK_USB_PD_CONNECT);

	start_time = get_time();
	hook_notify(HOOK_CHIPSET_PRE_INIT);
	time_diff_us = get_time().val - start_time.val;

	printk("%s: time_diff_us: %d\n", __func__, time_diff_us);

	zassert_true(time_diff_us > 500000, "CHIPSET_PRE_INIT hook not delayed",
		     NULL);
}

ZTEST_USER(board_chipset, test_disconnect_battery_delayed_boot)
{
	timestamp_t start_time;
	uint64_t time_diff_us;

	battery_soc_abs_value = 50;
	test_disconnect_state = BATTERY_DISCONNECTED;

	start_time = get_time();
	hook_notify(HOOK_CHIPSET_PRE_INIT);
	time_diff_us = get_time().val - start_time.val;

	printk("%s: time_diff_us: %d\n", __func__, time_diff_us);

	zassert_true(time_diff_us > 500000, "CHIPSET_PRE_INIT hook delayed",
		     NULL);
}

static void test_before(void *data)
{
	ARG_UNUSED(data);
	reset_pp5000_inited();
	test_disconnect_state = BATTERY_NOT_DISCONNECTED;
}

ZTEST_SUITE(board_chipset, NULL, NULL, test_before, NULL, NULL);
```
