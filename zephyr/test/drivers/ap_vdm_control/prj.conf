## CMakeLists.txt
```
# Copyright 2022 The ChromiumOS Authors
# Use of this source code is governed by a BSD-style license that can be
# found in the LICENSE file.

# Create library name based on current directory
zephyr_library_get_current_dir_lib_name(${ZEPHYR_BASE} lib_name)

# Create interface library
zephyr_interface_library_named(${lib_name})

# Add include paths
zephyr_include_directories("${CMAKE_CURRENT_SOURCE_DIR}")
zephyr_include_directories("${CMAKE_CURRENT_SOURCE_DIR}/include")

# Add source files
zephyr_library_sources("${CMAKE_CURRENT_SOURCE_DIR}/src/ap_vdm_control.c")

# Link in the library
zephyr_library_link_libraries(${lib_name})
```

## prj.conf
```kconfig
# Copyright 2022 The ChromiumOS Authors
# Use of this source code is governed by a BSD-style license that can be
# found in the LICENSE file.

CONFIG_PLATFORM_EC_USB_MUX_AP_CONTROL=y
CONFIG_PLATFORM_EC_USB_MUX_TASK=y
CONFIG_SHIMMED_TASKS=y
CONFIG_PLATFORM_EC_USB_PD_VDM_AP_CONTROL=y

CONFIG_PLATFORM_EC_USB_PD_TBT_COMPAT_MODE=n
CONFIG_PLATFORM_EC_USB_PD_USB4=n
```

## boards/native_posix.overlay
```dts
/* Copyright 2023 The ChromiumOS Authors
 * Use of this source code is governed by a BSD-style license that can be
 * found in the LICENSE file.
 */
#include "../../boards/native_posix.overlay"

/ {
	named-gpios {
		compatible = "named-gpios";

                gpio_usb_c0_hpd: usb_c0_hpd {
                        gpios = <&gpio0 0 GPIO_OUTPUT_LOW>;
                        enum-name = "GPIO_USB_C0_DP_HPD";
                };
	};
};
```

## src/ap_vdm_control_disabled.c
```c
/* Copyright 2023 The ChromiumOS Authors
 * Use of this source code is governed by a BSD-style license that can be
 * found in the LICENSE file.
 */

#include "ec_commands.h"
#include "test/drivers/stubs.h"
#include "test/drivers/test_state.h"
#include "test/drivers/utils.h"
#include "usb_pd_ap_vdm_control.h"

#include <stdint.h>

#include <zephyr/kernel.h>
#include <zephyr/ztest.h>

#define TEST_PORT USBC_PORT_C0

ZTEST_SUITE(ap_vdm_control_disabled, drivers_predicate_post_main, NULL, NULL,
	    NULL, NULL);

ZTEST(ap_vdm_control_disabled, test_feature_absent)
{
	struct ec_response_get_features feat = host_cmd_get_features();

	zassert_false(feat.flags[1] &
		      EC_FEATURE_MASK_1(EC_FEATURE_TYPEC_AP_VDM_SEND));
}

ZTEST(ap_vdm_control_disabled, test_send_vdm_req_fails)
{
	struct ec_params_typec_control params = {
		.port = TEST_PORT,
		.command = TYPEC_CONTROL_COMMAND_SEND_VDM_REQ,
		.vdm_req_params = {
			.vdm_data = { 0 },
			.vdm_data_objects = 1,
			.partner_type = TYPEC_PARTNER_SOP,
		},
	};

	zassert_equal(ec_cmd_typec_control(NULL, &params),
		      EC_RES_INVALID_PARAM);
}

ZTEST(ap_vdm_control_disabled, test_vdm_response_fails)
{
	struct ec_response_typec_vdm_response vdm_resp;
	struct ec_params_typec_vdm_response params = { .port = TEST_PORT };

	zassert_equal(ec_cmd_typec_vdm_response(NULL, &params, &vdm_resp),
		      EC_RES_INVALID_COMMAND);
}

ZTEST(ap_vdm_control_disabled, test_ap_vdm_stub_returns)
{
	uint8_t temp1, temp2;
	uint32_t data[2];

	zassert_equal(ap_vdm_attention_pop(TEST_PORT, data, &temp1), 0);
	zassert_equal(ap_vdm_copy_reply(TEST_PORT, &temp1, &temp2, data),
		      EC_RES_INVALID_COMMAND);
}
```
