## CMakeLists.txt
```
# Copyright 2024 The ChromiumOS Authors
# Use of this source code is governed by a BSD-style license that can be
# found in the LICENSE file.

cmake_minimum_required(VERSION 3.20)
find_package(Zephyr REQUIRED HINTS "${ZEPHYR_BASE}")
project(tabletmode_interrupt)

target_sources(app PRIVATE src/main.c)
```

## prj.conf
```kconfig
# Copyright 2024 The ChromiumOS Authors
# Use of this source code is governed by a BSD-style license that can be
# found in the LICENSE file.

CONFIG_ZTEST=y
CONFIG_PLATFORM_EC=y
CONFIG_PLATFORM_EC_HOOKS=y
CONFIG_CROS_EC=y
CONFIG_PLATFORM_EC_TABLET_MODE=y
```

## boards/native_sim.overlay
```dts
/* Copyright 2024 The ChromiumOS Authors
 * Use of this source code is governed by a BSD-style license that can be
 * found in the LICENSE file.
 */

#include <board-overlays/native_posix.dts>

/{
	tabletmode_interrupt: tabletmode-interrupt {
		compatible = "cros,tabletmode-interrupt";
		/* This test explicitly expects an active high interrupt */
		irq-gpios = <&gpio0 0 GPIO_ACTIVE_HIGH>;
	};
};

&gpio0 {
	ngpios = <1>;
};
```

## src/main.c
```c
/* Copyright 2024 The ChromiumOS Authors
 * Use of this source code is governed by a BSD-style license that can be
 * found in the LICENSE file.
 */

#include "tablet_mode.h"

#include <zephyr/drivers/gpio.h>
#include <zephyr/drivers/gpio/gpio_emul.h>
#include <zephyr/ztest.h>

ZTEST_SUITE(tabletmode_interrupt, NULL, NULL, NULL, NULL, NULL);

ZTEST(tabletmode_interrupt, test_gpio_toggles_tablet_mode)
{
	const struct gpio_dt_spec spec =
		GPIO_DT_SPEC_GET(DT_NODELABEL(tabletmode_interrupt), irq_gpios);

	/* Set pin to low, wait for sys-work queue to process events, then check
	 * tablet mode
	 */
	zassert_ok(gpio_emul_input_set(spec.port, spec.pin, 0));
	k_msleep(1);
	zassert_true(tablet_get_mode() == 0,
		     "Expected not to be in tablet mode");

	/* Set pin to high, wait for sys-work queue to process events, then
	 * check tablet mode
	 */
	zassert_ok(gpio_emul_input_set(spec.port, spec.pin, 1));
	k_msleep(1);
	zassert_true(tablet_get_mode() != 0, "Expected to be in tablet mode");
}
```
