## zephyr/test/charger/Kconfig
```kconfig
# Copyright 2024 The ChromiumOS Authors
# Use of this source code is governed by a BSD-style license that can be
# found in the LICENSE file.

choice TEST_BOARD_VARIANT
	prompt "Select board variant for tests"

	# Brox variants
	config TEST_BOARD_BROX
		bool "Run brox tests"

	# Nissa variants
	config TEST_BOARD_CRAASK
		bool "Run craask tests"
		select TEST_CHARGER_MULTI_DEF

	config TEST_BOARD_CRAASKOV
		bool "Run craaskov tests"
		select TEST_CHARGER_MULTI_DEF

	config TEST_BOARD_GOTHRAX
		bool "Run gothrax tests"
		select TEST_CHARGER_MULTI_DEF

	config TEST_BOARD_NIVVIKS
		bool "Run nivvkis tests"
		select TEST_CHARGER_MULTI_DEF

	config TEST_BOARD_PIRRHA
		bool "Run pirrha tests"
		select TEST_CHARGER_MULTI_DEF

	config TEST_BOARD_PUJJO
		bool "Run pujjo tests"
		select TEST_CHARGER_SOLO_DEF

	config TEST_BOARD_ULDREN
		bool "Run uldren tests"
		select TEST_CHARGER_MULTI_DEF

	config TEST_BOARD_XIVU
		bool "Run xivu tests"
		select TEST_CHARGER_MULTI_DEF

	config TEST_BOARD_XIVUR
		bool "Run xivur tests"
		select TEST_CHARGER_MULTI_DEF
endchoice

choice TEST_PROGRAM
	prompt "Select program for tests"
	default TEST_PROGRAM_BROX if TEST_BOARD_BROX
	default TEST_PROGRAM_NISSA if \
		TEST_BOARD_CRAASK || \
		TEST_BOARD_CRAASKOV || \
		TEST_BOARD_GOTHRAX || \
		TEST_BOARD_NIVVIKS || \
		TEST_BOARD_PIRRHA || \
		TEST_BOARD_PUJJO || \
		TEST_BOARD_ULDREN || \
		TEST_BOARD_XIVU || \
		TEST_BOARD_XIVUR

	config TEST_PROGRAM_BROX
		bool "Brox"

	config TEST_PROGRAM_NISSA
		bool "Nissa"
endchoice # TEST_PROGRAM

config TEST_PROGRAM_NAME
	string "Program name"
	default "brox" if TEST_PROGRAM_BROX
	default "nissa" if TEST_PROGRAM_NISSA

config TEST_BOARD_NAME
	string "Board name"
	default "brox" if TEST_BOARD_BROX
	default "craask" if TEST_BOARD_CRAASK
	default "craaskov" if TEST_BOARD_CRAASKOV
	default "gothrax" if TEST_BOARD_GOTHRAX
	default "nivviks" if TEST_BOARD_NIVVIKS
	default "pirrha" if TEST_BOARD_PIRRHA
	default "pujjo" if TEST_BOARD_PUJJO
	default "uldren" if TEST_BOARD_ULDREN
	default "xivu" if TEST_BOARD_XIVU
	default "xivur" if TEST_BOARD_XIVUR

choice TEST_CHARGER
	prompt "Select charger for tests"
	default TEST_ISL923X if \
		TEST_BOARD_BROX || \
		TEST_BOARD_CRAASK || \
		TEST_BOARD_CRAASKOV || \
		TEST_BOARD_GOTHRAX || \
		TEST_BOARD_NIVVIKS || \
		TEST_BOARD_PIRRHA || \
		TEST_BOARD_PUJJO || \
		TEST_BOARD_ULDREN || \
		TEST_BOARD_XIVU || \
		TEST_BOARD_XIVUR

	config TEST_ISL923X
		bool "Use ISL923x test variants"
		select ISL923X_MOCK

endchoice # TEST_CHARGER

choice TEST_TARGET
	prompt "Test to run"

	config TEST_EXTPOWER
		bool "Run external power tests"
endchoice # TEST_TARGET

config TEST_SRC
	string "Override default file to test"

config TEST_CHARGER_SOLO_DEF
	bool "Define CHARGER_SOLO"

config TEST_CHARGER_MULTI_DEF
	bool "Define CHARGER_PRIMARY and CHARGER_SECONDARY"

source "Kconfig.zephyr"
```

## zephyr/test/console/testcase.yaml
```yaml
common:
  platform_allow: native_sim
tests:
  # The UART API provides both interrupt driven and modes.
  console.output.interrupt:
    extra_conf_files:
    - console_output.conf
    extra_dtc_overlay_files:
    - boards/native_sim.overlay
    - console_output.dts
    extra_configs:
    - CONFIG_TEST_CONSOLE_OUTPUT=y
    - CONFIG_SHELL_BACKEND_SERIAL_API_INTERRUPT_DRIVEN=y
    - CONFIG_SHELL_BACKEND_SERIAL_API_POLLING=n
  console.output.interrupt.noisr:
    extra_conf_files:
    - console_output.conf
    extra_dtc_overlay_files:
    - boards/native_sim.overlay
    - console_output.dts
    extra_configs:
    - CONFIG_TEST_CONSOLE_OUTPUT=y
    - CONFIG_SHELL_BACKEND_SERIAL_API_INTERRUPT_DRIVEN=y
    - CONFIG_SHELL_BACKEND_SERIAL_API_POLLING=n
    - CONFIG_PLATFORM_EC_ISR_CONSOLE_OUTPUT=n
  console.output.polling:
    extra_conf_files:
    - console_output.conf
    extra_dtc_overlay_files:
    - boards/native_sim.overlay
    - console_output.dts
    extra_configs:
    - CONFIG_TEST_CONSOLE_OUTPUT=y
    - CONFIG_UART_ASYNC_API=y
    - CONFIG_SHELL_BACKEND_SERIAL_API_INTERRUPT_DRIVEN=n
    - CONFIG_SHELL_BACKEND_SERIAL_API_POLLING=y
  console.output.polling.noisr:
    extra_conf_files:
    - console_output.conf
    extra_dtc_overlay_files:
    - boards/native_sim.overlay
    - console_output.dts
    extra_configs:
    - CONFIG_TEST_CONSOLE_OUTPUT=y
    - CONFIG_UART_ASYNC_API=y
    - CONFIG_SHELL_BACKEND_SERIAL_API_INTERRUPT_DRIVEN=n
    - CONFIG_SHELL_BACKEND_SERIAL_API_POLLING=y
    - CONFIG_PLATFORM_EC_ISR_CONSOLE_OUTPUT=n
  console.restricted:
    extra_dtc_overlay_files:
    - boards/native_sim_restricted.overlay
    extra_configs:
    - CONFIG_TEST_CONSOLE_RESTRICTED=y
    - CONFIG_BOARD_FINGERPRINT=y
    - CONFIG_FINGERPRINT_SHELL=y
    - CONFIG_PLATFORM_EC_FINGERPRINT=y
    - CONFIG_BORINGSSL_CRYPTO=y
    - CONFIG_CPP=y
    - CONFIG_STD_CPP20=y
    - CONFIG_REQUIRES_FULL_LIBCPP=y
    - CONFIG_COMMON_LIBC_MALLOC=y
    - CONFIG_COMMON_LIBC_MALLOC_ARENA_SIZE=2048
    - CONFIG_PLATFORM_EC_ROLLBACK=y
    - CONFIG_PLATFORM_EC_ROLLBACK_SECRET_SIZE=32
    - CONFIG_FINGERPRINT_SENSOR=y
    - CONFIG_FP_ALGORITHM_TEMPLATE_SIZE=32
    - CONFIG_FINGERPRINT_SUBSYSTEM=y
    - CONFIG_PLATFORM_EC_RANDOM=y
    - CONFIG_EMUL=y
    - CONFIG_FLASH=y
    - CONFIG_GPIO=y
    - CONFIG_PLATFORM_EC_HOSTCMD_CONSOLE=y
    - CONFIG_PLATFORM_EC_HOSTCMD=y
    - CONFIG_INPUT_GPIO_KEYS=y
    - CONFIG_INPUT=y
```

## zephyr/test/craask/testcase.yaml
```yaml
# Copyright 2022 The ChromiumOS Authors
# Use of this source code is governed by a BSD-style license that can be
# found in the LICENSE file.

common:
  platform_allow: native_posix
tests:
  craask.convertible:
    extra_args: DTC_OVERLAY_FILE="./common.dts;../projects/nissa/craask/interrupts.dts;../projects/nissa/cbi.dts;../projects/nissa/craask/cbi.dts;../projects/nissa/craask/generated.dts;../projects/nissa/craask/motionsense.dts"
    extra_configs:
      - CONFIG_TEST_CRAASK=y
      - CONFIG_TEST_FORM_FACTOR_CONVERTIBLE=y
  craask.clamshell:
    extra_args: DTC_OVERLAY_FILE="./common.dts;../projects/nissa/craask/interrupts.dts;../projects/nissa/cbi.dts;../projects/nissa/craask/cbi.dts;../projects/nissa/craask/generated.dts;../projects/nissa/craask/motionsense.dts"
    extra_configs:
      - CONFIG_TEST_CRAASK=y
      - CONFIG_TEST_FORM_FACTOR_CLAMSHELL=y
  craask.alt_sensor:
    extra_args: DTC_OVERLAY_FILE="./common.dts;../projects/nissa/craask/interrupts.dts;../projects/nissa/cbi.dts;../projects/nissa/craask/cbi.dts;../projects/nissa/craask/generated.dts;../projects/nissa/craask/motionsense.dts"
    extra_configs:
      - CONFIG_TEST_CRAASK=y
      - CONFIG_TEST_ALT_SENSOR_PROBE=y
```

## zephyr/test/dirks/testcase.yaml
```yaml
# Copyright 2025 The ChromiumOS Authors
# Use of this source code is governed by a BSD-style license that can be
# found in the LICENSE file.

common:
  platform_allow:
    - native_sim
tests:
  dirks.board_power:
    extra_dtc_overlay_files:
      - "boards/generic_npcx.dts"
      - "boards/generic_power_signals.dts"
    extra_configs:
      - CONFIG_TEST_DIRKS_BOARD_POWER=y
      - CONFIG_AP_X86_INTEL_ADL=y
      - CONFIG_TEST_DISABLE_AP_PWRSEQ=y
      - CONFIG_AP_POWER_EVENTS_MOCK=y
      - CONFIG_POWER_SIGNALS_MOCK=y
      - CONFIG_AP_EVENTS=n
  dirks.board_power.ap_pwrseq_drv:
    extra_configs:
      - CONFIG_TEST_DIRKS_BOARD_POWER=y
      - CONFIG_PLATFORM_EC_VBOOT_HASH=n
      - CONFIG_AP_X86_INTEL_ADL=y
      - CONFIG_AP_PWRSEQ=y
      - CONFIG_EMUL_AP_PWRSEQ_DRIVER=y
      - CONFIG_EMUL_POWER_SIGNALS=y
      - CONFIG_AP_PWRSEQ_DRIVER=y
      - CONFIG_PLATFORM_EC_HOSTCMD=y
      - CONFIG_PLATFORM_EC_BACKLIGHT_LID=n
    extra_dtc_overlay_files:
      - "boards/generic_npcx.dts"
      - "boards/ap_pwrseq_drv_power_signals.dts"
  dirks.sub_board:
    extra_dtc_overlay_files:
      - "boards/generic_npcx.dts"
    extra_configs:
      - CONFIG_TEST_DIRKS_SUB_BOARD=y
      - CONFIG_DIRKS_BOARD_HAS_HDMI_SUPPORT=y
  dirks.common:
    extra_dtc_overlay_files:
      - "boards/generic_npcx.dts"
      - "boards/chargers.dts"
    extra_conf_files:
      - "prj.conf"
      - "charger.conf"
    extra_configs:
      - CONFIG_TEST_DIRKS_COMMON=y
  dirks.dirks:
    extra_configs:
      - CONFIG_TEST_DIRKS_DIRKS=y
      - CONFIG_PLATFORM_EC_TCPC_INTERRUPT=n
      - CONFIG_PLATFORM_EC_USB_PORT_ENABLE_DYNAMIC=n
    extra_dtc_overlay_files:
      - "boards/dirks.dts"
```

## zephyr/test/drivers/src/integration/usbc/testcase.yaml
```yaml
tests:
  drivers.integration.usbc:
    tags: ec drivers zephyr
    timeout: 300
    extra_args:
      DTC_OVERLAY_FILE="../../zephyr/dts/board-overlays/native_posix.dts;../../../overlay.dts"
      CONF_FILE="../../../prj.conf"
```

## zephyr/test/drivers/testcase.yaml
```yaml
common:
  platform_allow: native_posix
tests:
  drivers.gpio_unhook:
    extra_configs:
      - CONFIG_LINK_TEST_SUITE_GPIO_UNHOOK=y
```

## zephyr/test/dsp_comms/testcase.yaml
```yaml
tests:
  cros.dsp.level_trigger.buffered_i2c:
    harness: gtest
    extra_dtc_overlay_files:
      - boards/native_sim.overlay
      - boards/native_sim.buffered_i2c.overlay
    extra_args:
      - TEST_LIB=cros.dsp.test
    platform_allow:
      - native_sim
  cros.dsp.level_trigger.pio_i2c:
    harness: gtest
    extra_dtc_overlay_files:
      - boards/native_sim.overlay
    extra_args:
      - TEST_LIB=cros.dsp.test
    platform_allow:
      - native_sim
  cros.dsp.edge_trigger.buffered_i2c:
    harness: gtest
    extra_dtc_overlay_files:
      - boards/native_sim.overlay
      - boards/native_sim.buffered_i2c.overlay
      - boards/native_sim.edge_trigger.overlay
    extra_args:
      - TEST_LIB=cros.dsp.test
    platform_allow:
      - native_sim
  cros.dsp.edge_trigger.pio_i2c:
    harness: gtest
    extra_dtc_overlay_files:
      - boards/native_sim.overlay
      - boards/native_sim.edge_trigger.overlay
    extra_args:
      - TEST_LIB=cros.dsp.test
    platform_allow:
      - native_sim
  cros.dsp.service.transport:
    harness: gtest
    extra_args:
      - TEST_LIB=cros.dsp.service.transport_test
    platform_allow:
      - native_sim
  pw_fsm.state_machine:
    harness: gtest
    extra_args:
      - TEST_LIB=pw_fsm.fsm_test
    platform_allow:
      - native_sim
```

## zephyr/test/extpower/testcase.yaml
```yaml
common:
  platform_allow:
    - native_sim
tests:
  extpower.default: {}
  extpower.no_hostcmd:
    extra_configs:
      - CONFIG_PLATFORM_EC_HOSTCMD=n
```

## zephyr/test/i2c/testcase.yaml
```yaml
common:
  platform_allow: native_posix
tests:
  i2c.default:
    extra_configs:
    - CONFIG_TEST_I2C_DEFAULT=y

  i2c.pec:
    extra_configs:
    - CONFIG_TEST_I2C_PEC=y
    - CONFIG_PLATFORM_EC_SMBUS_PEC=y

  i2c.pec.legacy:
    extra_configs:
    - CONFIG_TEST_I2C_PEC=y
    - CONFIG_PLATFORM_EC_SMBUS_PEC=y
    - CONFIG_PLATFORM_EC_SMBUS_PEC_ZEPHYR=n
```

## zephyr/test/intel_mod_aic/testcase.yaml
```yaml
# Copyright 2025 The ChromiumOS Authors
# Use of this source code is governed by a BSD-style license that can be
# found in the LICENSE file.

common:
  platform_allow:
    - native_sim
tests:
  intel_mod_aic.default:
    extra_dtc_overlay_files:
      - boards/native_sim.overlay
      - mod_aic.dtsi
      - power_signals.dtsi
    extra_configs:
      - CONFIG_TEST_SUITE_INTEL_MOD_AIC=y
      - CONFIG_AP_PWRSEQ=y
      - CONFIG_AP_PWRSEQ_DRIVER=y
      - CONFIG_AP_POWER_EVENTS_MOCK=y
      - CONFIG_POWER_SIGNALS_MOCK=y
      - CONFIG_CHIPSET_API_MOCK=y
      - CONFIG_AP_EVENTS=n
```

## zephyr/test/intelrvp/Kconfig
```kconfig
# Copyright 2024 The ChromiumOS Authors
# Use of this source code is governed by a BSD-style license that can be
# found in the LICENSE file.

choice TEST_PROJECT_TYPE
	prompt "Select Intel RVP board variant for tests"
	help
	  Choose the board variant for which the tests will be compiled and run.

config TEST_PROJECT_MTLRVPP_COMMON
	bool "Enable tests for board mtlrvp common source code"
	help
	  Enable tests specific to the mtlrvp common source code.

config TEST_PROJECT_MTLRVPP_NPCX
	bool "Enable tests for board mtlrvp_npcx"
	help
	  Enable tests specific to the mtlrvp_npcx variant.

config TEST_PROJECT_MTLRVPP_MCHP
	bool "Enable tests for board mtlrvp_mchp"
	help
	  Enable tests specific to the mtlrvp_mchp variant.

config TEST_PROJECT_MTLRVPP_PD
	bool "Enable tests for board mtlrvp_pd"
	help
	  Enable tests specific to the mtlrvp_pd variant.
endchoice

config TEST_PROJECT_MTL_BOARD_POWER
	bool "Run tests for board_power.c"
	depends on TEST_PROJECT_MTLRVPP_NPCX || TEST_PROJECT_MTLRVPP_MCHP || \
		   TEST_PROJECT_MTLRVPP_PD
	help
	  Include board_power.c into the binary and test its functions.

config TEST_X86_NON_DSX_PWRSEQ_MTL
	bool "Replace CONFIG_X86_NON_DSX_PWRSEQ_MTL for testing"
	help
	  This is used to replace CONFIG_X86_NON_DSX_PWRSEQ_MTL for testing
	  purposes directly.

config TEST_PROJECT_BOARD_ID
	bool "Run INTELRVP board id test"
	help
	  Run board ID test for INTELRVP.

config TEST_PROJECT_TCPC
	bool "Run tests for tcpc.c"
	help
	  Include tcpc.c into the binary and test its functions.

config TEST_PROJECT_CHG_USB_PD_MECC
    bool "Run tests for chg_usb_pd_mecc_1_1.c"
    help
        Include chg_usb_pd_mecc_1_1.c into the binary and test its functions.

source "Kconfig.zephyr"
```
