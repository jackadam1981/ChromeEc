## zephyr/test/intelrvp/testcase.yaml
```yaml
# Copyright 2024 The ChromiumOS Authors
# Use of this source code is governed by a BSD-style license that can be
# found in the LICENSE file.

common:
  platform_allow: native_sim
tests:
  intelrvp.mtlrvp_npcx.board_power:
    extra_dtc_overlay_files:
      - boards/native_sim.overlay
      - boards/mtlrvp_npcx/board_power.dtsi
    extra_configs:
      - CONFIG_TEST_PROJECT_MTLRVPP_NPCX=y
      - CONFIG_AP_X86_INTEL_MTL=y
      - CONFIG_TEST_PROJECT_MTL_BOARD_POWER=y
      - CONFIG_AP_POWER_EVENTS_MOCK=y
      - CONFIG_POWER_SIGNALS_MOCK=y
      - CONFIG_AP_EVENTS=n
      - CONFIG_TEST_X86_NON_DSX_PWRSEQ_MTL=y
      - CONFIG_PLATFORM_EC_HOOKS=n
      - CONFIG_PLATFORM_EC_HIBERNATE=n
      - CONFIG_AP_PWRSEQ_DRIVER=n

  intelrvp.mtlrvp_mchp.board_power:
    extra_dtc_overlay_files:
      - boards/native_sim.overlay
      - boards/mtlrvp_mchp/board_power.dtsi
    extra_configs:
      - CONFIG_TEST_PROJECT_MTLRVPP_MCHP=y
      - CONFIG_AP_X86_INTEL_MTL=y
      - CONFIG_TEST_PROJECT_MTL_BOARD_POWER=y
      - CONFIG_AP_POWER_EVENTS_MOCK=y
      - CONFIG_POWER_SIGNALS_MOCK=y
      - CONFIG_AP_EVENTS=n
      - CONFIG_TEST_X86_NON_DSX_PWRSEQ_MTL=y
      - CONFIG_PLATFORM_EC_HOOKS=n
      - CONFIG_PLATFORM_EC_HIBERNATE=n
      - CONFIG_AP_PWRSEQ_DRIVER=n

  intelrvp.mtlrvp.board_id:
    extra_dtc_overlay_files:
      - boards/native_sim.overlay
      - boards/mtlrvp/board_id.dtsi
    extra_configs:
      - CONFIG_TEST_PROJECT_MTLRVPP_COMMON=y
      - CONFIG_TEST_PROJECT_BOARD_ID=y
      - CONFIG_GPIO_EMUL=y

  intelrvp.mtlrvp_npcx.tcpc:
    extra_dtc_overlay_files:
      - boards/native_sim.overlay
      - boards/mtlrvp_npcx/tcpc_gpio.dtsi
      - boards/mtlrvp_npcx/tcpc_i2c.dtsi
      - boards/mtlrvp/tcpc_interrupts.dtsi
      - boards/mtlrvp/tcpc_ioex.dtsi
      - boards/mtlrvp_npcx/i2c_charger.dtsi
      - boards/mtlrvp/usbc.dtsi
    extra_configs:
      - CONFIG_TEST_PROJECT_MTLRVPP_NPCX=y
      - CONFIG_TEST_PROJECT_TCPC=y
      - CONFIG_PLATFORM_EC_USB_MUX=y
      - CONFIG_GPIO_EMUL=y
      - CONFIG_I2C_EMUL=y
      - CONFIG_EMUL_TCPCI=y
      - CONFIG_PLATFORM_EC_USBC=y
      - CONFIG_PLATFORM_EC_USBC_PPC=y
      - CONFIG_PLATFORM_EC_USB_PD_DISCHARGE_PPC=y

  intelrvp.mtlrvp_mchp.tcpc:
    extra_dtc_overlay_files:
      - boards/native_sim.overlay
      - boards/mtlrvp_mchp/tcpc_i2c.dtsi
      - boards/mtlrvp_mchp/tcpc_gpio.dtsi
      - boards/mtlrvp/tcpc_ioex.dtsi
      - boards/mtlrvp/tcpc_interrupts.dtsi
      - boards/mtlrvp_mchp/i2c_charger.dtsi
      - boards/mtlrvp/usbc.dtsi
    extra_configs:
      - CONFIG_TEST_PROJECT_MTLRVPP_NPCX=y
      - CONFIG_TEST_PROJECT_TCPC=y
      - CONFIG_PLATFORM_EC_USB_MUX=y
      - CONFIG_GPIO_EMUL=y
      - CONFIG_I2C_EMUL=y
      - CONFIG_EMUL_TCPCI=y
      - CONFIG_PLATFORM_EC_USBC=y
      - CONFIG_PLATFORM_EC_USBC_PPC=y
      - CONFIG_PLATFORM_EC_USB_PD_DISCHARGE_PPC=y

  intelrvp.mtlrvp_npcx.dc_jack:
    extra_dtc_overlay_files:
      - boards/native_sim.overlay
      - boards/mtlrvp/interrupts.dtsi
      - boards/mtlrvp/battery.dtsi
      - boards/mtlrvp_npcx/i2c_charger.dtsi
    extra_configs:
      - CONFIG_PLATFORM_EC=y
      - CONFIG_TEST_PROJECT_MTLRVPP_NPCX=y
      - CONFIG_TEST_PROJECT_DC_JACK=y
      - CONFIG_PLATFORM_EC_PD_MAX_POWER_MW=100000
      - CONFIG_GPIO_EMUL=y
      - CONFIG_PLATFORM_EC_DEDICATED_CHARGE_PORT=y
      - CONFIG_I2C_EMUL=y
      - CONFIG_PLATFORM_EC_HOOKS=y
      - CONFIG_PLATFORM_EC_HOSTCMD=y
      - CONFIG_PLATFORM_EC_CHARGE_MANAGER=n
      - CONFIG_PLATFORM_EC_SWITCH=n
      - CONFIG_PLATFORM_EC_USBC=n
      - CONFIG_PLATFORM_EC_VBOOT_HASH=n
      - CONFIG_PLATFORM_EC_CHARGER_SENSE_RESISTOR=5
      - CONFIG_PLATFORM_EC_CHARGER_SENSE_RESISTOR_AC=10

  intelrvp.mtlrvp_mchp.chg_usb_pd_mecc_1_1:
    extra_dtc_overlay_files:
      - boards/native_sim.overlay
      - boards/mtlrvp/usbc.dtsi
      - boards/mtlrvp/tcpc_ioex.dtsi
      - boards/mtlrvp_mchp/i2c_charger.dtsi
      - boards/mtlrvp_mchp/tcpc_i2c.dtsi
      - boards/mtlrvp_mchp/tcpc_gpio.dtsi
    extra_configs:
      - CONFIG_TEST_PROJECT_MTLRVPP_MCHP=y
      - CONFIG_TEST_PROJECT_CHG_USB_PD_MECC=y
      - CONFIG_PLATFORM_EC_USB_MUX=y
      - CONFIG_GPIO_EMUL=y
      - CONFIG_I2C_EMUL=y
      - CONFIG_EMUL_TCPCI=y
      - CONFIG_PLATFORM_EC_USBC=y
      - CONFIG_PLATFORM_EC_USBC_PPC=y
      - CONFIG_PLATFORM_EC_USB_PD_DISCHARGE_PPC=y
      - CONFIG_PLATFORM_EC_USB_PD_TCPC_RUNTIME_CONFIG=y
      - CONFIG_PLATFORM_EC_TCPC_INTERRUPT=n

  intelrvp.mtlrvp_npcx.chg_usb_pd_mecc_1_1:
    extra_dtc_overlay_files:
      - boards/native_sim.overlay
      - boards/mtlrvp/usbc.dtsi
      - boards/mtlrvp/tcpc_ioex.dtsi
      - boards/mtlrvp_npcx/i2c_charger.dtsi
      - boards/mtlrvp_npcx/tcpc_gpio.dtsi
      - boards/mtlrvp_npcx/tcpc_i2c.dtsi
    extra_configs:
      - CONFIG_TEST_PROJECT_MTLRVPP_NPCX=y
      - CONFIG_TEST_PROJECT_CHG_USB_PD_MECC=y
      - CONFIG_PLATFORM_EC_USB_MUX=y
      - CONFIG_GPIO_EMUL=y
      - CONFIG_I2C_EMUL=y
      - CONFIG_EMUL_TCPCI=y
      - CONFIG_PLATFORM_EC_USBC=y
      - CONFIG_PLATFORM_EC_USBC_PPC=y
      - CONFIG_PLATFORM_EC_USB_PD_DISCHARGE_PPC=y
      - CONFIG_PLATFORM_EC_USB_PD_TCPC_RUNTIME_CONFIG=y
      - CONFIG_PLATFORM_EC_TCPC_INTERRUPT=n

  intelrvp.mtlrvp_mchp.dc_jack:
    extra_dtc_overlay_files:
      - boards/native_sim.overlay
      - boards/mtlrvp/battery.dtsi
      - boards/mtlrvp/tcpc_ioex.dtsi
      - boards/mtlrvp_mchp/i2c_charger.dtsi
      - boards/mtlrvp/interrupts.dtsi
    extra_configs:
      - CONFIG_TEST_PROJECT_MTLRVPP_MCHP=y
      - CONFIG_TEST_PROJECT_DC_JACK=y
      - CONFIG_PLATFORM_EC_PD_MAX_POWER_MW=100000
      - CONFIG_GPIO_EMUL=y
      - CONFIG_PLATFORM_EC_DEDICATED_CHARGE_PORT=y
      - CONFIG_I2C_EMUL=y
      - CONFIG_PLATFORM_EC_HOOKS=y
      - CONFIG_PLATFORM_EC_HOSTCMD=y
      - CONFIG_PLATFORM_EC_CHARGE_MANAGER=n
      - CONFIG_PLATFORM_EC_SWITCH=n
      - CONFIG_PLATFORM_EC_USBC=n
      - CONFIG_PLATFORM_EC_VBOOT_HASH=n
      - CONFIG_PLATFORM_EC_CHARGER_SENSE_RESISTOR=5
      - CONFIG_PLATFORM_EC_CHARGER_SENSE_RESISTOR_AC=10

  intelrvp.ptlrvp.board_power:
    extra_dtc_overlay_files:
      - boards/native_sim.overlay
      - boards/ptlrvp_mchp/board_power.dtsi
    extra_configs:
      - CONFIG_TEST_PROJECT_PTLRVPP_MCHP=y
      - CONFIG_TEST_PROJECT_PTL_BOARD_POWER=y
      - CONFIG_TEST_X86_NON_DSX_PWRSEQ_MTL=y
      - CONFIG_AP_X86_INTEL_MTL=y
      - CONFIG_AP_POWER_EVENTS_MOCK=y
      - CONFIG_POWER_SIGNALS_MOCK=y
      - CONFIG_AP_EVENTS=n
      - CONFIG_PLATFORM_EC_HOOKS=n
      - CONFIG_PLATFORM_EC_HIBERNATE=n
      - CONFIG_AP_PWRSEQ_DRIVER=y
      - CONFIG_EMUL_AP_PWRSEQ_DRIVER=y
      - CONFIG_TEST_AP_PWRSEQ_PP5500=y
```

## zephyr/test/kingler/testcase.yaml
```yaml
common:
  platform_allow: native_posix
tests:
  kingler.usbc:
    extra_configs:
    - CONFIG_TEST_KINGLER_USBC=y
    - CONFIG_PLATFORM_EC_TCPC_INTERRUPT=y
    - CONFIG_PLATFORM_EC_USBA=y
    - CONFIG_PLATFORM_EC_USB_PORT_POWER_DUMB=y
    - CONFIG_PLATFORM_EC_USBC=y
    - CONFIG_PLATFORM_EC_USB_PORT_POWER_DUMB_CUSTOM_HOOK=y
    - CONFIG_PLATFORM_EC_USB_PD_TCPM_RT1718S=y
    - CONFIG_PLATFORM_EC_USBC_PPC=y
    - CONFIG_PLATFORM_EC_BATTERY_FUEL_GAUGE=y
    - CONFIG_PLATFORM_EC_VBOOT_HASH=n
    - CONFIG_PLATFORM_EC_SWITCH=n
    - CONFIG_PLATFORM_EC_USB_PD_DISCHARGE_PPC=y
    - CONFIG_PLATFORM_EC_USB_PD_VBUS_MEASURE_BY_BOARD=y
    - CONFIG_PLATFORM_EC_CHARGER_SENSE_RESISTOR=10
    - CONFIG_PLATFORM_EC_CHARGER_SENSE_RESISTOR_AC=20
    - CONFIG_PLATFORM_EC_EXTPOWER=y
    - CONFIG_PLATFORM_EC_HOSTCMD=y
    - CONFIG_PLATFORM_EC_USB_PD_TCPM_ANX7447=y
    - CONFIG_VARIANT_CORSOLA_DB_DETECTION=n
    - CONFIG_PLATFORM_EC_BACKLIGHT_LID=n
    - CONFIG_PLATFORM_EC_CHARGER_ISL9238C=y
    - CONFIG_PLATFORM_EC_CHARGE_MANAGER=y
    - CONFIG_PLATFORM_EC_CHARGER=y
    - CONFIG_PLATFORM_EC_LID_SWITCH=y
    - CONFIG_PLATFORM_EC_BC12_DETECT_PI3USB9201=y
    - CONFIG_PLATFORM_EC_USBC_PPC_NX20P3483=y
    - CONFIG_PLATFORM_EC_CHARGE_RAMP_HW=y
    - CONFIG_PLATFORM_EC_USB_CHARGER=y
    - CONFIG_PLATFORM_EC_USB_PD_TCPM_ANX7447=y
    extra_dtc_overlay_files:
    - kingler.usbc.overlay
  kingler.steelix:
    extra_configs:
    - CONFIG_TEST_STEELIX_RUSTY=y
    - CONFIG_TEST_FORM_FACTOR_CONVERTIBLE=y
    - CONFIG_PLATFORM_EC_ACCELGYRO_LSM6DSM=y
    extra_dtc_overlay_files:
    - kingler.steelix.overlay
  kingler.rusty:
    extra_configs:
    - CONFIG_TEST_STEELIX_RUSTY=y
    - CONFIG_TEST_FORM_FACTOR_CLAMSHELL=y
    - CONFIG_PLATFORM_EC_ACCELGYRO_LSM6DSM=y
    extra_dtc_overlay_files:
    - kingler.steelix.overlay
  kingler.db_detect_typec:
    extra_configs:
    - CONFIG_TEST_DB_DETECT_TYPEC=y
    - CONFIG_VARIANT_CORSOLA_DB_DETECTION=y
    extra_dtc_overlay_files:
    - kingler.default.overlay
  kingler.db_detect_hdmi:
    extra_configs:
    - CONFIG_TEST_DB_DETECT_HDMI=y
    - CONFIG_VARIANT_CORSOLA_DB_DETECTION=y
    extra_dtc_overlay_files:
    - kingler.default.overlay
  kingler.db_detect_none:
    extra_configs:
    - CONFIG_TEST_DB_DETECT_NONE=y
    - CONFIG_VARIANT_CORSOLA_DB_DETECTION=y
    extra_dtc_overlay_files:
    - kingler.steelix.overlay
  kingler.ccd:
    extra_configs:
    - CONFIG_TEST_KINGLER_CCD=y
    extra_dtc_overlay_files:
    - kingler.default.overlay
  kingler.alt_sensor:
    extra_configs:
    - CONFIG_TEST_STEELIX_RUSTY=y
    - CONFIG_TEST_ALT_SENSOR_PROBE=y
    extra_dtc_overlay_files:
    - kingler.steelix.overlay
  kingler.voltorb:
    extra_configs:
    - CONFIG_TEST_VOLTORB=y
    - CONFIG_TEST_USB_PD_POLICY=y
    extra_dtc_overlay_files:
    - kingler.default.overlay
```

## zephyr/test/lib/testcase.yaml
```yaml
common:
  platform_allow: native_sim
tests:
  lib.sbrk:
    extra_configs:
    - CONFIG_TEST_LIB_SBRK=y
    - CONFIG_PLATFORM_EC_SBRK=y
```
