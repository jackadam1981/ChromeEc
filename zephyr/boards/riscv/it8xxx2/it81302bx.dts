/* Copyright 2022 The ChromiumOS Authors
 * Use of this source code is governed by a BSD-style license that can be
 * found in the LICENSE file.
 */

/dts-v1/;

#include <cros/ite/it8xxx2.dtsi>
#include <ite/it8xxx2-i2c.dtsi>
#include <ite/it8xxx2-wuc.dtsi>
#include "it8xxx2.dts"
