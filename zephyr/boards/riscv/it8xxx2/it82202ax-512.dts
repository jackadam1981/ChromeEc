/* Copyright 2022 The ChromiumOS Authors
 * Use of this source code is governed by a BSD-style license that can be
 * found in the LICENSE file.
 */

/dts-v1/;

#include "it8xxx2.dts"
#include <ite/it82xx2.dtsi>
#include <ite/it82202ax-512.dtsi>
#include <ite/it8xxx2-pinctrl-map.dtsi>
