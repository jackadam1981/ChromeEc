/* Copyright 2025 The ChromiumOS Authors
 * Use of this source code is governed by a BSD-style license that can be
 * found in the LICENSE file.
 */

/dts-v1/;

#include <ite/it51xxx.dtsi>
#include <ite/it51526aw.dtsi>
#include "it51xxx.dtsi"
