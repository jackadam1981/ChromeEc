## zephyr/drivers/dsp_comms/Kconfig.service
```kconfig
# Copyright 2023 The ChromiumOS Authors
# Use of this source code is governed by a BSD-style license that can be
# found in the LICENSE file.

config PLATFORM_EC_DSP_SERVICE
	bool "Communication driver for EC"
	default y
	depends on DT_HAS_CROS_DSP_SERVICE_ENABLED
	depends on NANOPB
	depends on I2C
	depends on I2C_TARGET
	help
	  Allow proto based communication between the EC and DSP core.

	  If enabled, the core will enable a service which is used to
	  serve the DSP core (this should be done on the EC).

config PLATFORM_EC_DSP_SERVICE_MODE_CHANGE_DELAY_MS
    int "Delay in milliseconds for mode handling work scheduling"
    depends on PLATFORM_EC_DSP_SERVICE
    default 10
    range 10 200
    help
      Delay in milliseconds for rescheduling the mode_handling_work when
	  notebook/tablet mode changes. This provides debouncing period and
	  avoids mode handling execution from ISR context. Default is 100 msec.
```

## zephyr/drivers/fingerprint/Kconfig.elan
```kconfig
# Copyright 2025 The ChromiumOS Authors
# Use of this source code is governed by a BSD-style license that can be
# found in the LICENSE file.


menuconfig FINGERPRINT_SENSOR_ELAN80SG
	bool "Fingerprint driver for ELAN80SG"
	default y
	depends on DT_HAS_ELAN_ELAN80SG_ENABLED
	help
	  Driver for ELAN80SG fingerprint sensor. It requires ELAN private library
	  to implement cros_fingerprint API. If the library is not available it
	  only supports checking sensor hardware ID.

if FINGERPRINT_SENSOR_ELAN80SG

# Enabled in private driver Kconfig
config HAVE_ELAN80SG_PRIVATE_DRIVER
	bool
	help
	  If enabled, it indicates that the private driver is present.

endif # FINGERPRINT_SENSOR_ELAN80SG

config FP_SENSOR_HWID_ELAN
    hex "Elan fingerprint sensor hardware ID"
    default 0x4f4f if FINGERPRINT_SENSOR_ELAN80SG
    help
      Hardware ID value used by the driver for identifying
      the specific Elan 80-series fingerprint sensor.

config FINGERPRINT_SENSOR_ELAN80SERIES_PAL
    bool "Platform Abstraction Layer for ELAN 80 series sensors"
    default y
    depends on FINGERPRINT_SENSOR_ELAN80SG
    help
      If enabled, Platform Abstraction Layer for ELAN private library will be compiled.
      This PAL is used by both ELAN80SG and ELANI80SA sensors.

config FINGERPRINT_SENSOR_ELAN80SERIES_HEAP_SIZE
	int "Size of heap for ELAN80SERIES driver"
	default 36864 if FINGERPRINT_SENSOR_ELAN80SG
	default 36864
	help
	  Size of heap to be used by ELAN private library. The heap must have
	  enough space to facilitate the generation of the finger templates
	  during the enrollment process and to enable efficient runtime matching
	  operations.
```

## zephyr/drivers/fingerprint/Kconfig.ft
```kconfig
# Copyright 2025 The ChromiumOS Authors
# Use of this source code is governed by a BSD-style license that can be
# found in the LICENSE file.

config FINGERPRINT_SENSOR_FT98XX
	bool "FT98XX sensor driver"
	help
	  Enable driver for focaltech ft98 series sensor

if FINGERPRINT_SENSOR_FT98XX

config FINGERPRINT_SENSOR_FT98XX_PAL
	bool "Platform Abstraction Layer for Focaltech private library"
	default y
	help
	  If enabled, Platform Abstraction Layer for Focaltech private library will be
	  compiled. The PAL is used to interact with the sensor (SPI, GPIO) and
	  the system (heap allocations, printing messages, time functions).

# Enabled in private driver Kconfig
config HAVE_FT98XX_PRIVATE_DRIVER
	bool
	default n
	help
	  If enabled, it indicates that focaltech private driver is present.

endif # FINGERPRINT_SENSOR_FT98XX

menuconfig FINGERPRINT_SENSOR_FT9865
	bool "Fingerprint driver for FT9865"
	default y
	depends on DT_HAS_FT_FT98XX_ENABLED
	select FINGERPRINT_SENSOR_FT98XX
	help
	  Driver for FT9865 fingerprint sensor. It requires Focaltech private library
	  to implement cros_fingerprint API. If the library is not available it
	  only supports checking sensor hardware ID.
```
