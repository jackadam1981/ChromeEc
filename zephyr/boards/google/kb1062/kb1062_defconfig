## zephyr/boards/google/kb1062/kb1062_defconfig
```kconfig
# Copyright 2026 The ChromiumOS Authors
# Use of this source code is governed by a BSD-style license that can be
# found in the LICENSE file.

# 0~0x3000 for boot loader
CONFIG_FLASH_BASE_ADDRESS=0x4000
CONFIG_ROM_START_OFFSET=0x0000
#CONFIG_FLASH_BASE_ADDRESS=0x0
#CONFIG_ROM_START_OFFSET=0x0

# Serial Drivers
CONFIG_SERIAL=y
CONFIG_UART_INTERRUPT_DRIVEN=n
CONFIG_SHELL_BACKEND_SERIAL=y

# Enable console
CONFIG_CONSOLE=y
CONFIG_UART_CONSOLE=y

# GPIO Controller
CONFIG_GPIO=y
CONFIG_GPIO_GET_CONFIG=y

# WATCHDOG configuration
CONFIG_WATCHDOG=y

# Power Management
CONFIG_PM=y
CONFIG_PM_DEVICE=y
CONFIG_PM_POLICY_CUSTOM=y
CONFIG_UART_CONSOLE_INPUT_EXPIRED=y

# Flash
CONFIG_FLASH=y
CONFIG_FLASH_JESD216_API=y
CONFIG_FLASH_EX_OP_ENABLED=y
CONFIG_FLASH_PAGE_LAYOUT=y

CONFIG_BBRAM=y
```

## zephyr/boards/riscv/it8xxx2/it8xxx2_defconfig
```kconfig
# Copyright 2021 The Chromium OS Authors. All rights reserved.
# Use of this source code is governed by a BSD-style license that can be
# found in the LICENSE file.

# Zephyr Kernel Configuration
CONFIG_SOC_SERIES_RISCV32_IT8XXX2=y
CONFIG_SOC_IT8XXX2=y

# Platform Configuration
CONFIG_BOARD_IT8XXX2=y

# GPIO Controller
CONFIG_GPIO=y
CONFIG_GPIO_ITE_IT8XXX2=y

# ADC Driver
CONFIG_ADC_ITE_IT8XXX2=y

# Clock configuration
CONFIG_CLOCK_CONTROL=y
CONFIG_SYS_CLOCK_HW_CYCLES_PER_SEC=32768
CONFIG_SYS_CLOCK_TICKS_PER_SEC=32768

# Flash
CONFIG_PLATFORM_EC_FLASH_CROS=y
CONFIG_SOC_FLASH_ITE_IT8XXX2=y

# I2C
CONFIG_I2C_ITE_IT8XXX2=y
CONFIG_PLATFORM_EC_I2C=y

# Pinmux Driver
CONFIG_PINMUX=y
CONFIG_PINMUX_ITE_IT8XXX2=y

# PWM
CONFIG_PWM_ITE_IT8XXX2=y

# Serial Host Interface (SHI) device.
CONFIG_CROS_SHI_IT8XXX2=y

# Timer configuration
CONFIG_ITE_IT8XXX2_TIMER=y

# BBRAM
CONFIG_BBRAM=y
CONFIG_BBRAM_IT8XXX2=y
```

## zephyr/drivers/board_id/Kconfig
```kconfig
# Copyright 2025 The ChromiumOS Authors
# Use of this source code is governed by a BSD-style license that can be
# found in the LICENSE file.

config BOARD_ID_RVP
	bool "Specific RVP Support"
	default n
	help
	  Enable support only for specific RVPs that require common
	  board id driver support.

config BOARD_ID_INTEL_RVP
	bool "Intel RVP board ID read"
	depends on DT_HAS_INTEL_RVP_BOARD_ID_ENABLED && BOARD_ID_RVP
	default y
	help
	  Enable support for reading board id for INTEL RVP.
```

## zephyr/drivers/cros_bbram/Kconfig
```kconfig
# Copyright 2021 The Chromium OS Authors. All rights reserved.
# Use of this source code is governed by a BSD-style license that can be
# found in the LICENSE file.

menuconfig CROS_BBRAM_NPCX
	bool "Nuvoton NPCX battery backed RAM driver for Zephyr"
	depends on SOC_FAMILY_NPCX
	default y
	help
		This options enables stuff.
menuconfig CROS_BBRAM_IT8XXX2
	bool "ITE IT81202 battery backed RAM driver for Zephyr"
	depends on SOC_FAMILY_RISCV_ITE
	default y
	help
		This options enables stuff.
```

## zephyr/drivers/cros_fingerprint/Kconfig
```kconfig
# Copyright 2023 The ChromiumOS Authors
# Use of this source code is governed by a BSD-style license that can be
# found in the LICENSE file.

menuconfig CROS_FP_SENSOR
	bool "Fingerprint drivers"
	help
	  Enable support for fingerprint sensors.

if CROS_FP_SENSOR

config CROS_FP_SENSOR_INIT_PRIORITY
	int "Fingerprint sensor init priority"
	default 80
	help
	  Fingerprint sensor driver device initialization priority.
	  This initialization priority is used unless the driver implementation
	  has its own initialization priority.

config CROS_FP_FPC1025
	bool "Fingerprint driver for FPC1025"
	depends on DT_HAS_FPC_FPC1025_ENABLED
	default y
	help
	  Driver for FPC1025 fingerprint sensor.

# Enabled in private driver Kconfig
config HAVE_FPC1025_PRIVATE_DRIVER
	bool
	default n
	help
	  If enabled, it indicates that the private driver is present.

config FP_SENSOR_IMAGE_SIZE
	int "Size of fingerprint image data"
	default 26260 if CROS_FP_FPC1025
	help
	  This is a size of fingerprint image with an additional metadata.
	  This size must be at least a size of raw image. For FPC1025,
	  the size of a raw image is 25600 and the size of metadata is 660, so
	  the total data is 26260 bytes.

config FP_SENSOR_IMAGE_OFFSET
	int "Offset of raw image in fingerprint image data"
	default 400 if CROS_FP_FPC1025
	help
	  This is an offset of the raw fingerprint image in the image data
	  buffer.

endif # CROS_FP_SENSOR
```

## zephyr/drivers/cros_flash/Kconfig
```kconfig
# Copyright 2020 The ChromiumOS Authors
# Use of this source code is governed by a BSD-style license that can be
# found in the LICENSE file.

menuconfig CROS_FLASH_NPCX
	bool "Nuvoton NPCX flash driver for the Zephyr shim"
	default y
	depends on DT_HAS_NUVOTON_NPCX_CROS_FLASH_ENABLED
	select PLATFORM_EC_FLASH_CROS
	select PLATFORM_EC_SPI_FLASH_REGS
	help
	  This option enables a flash unit interface (FIU) driver for the NPCX
	  chip. This is used instead of the flash memory interface so we can
	  continue to use most of the existing flash memory processing code in
	  ECOS.

if CROS_FLASH_NPCX

config CROS_FLASH_NPCX_INIT_PRIORITY
	int "Nuvoton NPCX flash driver priority for the Zephyr shim"
	default 85
	help
	  This sets the priority of the NPCX flash driver for zephyr shim.
	  This driver depends on the SPI controller and SPI NOR flash drivers.
	  Its priority must be lower than CONFIG_SPI_INIT_PRIORITY and
	  CONFIG_SPI_NOR_INIT_PRIORITY.

endif # CROS_FLASH_NPCX

config CROS_FLASH_IT8XXX2
	bool "ITE IT81202 flash driver for the Zephyr shim"
	depends on SOC_FAMILY_RISCV_ITE
	default y
	select PLATFORM_EC_FLASH_CROS
	help
	  This option enables the flash driver for the it8xxx2 chip. We can
	  access the flash by read, write and erase. The it8xxx2 flash size
	  is 1M byte.

config CROS_FLASH_XEC
	bool "Microchip XEC flash driver for the Zephyr shim"
	default y
	depends on DT_HAS_MICROCHIP_XEC_CROS_FLASH_ENABLED
	select PLATFORM_EC_FLASH_CROS
	select PLATFORM_EC_SPI_FLASH_REGS
	help
	  This option enables the flash driver for the MEC172x chips. Flash
	  access is via the QSPI driver to one of three ports: internal 512KB
	  SPI flash in the MEC1727 or external shared or private ports on
	  MEC1723, etc.

if CROS_FLASH_XEC

config CROS_FLASH_XEC_INIT_PRIORITY
	int "Microchip XEC flash driver priority for the Zephyr shim"
	default 85
	help
	  This sets the priority of the MCHP flash driver for zephyr shim.
	  This driver depends on the SPI controller and SPI NOR flash drivers.
	  Its priority must be lower than CONFIG_SPI_INIT_PRIORITY and
	  CONFIG_SPI_NOR_INIT_PRIORITY.

endif # CROS_FLASH_XEC

config CROS_FLASH_STM32
	bool "ST STM32 cros-flash driver for the Zephyr shim"
	depends on SOC_FAMILY_STM32 && SOC_FLASH_STM32
	default y
	select FLASH_EX_OP_ENABLED
	select FLASH_STM32_WRITE_PROTECT
	select PLATFORM_EC_FLASH_CROS
	help
	  This option enables the cros-flash driver for the STM32 chips.
	  This driver actually acts as a translation layer between Zephyr flash
	  driver and EC flash protection flags (ro_now, ro_at_boot, etc.). The
	  driver doesn't interact with the hardware directly.

if CROS_FLASH_STM32

config CROS_FLASH_STM32_READOUT_PROTECTION
	bool "STM32 flash readout protection"
	depends on FLASH_STM32_READOUT_PROTECTION
	default n
	help
	  This option enables support for readout protection in STM32 cros-flash
	  driver. The option depends on RDP extended operations enabled when
	  FLASH_STM32_READOUT_PROTECTION is enabled in Zephyr.

config CROS_FLASH_STM32_PROTECTION_COMPAT
	bool "Enable protection data backward compatibility"
	default n
	help
	  This option enables backward compatibility with EC flash protection
	  data. During sysjump, flash protection information is saved in jump
	  tags. The part we've jumped to will read the data, so it will report
	  protection correctly. This includes the code for coverting the data
	  between old and new formats.

config CROS_FLASH_STM32_INIT_PRIORITY
	int "ST STM32 flash driver priority for the Zephyr shim"
	default 55
	help
	  This sets the priority of the STM32 cros-flash driver for Zephyr shim.
	  This driver depends on the STM32 flash driver in zephyr.
	  Its priority must be lower than CONFIG_FLASH_INIT_PRIORITY.

endif # CROS_FLASH_STM32
```

## zephyr/drivers/cros_kb_raw/Kconfig
```kconfig
# Copyright 2021 The Chromium OS Authors. All rights reserved.
# Use of this source code is governed by a BSD-style license that can be
# found in the LICENSE file.

if PLATFORM_EC_KEYBOARD

menuconfig CROS_KB_RAW
	bool "CROS raw-keyboard-scan driver for the Zephyr shim"
	default y if KSCAN
	help
	  This option enables a driver for providing raw access to the
	  keyboard-scan peripheral in the chip. This is used instead of the
	  kscan interface so we can continue to use most of the existing
	  keyboard-scanning code in ECOS.

if CROS_KB_RAW

config CROS_KB_RAW_INIT_PRIORITY
	int "cros_kb_raw initialization priority"
	default 95
	help
	  This option sets the  cros_kb_raw initialization priority.
	  This driver depends on native zephyr kscan driver. Its priority
	  must be lower than CONFIG_KSCAN_INIT_PRIORIT.

endif # CROS_KB_RAW

config CROS_KB_RAW_ITE
	bool "ITE raw-keyboard-scan driver for the Zephyr shim"
	depends on SOC_FAMILY_RISCV_ITE
	default y
	help
	  This option enables a driver for providing raw access to the
	  keyboard-scan peripheral in the chip. This is used instead of the
	  kscan interface so we can continue to use most of the existing
	  keyboard-scanning code in ECOS.

menuconfig CROS_KB_RAW_XEC
	bool "Microchip raw-keyboard-scan driver for the Zephyr shim"
	depends on SOC_FAMILY_MEC
	default y
	help
	  This option enables a driver for providing raw access to the
	  keyboard-scan peripheral in the chip. This is used instead of the
	  kscan interface so we can continue to use most of the existing
	  keyboard-scanning code in ECOS.

endif # PLATFORM_EC_KEYBOARD
```

## zephyr/drivers/cros_notebook_interrupt/Kconfig
```kconfig
# Copyright 2024 The ChromiumOS Authors
# Use of this source code is governed by a BSD-style license that can be
# found in the LICENSE file.

config CROS_NOTEBOOK_INTERRUPT
	bool "Interrupt driver used to toggle notebook mode"
	default y
	depends on DT_HAS_CROS_NOTEBOOK_INTERRUPT_ENABLED
	depends on PLATFORM_EC_TABLET_MODE
	help
	  Allows the EC to toggle tablet mode based on an external GPIO. This is
	  most commonly used when the ISH is running the motionsense task and
	  is responsible for notifying the EC of notebook mode changes caused
	  by lid angle changes.
```

## zephyr/drivers/cros_rtc/Kconfig
```kconfig
# Copyright 2021 The Chromium OS Authors. All rights reserved.
# Use of this source code is governed by a BSD-style license that can be
# found in the LICENSE file.

menuconfig CROS_RTC
	bool "RTC support"
	help
	  Enables RTC support on the board.

if CROS_RTC

choice "RTC Select"
	prompt "Select the battery to use"
	help
	  Select the RTC used on the board.

config CROS_RTC_NPCX
	bool "Nuvoton NPCX Real-Time Clock (RTC) driver for the Zephyr shim"
	depends on SOC_FAMILY_NPCX
	help
	  This option enables a driver for providing the support of Real-Time
	  Clock (RTC) on the chip. Currently, Zephyr doesn't provide setting
	  RTC value functionality in the counter driver api interface. Hence,
	  a cros RTC api provides the low-level driver interface related to
	  it and the others used in cros ec.

config NXP_RTC_PCF85063A
	bool "NXP PCF85063A Real-Time Clock (RTC) driver for the Zephyr shim"
	depends on PLATFORM_EC_I2C
	help
	  This option enables a driver for providing the support of Real-Time
	  Clock (RTC) on the chip. Currently, Zephyr doesn't provide setting RTC
	  value functionality in the counter driver api interface. Hence, a cros
	  RTC api provides the low-level driver interface related to it and the
	  others used in cros ec.

endchoice  # RTC Select

endif # CROS_RTC
```

## zephyr/drivers/cros_shi/Kconfig
```kconfig
# Copyright 2021 The Chromium OS Authors. All rights reserved.
# Use of this source code is governed by a BSD-style license that can be
# found in the LICENSE file.

menuconfig CROS_SHI_NPCX
	bool "Nuvoton NPCX Serial Host Interface driver for the Zephyr shim"
	depends on SOC_FAMILY_NPCX
	default n
	help
	  This option enables Serial Host Interface dtriver for the NPCX family
	  of processors. This is used for host command communication on the
	  platform which AP is ARM-based SoC.

config CROS_SHI_MAX_REQUEST
	hex "Max data size for the version 3 request packet"
	default 0x220

config CROS_SHI_MAX_RESPONSE
	hex "Max data size for the version 3 response packet"
	default 0x220
```

## zephyr/drivers/cros_system/Kconfig
```kconfig
# Copyright 2021 The Chromium OS Authors. All rights reserved.
# Use of this source code is governed by a BSD-style license that can be
# found in the LICENSE file.

menuconfig CROS_SYSTEM_NPCX
	bool "Nuvoton NPCX cros system driver"
	depends on SOC_FAMILY_NPCX
	default y
	help
	  This option enables the cros system driver for the NPCX family of
	  processors. Currently, Zephyr doesn't provide the system related API.
	  The cros system driver provides the low-level driver related to
	  chromium ec system functionality.

if CROS_SYSTEM_NPCX

config CROS_SYSTEM_NPCX_INIT_PRIORITY
	int "cros_system npcx initialization priority"
	default 10
	range 0 99
	help
	  This sets the npcx cros_system driver initialization priority. CROS
	  system initializes flow is influence by the system reset cause. We put
	  the chip level reset cause here and let the priority is higher than
	  SYSTEM_PRE_INIT_PRIORITY which fills the system reset-cause by the
	  chip reset cause.

endif # CROS_SYSTEM_NPCX
```

## zephyr/drivers/cros_usbc/Kconfig
```kconfig
# Copyright 2023 The ChromiumOS Authors
# Use of this source code is governed by a BSD-style license that can be
# found in the LICENSE file.

if PLATFORM_EC_USBC

config CROS_USBC_INTEL_ALTMODE
	bool "USB-C Intel alternate mode configuration driver"
	default y
	depends on DT_HAS_INTEL_PD_ALTMODE_ENABLED
	help
	  This option enables a driver for communicating betwen the USB PD
	  chip and EC for configuring the USB-C alternate mode muxes inside
	  Intel AP.

endif # PLATFORM_EC_USBC
```

## zephyr/drivers/dsp_comms/Kconfig
```kconfig
# Copyright 2024 The ChromiumOS Authors
# Use of this source code is governed by a BSD-style license that can be
# found in the LICENSE file.

rsource "Kconfig.service"
rsource "Kconfig.client"

config PLATFORM_EC_DSP_COMMS
	bool
	default y
	depends on PLATFORM_EC_DSP_SERVICE || PLATFORM_EC_DSP_CLIENT

if PLATFORM_EC_DSP_COMMS

module = DSP_COMMS
module-str = DSP_COMMS
source "subsys/logging/Kconfig.template.log_config"

config PLATFORM_EC_DSP_INIT_PRIORITY
	int "Initialization priority for the DSP comms drivers"
	default 99
	help
	  Initialization priority for the DSP comms drivers (service and
	  clients).

config PLATFORM_EC_DSP_REMOTE_LID_SWITCH
	bool ""
	default y if !TEST
	depends on !PLATFORM_EC_LID_SWITCH
	help
		...

config PLATFORM_EC_DSP_REMOTE_TABLET_SWITCH
	bool ""
	default y if !TEST
	#depends on PLATFORM_EC_GMR_TABLET_MODE
	help
		...

config PLATFORM_EC_DSP_REMOTE_LID_ANGLE
	bool "DSP service toggles tablet/clamshell modes based on lid angle"
	default y if !TEST
	help
	  When enabled, the DSP service will call lid_angle_peripheral_enable()
	  based on the inbound RPC message.

endif # PLATFORM_EC_DSP_COMMS
```
