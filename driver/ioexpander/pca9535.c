/* Copyright 2023 The ChromiumOS Authors
 * Use of this source code is governed by a BSD-style license that can be
 * found in the LICENSE file.
 *
 * PCA9535 Remote 16-BIT I2C and SMBus Low-Power I/O Expander With Interrupt
 * Output and Configuration Registers.
 */

#include "console.h"
#include "gpio.h"
#include "i2c.h"
#include "ioexpander.h"
#include "pca9535.h"

static inline int pca9535_read(int ioex, const uint8_t reg, int *data)
{
	int rv;
	uint8_t val;

	/*
	 * Read sequence
	 * Dev Address:W | Register | Dev Address:R | DATA
	 */
	rv = i2c_xfer(ioex_config[ioex].i2c_host_port,
		      ioex_config[ioex].i2c_addr_flags, &reg, 1, &val, 1);
	*data = val;

	return rv;
}

static inline int pca9535_write(int ioex, int reg, int data)
{
	/*
	 * Write sequence
	 * Dev Address:W | Register | DATA
	 */
	return i2c_write8(ioex_config[ioex].i2c_host_port,
			  ioex_config[ioex].i2c_addr_flags, reg, data);
}

static int pca9535_get_flags_by_mask(int ioex, int port, int mask, int *flags)
{
	int rv, data;

	rv = pca9535_read(ioex, PCA9535_REG_CONFIGURATION(port), &data);

	*flags = mask & data ? GPIO_INPUT : GPIO_OUTPUT;

	return rv;
}

static int pca9535_get_level(int ioex, int port, int mask, int *val)
{
	int rv, data;

	rv = pca9535_read(ioex, PCA9535_REG_INPUT(port), &data);

	*val = !!(data & mask);

	return rv;
}

static int pca9535_set_level(int ioex, int port, int mask, int val)
{
	int rv, data;

	rv = pca9535_read(ioex, PCA9535_REG_OUTPUT(port), &data);
	if (rv)
		return rv;

	if (val)
		data |= mask;
	else
		data &= ~mask;

	return pca9535_write(ioex, PCA9535_REG_OUTPUT(port), data);
}

static int pca9535_set_flags_by_mask(int ioex, int port, int mask, int flags)
{
	int rv, data;

	rv = pca9535_read(ioex, PCA9535_REG_CONFIGURATION(port), &data);
	if (rv)
		return rv;

	/* 1 - input, 0 - output: Default pins are input */
	if (flags & GPIO_OUTPUT) {
		data &= ~mask;
	}

	rv = pca9535_write(ioex, PCA9535_REG_CONFIGURATION(port), data);
	if (rv)
		return rv;

	/* Set the initial GPIO level */
	if (flags & GPIO_OUTPUT)
		return pca9535_set_level(ioex, port, mask, flags & GPIO_HIGH);

	return EC_SUCCESS;
}

static int pca9535_enable_interrupt(int ioex, int port, int mask, int enable)
{
	/*
	 * Nothing to do as an interrupt is generated by any rising or
	 * falling edge of the port inputs.
	 */
	return EC_SUCCESS;
}

int pca9535_init(int ioex)
{
	/* Nothing to do */
	return EC_SUCCESS;
}

const struct ioexpander_drv pca9535_ioexpander_drv = {
	.init = &pca9535_init,
	.get_level = &pca9535_get_level,
	.set_level = &pca9535_set_level,
	.get_flags_by_mask = &pca9535_get_flags_by_mask,
	.set_flags_by_mask = &pca9535_set_flags_by_mask,
	.enable_interrupt = &pca9535_enable_interrupt,
};
