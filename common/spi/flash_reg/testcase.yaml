## driver/Kconfig.als
```kconfig
config HAVE_ALS_AL3010
	bool
	select ALS
	select ALS_AL3010

config HAVE_ALS_BH1730
	bool
	select ALS
	select ALS_BH1730

config HAVE_ALS_ISL29035
	bool
	select ALS
	select ALS_ISL29035

config HAVE_ALS_OPT3001
	bool
	select ALS
	select ALS_OPT3001

config HAVE_ALS_SI114X
	bool
	select ALS
	select ALS_SI114X__yn

config HAVE_ALS_TCS3400
	bool
	select ALS
	select ALS_TCS3400

#

config ALS
	bool "ALS support"

if ALS

menu "ALS Chips"

config ALS_AL3010
	bool "AL3010"

config ALS_BH1730
	bool "BH1730"

config ALS_BH1730_LUXTH_PARAMS
	bool "Use board specific lux calculation"
	depends on ALS_BH1730
	help
	  If defined, BH1730 uses board specific lux calculation formula parameters.
	  If not defined, BH1730 uses default parameters to calculate lux.

config ALS_ISL29035
	bool "Enable ISL29035 support"

config ALS_OPT3001
	bool "OPT3001"

config ALS_SI114X__yn
	bool "Select ALS_SI114X"
config ALS_SI114X
	hex "Define the exact model ID present on the board: SI1141 = 41, SI1142 = 42"
	range 0x00 0xff
	default 0x40 if BOARD_EVE
	depends on ALS_SI114X__yn

if ALS_SI114X

config ALS_SI114X_CHECK_REVISION
	bool "Check if the device revision is supported"

config ALS_SI114X_POLLING
	bool "Enable Si114x to operate in polling mode"
	help
	  Enable Si114x to operate in polling mode. This config is used in conjunction
	  with CONFIG_ALS_SI114X_INT_EVENT. When polling is enabled, the read is
	  initiated in the same manner as when interrupts are used, but the event which
	  triggers the irq_handler is generated by deferred call using a fixed delay.

endif # ALS_SI114X

config ALS_TCS3400
	bool "Define to include the clear channel driver for the tcs3400 light sensor"

if ALS_TCS3400

config TCS_USE_LUX_TABLE
	bool "TCS_USE_LUX_TABLE"
	help
	  Define to use atime tables in anti-saturation algos in the tcs3400 driver.
	  Defining this for a board makes the anti-saturation algorithm much more
	  efficient, but requires the board to have it's lens cover scale and k_channel
	  scales to be determined.  Define this for a board once it's added its
	  cover_scale and k_channel scale factors.

config ALS_TCS3400_EMULATED_IRQ_EVENT
	bool "Enable tcs3400 to operate without interrupt pin"
	help
	  Enable tcs3400 to operate without interrupt pin. This config is used in
	  conjunction with CONFIG_ALS_TCS3400_INT_EVENT. When this option is enabled,
	  the read is initiated in the same manner as when interrupts are used, but the
	  event which triggers the irq_handler is generated by deferred call.

endif # ALS_TCS3400

#endchoice # ALS chip

config ALS_LIGHTBAR_DIMMING
	bool "Define which ALS sensor is used for dimming the lightbar when dark"

endmenu # "ALS Chips"

endif # ALS
```

## power/Kconfig
```kconfig
source power/Kconfig.chipset

menu "Power Setup"

menu "Power Button"

config POWER_BUTTON
	bool "Compile common code to support power button debouncing"

config POWER_BUTTON_ACTIVE_STATE__yn
	bool "Select POWER_BUTTON_ACTIVE_STATE"
config POWER_BUTTON_ACTIVE_STATE
	int "Force the active state of the power button : 0(default if unset) or 1"
	range 0 1
	depends on POWER_BUTTON_ACTIVE_STATE__yn

config POWER_BUTTON_IGNORE_LID
	bool "Allow the power button to send events while the lid is closed"

config POWER_BUTTON_X86
	bool "Support sending the power button signal to x86 chipsets"

config POWER_BUTTON_INIT_IDLE
	bool "Set power button state idle at init. Implemented only for npcx"

config POWER_BUTTON_INIT_TIMEOUT__yn
	bool "Select POWER_BUTTON_INIT_TIMEOUT"
	default y
config POWER_BUTTON_INIT_TIMEOUT
	int "Timeout before power button task gives up starting system"
	default 1
	depends on POWER_BUTTON_INIT_TIMEOUT__yn

endmenu # "Power Button"

config POWER_COMMON
	bool "Compile common code for AP power state machine"

config POWER_PP5000_CONTROL
	bool "Enable a task-safe way to control the PP5000 rail"

config POWER_SHUTDOWN_PAUSE_IN_S5
	bool "Support stopping in S5 on shutdown"

config POWER_SIGNAL_INTERRUPT_STORM_DETECT_THRESHOLD__yn
	bool "Select CONFIG_POWER_SIGNAL_INTERRUPT_STORM_DETECT_THRESHOLD"
config POWER_SIGNAL_INTERRUPT_STORM_DETECT_THRESHOLD
	int "POWER_SIGNAL_INTERRUPT_STORM_DETECT_THRESHOLD"
	depends on POWER_SIGNAL_INTERRUPT_STORM_DETECT_THRESHOLD__yn
	help
	  Detect power signal interrupt storms, defined as more than
	  CONFIG_POWER_SIGNAL_INTERRUPT_STORM_DETECT_THRESHOLD occurences of a single
	  power signal interrupt within one second.

config POWER_TRACK_HOST_SLEEP_STATE
	bool "POWER_TRACK_HOST_SLEEP_STATE"
	help
	  Allow the host to self-report its sleep state, in case there is some delay
	  between the host beginning to enter the sleep state and power signals
	  actually reflecting the new state.

config POWER_S0IX
	bool "Support S0ix"

config POWER_S0IX_FAILURE_DETECTION
	bool "Support detecting failure to enter S0ix"
	depends on POWER_S0IX
	depends on POWER_TRACK_HOST_SLEEP_STATE

config HIBERNATE
	bool "Enable system hibernate"
	default y

config HIBERNATE_DELAY_SEC
	int "Default delay after shutting down before hibernating"
	default "3600"

config SUPPORT_CHIP_HIBERNATION
	bool "If defined, chip hibernation is used"
	help
	  If defined, chip hibernation is used. Your board needs to define wake-up
	  signals. Undefine this to use board hibernation capability.

menu "External Power"

config EXTPOWER
	bool "Include code for handling external power"
	default y

config EXTPOWER_GPIO
	bool "Support detecting external power presence via a GPIO"

config EXTPOWER_DEBOUNCE_MS
	int "Default debounce time for external power signal"
	default 30

endmenu # "External Power"

endmenu # "Power"
```

## power/Kconfig.chipset
```kconfig
config HAVE_CHIPSET_TIGERLAKE
	bool
config HAVE_CHIPSET_ICELAKE
	bool
config HAVE_CHIPSET_CANNONLAKE
	bool
config HAVE_CHIPSET_COMETLAKE
	bool
config HAVE_CHIPSET_SKYLAKE
	bool
config HAVE_CHIPSET_GEMINILAKE
	bool
config HAVE_CHIPSET_APOLLOLAKE
	bool
config HAVE_CHIPSET_BRASWELL
	bool
config HAVE_CHIPSET_MT8183
	bool
config HAVE_CHIPSET_MT817X
	bool
config HAVE_CHIPSET_RK3399
	bool
config HAVE_CHIPSET_RK3288
	bool
config HAVE_CHIPSET_SDM845
	bool
config HAVE_CHIPSET_STONEY
	bool
config HAVE_CHIPSET_ECDRIVEN
	bool

menu "Chipset config"

choice
	prompt "Choose chipset"

	default CHIPSET_TIGERLAKE  if HAVE_CHIPSET_TIGERLAKE
	default CHIPSET_ICELAKE    if HAVE_CHIPSET_ICELAKE
	default CHIPSET_CANNONLAKE if HAVE_CHIPSET_CANNONLAKE
	default CHIPSET_COMETLAKE  if HAVE_CHIPSET_COMETLAKE
	default CHIPSET_SKYLAKE    if HAVE_CHIPSET_SKYLAKE
	default CHIPSET_GEMINILAKE if HAVE_CHIPSET_GEMINILAKE
	default CHIPSET_APOLLOLAKE if HAVE_CHIPSET_APOLLOLAKE
	default CHIPSET_BRASWELL   if HAVE_CHIPSET_BRASWELL
	default CHIPSET_MT8183 	   if HAVE_CHIPSET_MT8183
	default CHIPSET_MT817X 	   if HAVE_CHIPSET_MT817X
	default CHIPSET_RK3399 	   if HAVE_CHIPSET_RK3399
	default CHIPSET_RK3288 	   if HAVE_CHIPSET_RK3288
	default CHIPSET_SDM845 	   if HAVE_CHIPSET_SDM845
	default CHIPSET_STONEY 	   if HAVE_CHIPSET_STONEY
	default CHIPSET_ECDRIVEN   if HAVE_CHIPSET_ECDRIVEN

config CHIPSET_TIGERLAKE
	bool "Intel Tigerlake (x86)"
	select CHIPSET_ICL_TGL
	select POWER_COMMON
	select CHIPSET_X86_RSMRST_DELAY
config CHIPSET_ICELAKE
	bool "Intel Icelake (x86)"
	select CHIPSET_ICL_TGL
	select POWER_COMMON
	select CHIPSET_X86_RSMRST_DELAY
config CHIPSET_CANNONLAKE
	bool "Intel Cannonlake (x86)"
	select POWER_COMMON
	select CHIPSET_X86_RSMRST_DELAY
config CHIPSET_COMETLAKE
	bool "Intel Cometlake (x86)"
	select POWER_COMMON
config CHIPSET_SKYLAKE
	bool "Intel Skylake (x86)"
	select POWER_COMMON
	select CHIPSET_X86_RSMRST_DELAY
config CHIPSET_GEMINILAKE
	bool "Intel Geminilake (x86)"
	select CHIPSET_APL_GLK
	select POWER_COMMON
config CHIPSET_APOLLOLAKE
	bool "Intel Apollolake (x86)"
	select CHIPSET_APL_GLK
	select POWER_COMMON
config CHIPSET_BRASWELL
	bool "Intel Braswell (x86)"
	select POWER_COMMON
config CHIPSET_MT8183
	bool "MediaTek MT8183"
config CHIPSET_MT817X
	bool "MediaTek MT817x"
config CHIPSET_RK3399
	bool "Rockchip rk3399"
config CHIPSET_RK3288
	bool "Rockchip rk3288"
config CHIPSET_SDM845
	bool "Qualcomm SDM845"
config CHIPSET_STONEY
	bool "AMD Stoney (x86)"
config CHIPSET_ECDRIVEN
	bool "Dummy power module"

endchoice

config CHIPSET_ICL_TGL
	bool

config CHIPSET_APL_GLK
	bool

config CHIPSET_POWER_SEQ_VERSION
	int "CHIPSET_POWER_SEQ_VERSION"
	default 0
	help
	  Redefine when we need a different power-on sequence on the same chipset.

config CHIPSET_HAS_PLATFORM_PMIC_RESET
	bool "Support PMIC reset (using LDO_EN) in chipset"

config CHIPSET_HAS_PRE_INIT_CALLBACK
	bool "Board requires chipset pre-init callback"
	default y if CHIPSET_APL_GLK

config CHIPSET_RESET_HOOK
	bool "Enable chipset reset hook, requires a deferrable function"

config CHIPSET_X86_RSMRST_DELAY
	bool "Enable delayed RSMRST to PCH"
	help
	  Enable if chipset requires delay between power signals going high
	  and deasserting RSMRST to PCH.

config CPU_PROCHOT_ACTIVE_LOW
	bool "PROCHOT signal is active low"
	help
	  On x86 systems, define this option if the CPU_PROCHOT signal is active low"

endmenu # "Chipset config"
```

## third_party/boringssl/Kconfig
```kconfig
# Copyright 2023 The ChromiumOS Authors
# Use of this source code is governed by a BSD-style license that can be
# found in the LICENSE file.

config BORINGSSL_CRYPTO
	bool "BoringSSL support"
	depends on COMMON_LIBC_MALLOC_ARENA_SIZE >= 2048 || \
		   NEWLIB_LIBC_MIN_REQUIRED_HEAP_SIZE >= 2048
	select REQUIRES_STD_C11
	help
	  This option enables BoringSSL cryptography library.
	  The library is provided as external module.

if BORINGSSL_CRYPTO

config BORINGSSL_HARDWARE_ENTROPY
	bool "Provide entropy from hardware RNG"
	default y
	depends on POSIX_C_LIB_EXT
	help
	  This option enables support for providing entropy to BoringSSL.
	  Entropy comes from hardware RNG selected in DTS.

config HEAP_MEM_POOL_ADD_SIZE_BORINGSSL
	def_int 64
	help
      This option specifies the additional size (in bytes) to allocate when
	  initializing the BoringSSL memory pool. BoringSSL stores one pointer per
	  thread so 64 bytes seems to be enough.

endif
```

## util/Kconfig
```kconfig
config VIF_TYPE_C_CAN_ACT_AS_HOST
	bool "Indicates whether the UUT can communicate as host"
	default n
	help
	  Used during generation of VIF for USB Type-C Compliance Testing.
	  Indicates whether the UUT can communicate with USB 2.0 or USB 3.1 as a host
	  or as the Downstream Facing Port of a hub.

config VIF_CAPTIVE_CABLE
	bool "Indicates whether the UUT has a captive cable"
	default n
	help
	  Used during generation of VIF for USB Type-C Compliance Testing.
	  Indicates whether the UUT has a captive cable.
```
