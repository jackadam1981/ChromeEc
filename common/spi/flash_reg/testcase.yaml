## zephyr/Kconfig.batterystable
```kconfig
# Copyright 2023 The ChromiumOS Authors
# Use of this source code is governed by a BSD-style license that can be
# found in the LICENSE file.

menuconfig PLATFORM_EC_BATTERY_STBL_STAT
	bool "Check whether the battery is initialized and stable"
	depends on PLATFORM_EC_BATTERY
	help
	  Enables support for checking the specific battery status to
	  judge whether the battery is initialized and stable when the battery
	  wakes up from ship mode.
	  Use two MASKs to provide logical AND and logical OR options for different
	  status. For example:

	  Logical OR -- need any one of TCA/TDA mask:
	    #define CONFIG_BATT_STBL_MASK1 \
	        (STATUS_TERMINATE_CHARGE_ALARM | STATUS_TERMINATE_DISCHARGE_ALARM)
	    #define CONFIG_BATT_STBL_MASK2 0xFFFF

	  Logical AND -- need both TCA/TDA mask:
	    #define CONFIG_BATT_STBL_MASK1 STATUS_TERMINATE_CHARGE_ALARM
	    #define CONFIG_BATT_STBL_MASK2 STATUS_TERMINATE_DISCHARGE_ALARM

if PLATFORM_EC_BATTERY_STBL_STAT

config PLATFORM_EC_BATT_STBL_MASK1
	hex "The battery status mask"
	default 0x4800
	help
	  Use two MASKs to provide logical AND and logical OR options for different
	  status. Default mask 0x4800 means
	  (STATUS_TERMINATE_CHARGE_ALARM | STATUS_TERMINATE_DISCHARGE_ALARM),
	  any one of these two masks is set, the battery state can be considered
	  stable.

config PLATFORM_EC_BATT_STBL_MASK2
	hex "The battery status mask"
	default 0xFFFF
	help
	  Use two MASKs to provide logical AND and logical OR options for different
	  status. Default mask 0xFFFF means do not use this mask.

endif  # PLATFORM_EC_BATTERY_STBL_STAT
```

## zephyr/Kconfig.body_detection
```kconfig
# Copyright 2021 The Chromium OS Authors. All rights reserved.
# Use of this source code is governed by a BSD-style license that can be
# found in the LICENSE file.

menu "body detection"

config PLATFORM_EC_BODY_DETECTION
	bool "Sensor support body detection"
	help
	  Enable the body detection function.

	  The Power Reduction Algorithm is based on the Motion Detector
	  output of In Motion (on body) state or Stationary (off body) state.
	  The input of the Motion Detector is the X and Y axis signal
	  from an accelerometer.

if PLATFORM_EC_BODY_DETECTION

config PLATFORM_EC_BODY_DETECTION_MAX_WINDOW_SIZE
	int "Maximal windows size"
	default 250
	help
	  max sensor odr (Hz)

config PLATFORM_EC_BODY_DETECTION_VAR_THRESHOLD
	int "The threshold of acceleration variance"
	default 550
	help
	  The unit is (mm/s^2)^2

config PLATFORM_EC_BODY_DETECTION_CONFIDENCE_DELTA
	int "The threshold of acceleration variance"
	default 525
	help
	  The unit is (mm/s^2)^2

config PLATFORM_EC_BODY_DETECTION_VAR_NOISE_FACTOR
	int "How much noise affect threshold of variance"
	default 120
	help
	  Maximum sensor odr (Hz)

config PLATFORM_EC_BODY_DETECTION_ON_BODY_CON
	int "The confidence limit of on_body"
	default 50
	help
	  The unit is percentage

config PLATFORM_EC_BODY_DETECTION_OFF_BODY_CON
	int "The confidence limit of off body"
	default 10
	help
	  The unit is percentage

config PLATFORM_EC_BODY_DETECTION_STATIONARY_DURATION
	int "The threshold duration to change to off_body"
	default 15
	help
	  The unit is seconds

endif # PLATFORM_EC_BODY_DETECTION

endmenu # body detection
```

## zephyr/Kconfig.btn_ign
```kconfig
config PLATFORM_EC_BTN_IGN_OUT
	bool "Enable power button ignore output"
	help
	  Enables setting power button ignore state by GPIO.
	  If enabled, the btn_ign node has to be defined in DT.
	select PLATFORM_EC_BTN_IGN_OUT_FINGERPRINT

config PLATFORM_EC_BTN_IGN_OUT_FINGERPRINT
	bool "Integrate power button ignore output with fingerprint"
	help
	  Fingerprint application controls btn_ign

config PLATFORM_EC_BTN_IGN_IN
	bool "Enable power button ignore input"
	help
	  Enables handling power button ignore state read from GPIO.
```

## zephyr/Kconfig.chargesplash
```kconfig
# Copyright 2022 The Chromium OS Authors. All rights reserved.
# Use of this source code is governed by a BSD-style license that can be
# found in the LICENSE file.

menuconfig PLATFORM_EC_CHARGESPLASH
	bool "Charging splashscreen support"
	depends on PLATFORM_EC_CHARGER
	help
	  Enable visual charging indicator to display on-screen when
	  AC is initially connected.

if PLATFORM_EC_CHARGESPLASH

config PLATFORM_EC_CHARGESPLASH_BOOT_MAX_TRIES
	int "Max boot tries"
	default 5
	help
	  A charger which is connecting and disconnecting frequently
	  can indicate damage to the charger or port.  If the charger
	  disconnects too frequently when booting to the charging
	  splash, it could indicate this condition, and the
	  chargesplash feature will lockout until the next EC reset.

	  Set this value to the number of boot failures by AC
	  disconnection that should trigger the lockout.

endif  # PLATFORM_EC_CHARGESPLASH
```

## zephyr/Kconfig.fingerprint
```kconfig
# Copyright 2023 The ChromiumOS Authors
# Use of this source code is governed by a BSD-style license that can be
# found in the LICENSE file.

config PLATFORM_EC_FINGERPRINT
	bool "Support for fingerprint authentication subsystem"
	depends on BORINGSSL_CRYPTO
	help
	  This option enables fingerprint authentication subsystem which
	  is complete Match On Chip solution. Operations (e.g. enroll,
	  match) are exposed to AP using Host Command interface.

if PLATFORM_EC_FINGERPRINT

config FINGERPRINT_SHELL
	bool "Enable fingerprint debugging console commands"
	help
	  This option adds fingerprint console commands that can be used to
	  verify fingerpint functionality.

config FP_MAX_FINGER_COUNT
	int "Maximal number of loaded finger templates"
	default 5
	help
	  Max number of templates stored / matched against. This limit comes
	  from memory constraints and matching time.

endif # PLATFORM_EC_FINGERPRINT
```

## zephyr/Kconfig.header
```kconfig
# Copyright 2021 The Chromium OS Authors. All rights reserved.
# Use of this source code is governed by a BSD-style license that can be
# found in the LICENSE file.

config PLATFORM_EC_RO_HEADER
	bool "RO section includes a header"
	default y
	depends on CROS_EC_RO
	depends on SOC_FAMILY_NPCX
	help
	  The RO image residing on flash memory has a header section. The header
	  is used on some chips (such as the npcx) to load the image correctly
	  from flash. The values for offset and size are used by the linker
	  scripts to generate the header. See core/cortex-m/ec.lds.S for
	  reference.

config PLATFORM_EC_RO_HEADER_OFFSET
	hex "Offset in memory for the location of the header"
	default 0x0
	help
	  The offset (in bytes) of the header relative to the start address of
	  the RO image.

config PLATFORM_EC_RO_HEADER_SIZE
	hex "Size of the RO header"
	default 0x40
	help
	  The size of the RO header in bytes. This values should come from the
	  datasheet of the chip being used.

config PLATFORM_EC_RO_HEADER_ENABLE_HEADER_CRC
	bool "Enable header crc check"
	help
	  When enabled, the header will be verified at boot using a crc
	  checksum.

config PLATFORM_EC_RO_HEADER_ENABLE_FIRMWARE_CRC
	bool "Enable firmware image crc check"
	help
	  When enabled, the firmware image will be verified at boot using a
	  crc checksum.

config PLATFORM_EC_RO_HEADER_SPI_MAX_CLOCK
	int "Maximum clock rate (MHz) for SPI flash"
	default 20
	help
	  The maximum clock rate (MHz) allowed for the SPI flash. This must be
	  one of 20, 25, 33, 40, or 50 MHz.

config PLATFORM_EC_RO_HEADER_SPI_READ_MODE
	string
	default "dual"
	help
	  The mode used for reading SPI flash. Must be one of "normal", "fast",
	  "dual", or "quad".
```

## zephyr/Kconfig.ioex
```kconfig
# Copyright 2021 The Chromium OS Authors. All rights reserved.
# Use of this source code is governed by a BSD-style license that can be
# found in the LICENSE file.

menuconfig PLATFORM_EC_IOEX
	bool "IO expander support"
	depends on I2C
	help
	  Enable support for IO expanders subsystem.
	  This will allow to use CrOS EC calls to ioex_* functions. It supports
	  both CrOS EC ioex drivers and Zephyr GPIO drivers.

if PLATFORM_EC_IOEX

config PLATFORM_EC_IOEX_INIT_PRIORITY
	int "IOEX init priority"
	range 0 99
	default 52
	help
	  Sets the priority of function that initializes the IOEX subsystem

config PLATFORM_EC_IOEX_SHELL_COMMANDS
	bool "Enable shell commands for io expander"
	depends on SHELL
	help
	  Enable shell commands for io expander.
	  It will enable ioexget and ioexset commands in EC console
	  that allow to get and change values of io expanders pins.

endif
```

## zephyr/Kconfig.log
```kconfig
# These Logging Modules were pre generated from CrOS EC console_channel.inc

config LOG
	default y

config PLATFORM_EC_LOG_FULL
	bool "Enable core Zephyr logging features"
	imply LOG_SPEED
	imply LOG_OUTPUT_FORMAT_LINUX_TIMESTAMP
	imply LOG_RUNTIME_FILTERING
	help
	  The Zephyr logging subsystem is quite robust. Selecting this option
	  will enable the core Zephyr logging features used by EC.
	  The logging subsystem consumes a significant amount of storage and memory,
	  so some EC projects will not be able to utilize it.

choice LOG_MODE
	default LOG_MODE_IMMEDIATE if PLATFORM_EC_LOG_FULL
	default LOG_MODE_MINIMAL
endchoice

module = CC_COMMAND
module-str = command
source "subsys/logging/Kconfig.template.log_config"

module = CC_ACCEL
module-str = accel
source "subsys/logging/Kconfig.template.log_config"

module = CC_AUDIO_CODEC
module-str = audio_codec
source "subsys/logging/Kconfig.template.log_config"

module = CC_BLUETOOTH_LE
module-str = bluetooth_le
source "subsys/logging/Kconfig.template.log_config"

module = CC_BLUETOOTH_LL
module-str = bluetooth_ll
source "subsys/logging/Kconfig.template.log_config"

module = CC_BLUETOOTH_HCI
module-str = bluetooth_hci
source "subsys/logging/Kconfig.template.log_config"

module = CC_CEC
module-str = cec
source "subsys/logging/Kconfig.template.log_config"

module = CC_CHARGER
module-str = charger
source "subsys/logging/Kconfig.template.log_config"

module = CC_CHIPSET
module-str = chipset
source "subsys/logging/Kconfig.template.log_config"

module = CC_CLOCK
module-str = clock
source "subsys/logging/Kconfig.template.log_config"

module = CC_DMA
module-str = dma
source "subsys/logging/Kconfig.template.log_config"

module = CC_EVENTS
module-str = events
source "subsys/logging/Kconfig.template.log_config"

module = CC_FP
module-str = fingerprint
source "subsys/logging/Kconfig.template.log_config"

module = CC_GESTURE
module-str = gesture
source "subsys/logging/Kconfig.template.log_config"

module = CC_GPIO
module-str = gpio
source "subsys/logging/Kconfig.template.log_config"

module = CC_HOSTCMD
module-str = hostcmd
source "subsys/logging/Kconfig.template.log_config"

module = CC_I2C
module-str = i2c
source "subsys/logging/Kconfig.template.log_config"

module = CC_IPI
module-str = ipi
source "subsys/logging/Kconfig.template.log_config"

module = CC_KEYBOARD
module-str = keyboard
source "subsys/logging/Kconfig.template.log_config"

module = CC_KEYSCAN
module-str = keyscan
source "subsys/logging/Kconfig.template.log_config"

module = CC_LIDANGLE
module-str = lidangle
source "subsys/logging/Kconfig.template.log_config"

module = CC_LOGOLED
module-str = logoled
source "subsys/logging/Kconfig.template.log_config"

module = CC_LIGHTBAR
module-str = lightbar
source "subsys/logging/Kconfig.template.log_config"

module = CC_RGBKBD
module-str = rgbkbd
source "subsys/logging/Kconfig.template.log_config"

module = CC_LPC
module-str = lpc
source "subsys/logging/Kconfig.template.log_config"

module = CC_MOTION_LID
module-str = motionlid
source "subsys/logging/Kconfig.template.log_config"

module = CC_MOTION_SENSE
module-str = motionsense
source "subsys/logging/Kconfig.template.log_config"

module = CC_PD_HOST_CMD
module-str = pdhostcm
source "subsys/logging/Kconfig.template.log_config"

module = CC_PORT80
module-str = port80
source "subsys/logging/Kconfig.template.log_config"

module = CC_PS2
module-str = ps2
source "subsys/logging/Kconfig.template.log_config"

module = CC_PCHG
module-str = pchg
source "subsys/logging/Kconfig.template.log_config"

module = CC_PWM
module-str = pwm
source "subsys/logging/Kconfig.template.log_config"

module = CC_SPI
module-str = spi
source "subsys/logging/Kconfig.template.log_config"

module = CC_SWITCH
module-str = switch
source "subsys/logging/Kconfig.template.log_config"

module = CC_SYSTEM
module-str = system
source "subsys/logging/Kconfig.template.log_config"

module = CC_TASK
module-str = task
source "subsys/logging/Kconfig.template.log_config"

module = CC_TOUCHPAD
module-str = touchpad
source "subsys/logging/Kconfig.template.log_config"

module = CC_DPTF
module-str = dptf
source "subsys/logging/Kconfig.template.log_config"

module = CC_ALS
module-str = als
source "subsys/logging/Kconfig.template.log_config"

module = CC_THERMAL
module-str = thermal
source "subsys/logging/Kconfig.template.log_config"

module = CC_USB
module-str = usb
source "subsys/logging/Kconfig.template.log_config"

module = CC_USBCHARGE
module-str = usbcharge
source "subsys/logging/Kconfig.template.log_config"

module = CC_USBPD
module-str = usbpd
source "subsys/logging/Kconfig.template.log_config"

module = CC_VBOOT
module-str = vboot
source "subsys/logging/Kconfig.template.log_config"

module = CC_HOOK
module-str = hook
source "subsys/logging/Kconfig.template.log_config"

module = CC_GPU
module-str = gpu
source "subsys/logging/Kconfig.template.log_config"
```
